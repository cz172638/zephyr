## CMakeLists.txt
```
# Copyright The Zephyr Project Contributors
# SPDX-License-Identifier: Apache-2.0

cmake_minimum_required(VERSION 3.20.0)
find_package(Zephyr REQUIRED HINTS $ENV{ZEPHYR_BASE})
project(rk3399_amp)

target_sources(app PRIVATE src/main.c)
```

## Kconfig
```
# Copyright The Zephyr Project Contributors
# SPDX-License-Identifier: Apache-2.0

mainmenu "RK3399 AMP launcher"

config AMP_A72_ENTRY
	hex "Entry point of the big cluster image (0 = do not start)"
	default 0x04000000

config AMP_M0_PMU_IMAGE
	hex "DRAM address of the PMU M0 image (0 = do not start)"
	default 0x06000000

config AMP_M0_PERILP_IMAGE
	hex "DRAM address of the PERILP M0 image (0 = do not start)"
	default 0x06100000

config AMP_M0_PERILP_DIV
	int "PERILP M0 clock divider, fclk = GPLL / (div + 1)"
	default 7

source "Kconfig.zephyr"
```

## prj.conf
```kconfig
CONFIG_RK3399_REMOTE_CORE_CONTROL=y
```

## src/main.c
```c
/*
 * Copyright The Zephyr Project Contributors
 * SPDX-License-Identifier: Apache-2.0
 *
 * Runs on the little cluster and starts the other images, which a previous
 * boot stage (U-Boot, or the SPL FIT "loadables") has already placed in
 * DRAM and cleaned to the point of coherency.
 */

#include <stdio.h>

#include <zephyr/kernel.h>

#include <soc.h>
#include <rk3399_cores.h>

static void report(const char *what, int ret)
{
	printf("%-12s %s (%d)\n", what, (ret == 0) ? "started" : "FAILED", ret);
}

int main(void)
{
	printf("RK3399 AMP launcher on %s\n", CONFIG_BOARD_TARGET);

	if (CONFIG_AMP_M0_PMU_IMAGE != 0) {
		report("PMU M0", rk3399_m0_start(RK3399_M0_PMU, CONFIG_AMP_M0_PMU_IMAGE, 0));
	}

	if (CONFIG_AMP_M0_PERILP_IMAGE != 0) {
		report("PERILP M0", rk3399_m0_start(RK3399_M0_PERILP, CONFIG_AMP_M0_PERILP_IMAGE,
						    CONFIG_AMP_M0_PERILP_DIV));
	}

	if (CONFIG_AMP_A72_ENTRY != 0) {
		report("A72 CPU4", rk3399_cpu_start(RK3399_MPIDR_A72(0), CONFIG_AMP_A72_ENTRY));
	}

	return 0;
}
```
