## CMakeLists.txt
```
# SPDX-FileCopyrightText: Copyright The Zephyr Project Contributors
# SPDX-License-Identifier: Apache-2.0

cmake_minimum_required(VERSION 3.20.0)
find_package(Zephyr REQUIRED HINTS $ENV{ZEPHYR_BASE})
project(sun55i_pcie_shell)

target_sources(app PRIVATE src/main.c)
```

## prj.conf
```kconfig
CONFIG_GPIO=y
CONFIG_LOG=y
CONFIG_SHELL=y
CONFIG_KERNEL_SHELL=y
CONFIG_DEVMEM_SHELL=y
CONFIG_SHELL_STACK_SIZE=8192

# root complex; "pcie controller", "pcie ls", "pcie cfg"
CONFIG_PCIE=y
CONFIG_PCIE_CONTROLLER=y

# DBI 4.5 MiB, BARs of the endpoints mapped at run time
CONFIG_KERNEL_VM_SIZE=0x10000000
CONFIG_MAX_XLAT_TABLES=32

# AER below the root port, polled with the link monitor; "pcie controller aer"
CONFIG_PCIE_AER=y
```

## src/main.c
```c
/*
 * SPDX-FileCopyrightText: Copyright The Zephyr Project Contributors
 * SPDX-License-Identifier: Apache-2.0
 *
 * The A523 root complex comes up and enumerates during boot; the "pcie"
 * shell commands show the link and the devices behind the M.2 slot.
 */

#include <zephyr/device.h>
#include <zephyr/devicetree.h>
#include <zephyr/kernel.h>

int main(void)
{
	const struct device *pcie = DEVICE_DT_GET(DT_NODELABEL(pcie));

	printk("pcie: root complex %s %s\n", pcie->name,
	       device_is_ready(pcie) ? "ready" : "failed");
	return 0;
}
```
