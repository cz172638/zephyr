## CMakeLists.txt
```
# Copyright (c) 2026 Jiri Kastner
# SPDX-License-Identifier: Apache-2.0

cmake_minimum_required(VERSION 3.20.0)
find_package(Zephyr REQUIRED HINTS $ENV{ZEPHYR_BASE})
project(netshell)

target_sources(app PRIVATE src/main.c src/config.c src/top.c)
# TCAM rule API of the switch driver
target_include_directories(app PRIVATE ${ZEPHYR_BASE}/drivers/ethernet/phy)

# Public key allowed to log in, PEM/PKCS8, e.g.
#   ssh-keygen -e -m PKCS8 -f ~/.ssh/id_rsa.pub > authorized_key.pem
# taken from -DNETSHELL_AUTHORIZED_KEY=<file> or authorized_key.pem here.
if(NOT NETSHELL_AUTHORIZED_KEY)
  set(NETSHELL_AUTHORIZED_KEY ${CMAKE_CURRENT_SOURCE_DIR}/authorized_key.pem)
endif()

if(EXISTS ${NETSHELL_AUTHORIZED_KEY})
  set(gen_dir ${ZEPHYR_BINARY_DIR}/include/generated)
  generate_inc_file_for_target(app ${NETSHELL_AUTHORIZED_KEY} ${gen_dir}/authorized_key.inc)
  target_compile_definitions(app PRIVATE NETSHELL_HAVE_AUTHORIZED_KEY=1)
  message(STATUS "netshell: authorized key ${NETSHELL_AUTHORIZED_KEY}")
elseif(CONFIG_NETSHELL_PASSWORD STREQUAL "")
  message(FATAL_ERROR "netshell: give an authorized key (authorized_key.pem or "
                      "-DNETSHELL_AUTHORIZED_KEY=...) or CONFIG_NETSHELL_PASSWORD")
endif()

# Lab agent: built-in LLEXT self test (lab selftest, source in
# subsys/lab/ext), and debug modules: <image>-<name>.llext, built with
#   west build -d <dir> -t lab_mods
# without touching the firmware (zephyr.elf is only read, by the
# symbol check: a module that needs a symbol the firmware does not
# export means a new firmware image).
if(CONFIG_LAB_EXT)
  set(lab_ext_bin ${PROJECT_BINARY_DIR}/llext/lab_hello.llext)
  add_llext_target(lab_hello_ext
    OUTPUT  ${lab_ext_bin}
    SOURCES ${ZEPHYR_BASE}/subsys/lab/ext/lab_hello.c
  )
  generate_inc_file_for_target(app ${lab_ext_bin}
    ${ZEPHYR_BINARY_DIR}/include/generated/lab_hello.inc)
  target_sources(app PRIVATE src/lab_selftest.c src/dbg_exports.c)
  target_include_directories(app PRIVATE ${ZEPHYR_BASE}/drivers/pcie/endpoint)

  set(lab_img ${CONFIG_LAB_IMAGE})
  set(lab_mod_dir ${PROJECT_BINARY_DIR}/llext)
  set(epc_dir ${ZEPHYR_BASE}/drivers/pcie/endpoint)
  set(lab_mod_files)
  function(lab_dbg_module name)
    set(out ${lab_mod_dir}/${lab_img}-${name}.llext)
    add_llext_target(lab_mod_${name} OUTPUT ${out} SOURCES ${ARGN})
    get_target_property(lib lab_mod_${name} lib_target)
    target_include_directories(${lib} PRIVATE ${epc_dir})
    set(lab_mod_files ${lab_mod_files} ${out} PARENT_SCOPE)
    set(lab_mod_targets ${lab_mod_targets} lab_mod_${name} PARENT_SCOPE)
  endfunction()

  lab_dbg_module(irqtest ${epc_dir}/pcie_epc_aardvark_a3700_irqtest.c)
  lab_dbg_module(xortest ${epc_dir}/pcie_epc_aardvark_a3700_xortest.c)
  lab_dbg_module(loopback ${CMAKE_CURRENT_SOURCE_DIR}/dbg/pcie_loopback.c)
  lab_dbg_module(comphy ${CMAKE_CURRENT_SOURCE_DIR}/dbg/comphy.c)
  lab_dbg_module(netlb ${CMAKE_CURRENT_SOURCE_DIR}/dbg/netlb.c)
  lab_dbg_module(ibmap ${CMAKE_CURRENT_SOURCE_DIR}/dbg/ibmap.c)
  lab_dbg_module(regdiff ${CMAKE_CURRENT_SOURCE_DIR}/dbg/regdiff.c)
  lab_dbg_module(mbusx ${CMAKE_CURRENT_SOURCE_DIR}/dbg/mbusx.c)

  # with the firmware: build and name the modules
  add_custom_target(lab_mods_build ALL
    COMMAND ${CMAKE_COMMAND} -E copy ${lab_ext_bin} ${lab_mod_dir}/${lab_img}-lab_hello.llext
    DEPENDS ${lab_mod_targets} lab_hello_ext
    VERBATIM)
  # on their own (-t lab_mods): build, then check against the existing
  # zephyr.elf, which is not rebuilt
  add_custom_target(lab_mods
    COMMAND ${ZEPHYR_BASE}/scripts/lab/llext-symcheck.pl -nm ${CMAKE_NM}
            ${ZEPHYR_BINARY_DIR}/zephyr.elf ${lab_mod_files}
    DEPENDS lab_mods_build
    COMMENT "lab debug modules for image ${lab_img}, symbol check"
    VERBATIM)
endif()
```

## Kconfig
```
# Copyright (c) 2026 Jiri Kastner
# SPDX-License-Identifier: Apache-2.0

source "Kconfig.zephyr"

config NETSHELL_USERNAME
	string "SSH user name (empty: any)"
	default "root"

config NETSHELL_PASSWORD
	string "SSH password (empty: public key only)"
	default ""
	help
	  Only used when no authorized key is built in, or in addition to it.
	  Stored in clear text in the image.

config NETSHELL_HOST_KEY_BITS
	int "RSA host key size"
	default 2048

config NETSHELL_MAC_SPI_NOR_UID
	bool "MAC addresses from the SPI NOR unique ID"
	default y
	depends on SPI_NOR
	select FLASH_EX_OP_ENABLED
	help
	  Interfaces without a saved MAC address get one derived from the
	  64-bit factory unique ID of the SPI NOR (command 0x4B) and the
	  interface index: locally administered, the same on every boot and
	  after a settings erase, nothing written. A saved address (older
	  images) still wins; "config mac-uid" drops those. Without the ID
	  the random address is saved as before.

config NETSHELL_ROUTER
	bool "Router: wan uplink, bridged lan ports with a DHCP server"
	depends on NET_DSA && NET_ETHERNET_BRIDGE && NET_DHCPV4_SERVER && NET_IPV4_FORWARDING
	depends on NET_DHCPV4_OPTION_CALLBACKS
	help
	  The DSA port named NETSHELL_WAN_IFACE gets an address with DHCP,
	  the ports whose names start with NETSHELL_LAN_PREFIX join the
	  first bridge, which gets NETSHELL_LAN_ADDR and a DHCP server.
	  IPv4 is forwarded between them without NAT; the DHCP server hands
	  out the DNS server of the wan lease. Name the ports with
	  the espressobin-dsa-v5 or espressobin-dsa-v7 snippet.

if NETSHELL_ROUTER

config NETSHELL_WAN_IFACE
	string "Uplink interface"
	default "wan"

config NETSHELL_LAN_PREFIX
	string "Name prefix of the bridged interfaces"
	default "lan"

config NETSHELL_LAN_ADDR
	string "LAN (bridge) address"
	default "192.168.10.1"

config NETSHELL_LAN_NETMASK
	string "LAN netmask"
	default "255.255.255.0"

config NETSHELL_DHCP_POOL
	string "First address handed out by the DHCP server"
	default "192.168.10.100"
	help
	  CONFIG_NET_DHCPV4_SERVER_ADDR_COUNT consecutive addresses.

endif
```

## sample.yaml
```
sample:
  name: ESPRESSObin network shell
common:
  platform_allow:
    - espressobin
    - espressobin/armada3720/smp
  tags:
    - net
    - shell
    - ssh
  build_only: true
tests:
  sample.boards.espressobin.netshell:
    extra_configs:
      - CONFIG_NETSHELL_PASSWORD="test"
```

## prj.conf
```kconfig
# Headless ESPRESSObin: DHCP, SSH shell, firmware update over TCP.

CONFIG_NETWORKING=y
CONFIG_NET_IPV4=y
CONFIG_NET_IPV6=n
CONFIG_NET_TCP=y
CONFIG_NET_UDP=y
CONFIG_NET_DHCPV4=y
# DHCP sends the name, mDNS answers <name>.local
CONFIG_NET_HOSTNAME_ENABLE=y
CONFIG_NET_HOSTNAME="espressobin"
CONFIG_NET_HOSTNAME_UNIQUE=y
CONFIG_NET_HOSTNAME_UNIQUE_UPDATE=y
CONFIG_MDNS_RESPONDER=y
CONFIG_DNS_SD=y
CONFIG_NET_SOCKETS=y
CONFIG_NET_MAX_CONTEXTS=12
# UDP/TCP handlers: mDNS per interface, DHCP, SSH, fwupdate (default 4)
CONFIG_NET_MAX_CONN=16
CONFIG_NET_PKT_RX_COUNT=64
CONFIG_NET_PKT_TX_COUNT=64
CONFIG_NET_BUF_RX_COUNT=128
CONFIG_NET_BUF_TX_COUNT=128
CONFIG_NET_RX_STACK_SIZE=4096
CONFIG_ZVFS_POLL_MAX=10
CONFIG_ZVFS_OPEN_MAX=16

CONFIG_SHELL=y
CONFIG_NET_SHELL=y
CONFIG_SHELL_STACK_SIZE=8192
CONFIG_KERNEL_SHELL=y
CONFIG_REBOOT=y
CONFIG_LOG=y

# SSH server with shell backend; host key kept in settings (NVS)
CONFIG_SSH_SERVER=y
CONFIG_SSH_SERVER_MAX_CLIENTS=2
CONFIG_SSH_MAX_CHANNELS=2
CONFIG_SSH_MAX_HOST_KEYS=2
CONFIG_MBEDTLS=y
CONFIG_MAIN_STACK_SIZE=16384
# ssh <board> '<command>', and scp -O image <board>:/fw (fwupdate)
CONFIG_SHELL_SSH_EXEC=y
CONFIG_SHELL_SSH_SCP=y
CONFIG_SHELL_DUMMY_INIT_LOG_LEVEL_NONE=y
CONFIG_SHELL_PROMPT_DUMMY=""
# Bigger channel buffers: the window is topped up at half, scp streams
CONFIG_SSH_CHANNEL_BUF_SIZE=8192

# No hardware RNG driver for the Armada 3700 yet
CONFIG_ENTROPY_GENERATOR=y
CONFIG_TEST_RANDOM_GENERATOR=y

CONFIG_FLASH=y
CONFIG_FLASH_MAP=y
CONFIG_FLASH_SHELL=y
CONFIG_NVS=y
CONFIG_SETTINGS=y
CONFIG_SETTINGS_NVS=y

CONFIG_FWUPDATE=y
CONFIG_FWUPDATE_TCP=y

CONFIG_NET_L2_ETHERNET_MGMT=y
CONFIG_ETH_MVNETA_SHELL=y
CONFIG_PHY_MARVELL_MV88E6XXX_SHELL=y
CONFIG_PHY_MARVELL_MV88E6XXX_TCAM=y

# "top": per thread / per CPU runtime statistics
CONFIG_THREAD_RUNTIME_STATS=y
CONFIG_SCHED_THREAD_USAGE_ALL=y
```

## gptp.conf
```kconfig
# gPTP (802.1AS) on the DSA ports, with -S espressobin-dsa:
#   west build ... -S espressobin-dsa -- -DEXTRA_CONF_FILE=gptp.conf
# "net gptp" in the shell shows the port states and statistics.
CONFIG_NET_GPTP=y
CONFIG_NET_GPTP_NUM_PORTS=3
CONFIG_NET_GPTP_STATISTICS=y
CONFIG_NET_GPTP_GM_CAPABLE=y
CONFIG_PTP_CLOCK_SHELL=y
```

## netstats.conf
```kconfig
# Network statistics for debugging stalls:
#   net stats [iface|all]   per interface counters (IP, TCP, UDP, errors)
#   net mem                 net_pkt slabs and net_buf pools in use
#   net allocs              net_pkt/net_buf currently allocated, by caller
CONFIG_NET_STATISTICS=y
CONFIG_NET_STATISTICS_PER_INTERFACE=y
CONFIG_NET_STATISTICS_ETHERNET=y
CONFIG_NET_STATISTICS_USER_API=y
CONFIG_NET_BUF_POOL_USAGE=y
CONFIG_NET_DEBUG_NET_PKT_ALLOC=y
```

## pcie-ep-uartlog.conf
```kconfig
# PCIe endpoint (snippet espressobin-pcie-ep) bring-up: logs and printk
# straight to the UART. With the shell as the only log backend the
# router + endpoint image does not come up (open, see design doc).
CONFIG_PCIE_EPC_AARDVARK_TRACE_INIT=y
CONFIG_LOG_PRINTK=n
CONFIG_LOG_BACKEND_UART=y
CONFIG_PCIE_AARDVARK_TRACE_INIT=y
```

## router.conf
```kconfig
# Router: wan with DHCP, lan0+lan1 bridged in the switch with a DHCP
# server, IPv4 forwarding without NAT. With the DSA and port name snippets:
#   west build ... -S espressobin-dsa -S espressobin-dsa-v7 \
#       -- -DEXTRA_CONF_FILE=router.conf
# with gPTP on wan, lan0 and lan1: -DEXTRA_CONF_FILE="router.conf;gptp.conf"
CONFIG_NETSHELL_ROUTER=y
CONFIG_NET_ETHERNET_BRIDGE=y
CONFIG_NET_ETHERNET_BRIDGE_SHELL=y
CONFIG_NET_DHCPV4_SERVER=y
CONFIG_NET_DHCPV4_SERVER_ADDR_COUNT=32
# The LAN gets the DNS server of the wan lease (option callback); set
# CONFIG_NET_DHCPV4_SERVER_OPTION_DNS_ADDRESS for one until then
CONFIG_NET_DHCPV4_OPTION_CALLBACKS=y
CONFIG_NET_IPV4_ROUTE=y
CONFIG_NET_IPV4_FORWARDING=y
# eth0, swp0, wan, lan0, lan1, bridge
CONFIG_NET_IF_MAX_IPV4_COUNT=6
# mDNS takes a UDP context and connection handler per interface; with
# the DHCP client and server, SSH and fwupdate the default 4 handlers run
# out and the DHCP server fails with -ENOENT
CONFIG_NET_MAX_CONN=24
CONFIG_NET_MAX_CONTEXTS=32
CONFIG_ZVFS_OPEN_MAX=32
CONFIG_ZVFS_POLL_MAX=16
CONFIG_NET_PKT_RX_COUNT=128
CONFIG_NET_PKT_TX_COUNT=128
CONFIG_NET_BUF_RX_COUNT=256
CONFIG_NET_BUF_TX_COUNT=256
```

## sdcard.conf
```kconfig
# microSD (Xenon SDHC) with FAT and the fs shell:
#   -DEXTRA_CONF_FILE=sdcard.conf (with router.conf/gptp.conf: ";"-separated)
#   fs mount fat /SD: ; fs ls /SD:
CONFIG_DISK_ACCESS=y
CONFIG_DISK_DRIVERS=y
CONFIG_DISK_DRIVER_SDMMC=y
CONFIG_FILE_SYSTEM=y
CONFIG_FAT_FILESYSTEM_ELM=y
CONFIG_FILE_SYSTEM_SHELL=y
CONFIG_REGULATOR=y
# fs mount needs the kernel heap
CONFIG_HEAP_MEM_POOL_SIZE=16384
# fs read_test / erase_write_test with speed
CONFIG_FILE_SYSTEM_SHELL_TEST_COMMANDS=y
# the test buffer lives on the shell stack
CONFIG_FILE_SYSTEM_SHELL_BUFFER_SIZE=0x4000
CONFIG_SHELL_STACK_SIZE=24576
# uptime stamps and rates around fs commands; big aligned cp chunks
CONFIG_FILE_SYSTEM_SHELL_TIMING=y
CONFIG_FILE_SYSTEM_SHELL_CP_BUFFER_SIZE=32768
```

## zerocopy.conf
```kconfig
# NETA zero copy: RX into net_bufs handed to the stack, TX from the
# packet's own fragments. Full size net_bufs keep a frame in one or two
# fragments; more TX descriptors for the per-fragment descriptors.
#   -DEXTRA_CONF_FILE="router.conf;gptp.conf;zerocopy.conf"
#   mvneta_zc        counters (zero copy vs. copied) and RX pool
CONFIG_ETH_MVNETA_ZERO_COPY=y
CONFIG_ETH_MVNETA_TX_DESCS=128
CONFIG_NET_BUF_DATA_SIZE=1536
CONFIG_NET_BUF_POOL_USAGE=y
# throughput: zperf udp/tcp upload/download
CONFIG_NET_ZPERF=y
```

## boards/espressobin_armada3720.overlay
```dts
/*
 * Settings (SSH host key, MAC) in the "zephyr-storage" partition just
 * below the U-Boot environment, so a U-Boot in the same flash keeps its
 * env and Zephyr started by it keeps its settings.
 */
/ {
	chosen {
		zephyr,settings-partition = &storage_partition;
	};
};
```

## boards/espressobin_armada3720_smp.overlay
```dts
/*
 * Settings (SSH host key) in the last 64 KiB of the SPI NOR, where the
 * stock U-Boot keeps its environment.
 */
/ {
	chosen {
		zephyr,settings-partition = &env_partition;
	};
};
```

## src/main.c
```c
/*
 * Copyright (c) 2026 Jiri Kastner
 *
 * SPDX-License-Identifier: Apache-2.0
 *
 * Headless ESPRESSObin: get an address with DHCP and start an SSH server
 * with the Zephyr shell, so the board can be used and updated
 * ("fwupdate tcp") without a serial console.
 *
 * The RSA host key is generated on the first boot and kept in settings
 * (NVS in the SPI NOR), so the fingerprint stays the same across reboots
 * and firmware updates. A random (locally administered) MAC address is
 * kept the same way, so DHCP leases and the mDNS name stay stable.
 *
 * With DSA (espressobin-dsa snippet) every switch port is its own
 * interface: each one gets a stable MAC address and DHCP.
 *
 * As a router (router.conf, ports named by espressobin-dsa-v5/-v7) the
 * wan port gets DHCP, the lan ports form a bridge, switched in hardware,
 * with a static address and a DHCP server, and IPv4 is forwarded between
 * the two (no NAT: the upstream router needs a route to the LAN).
 */

#include <stdio.h>
#include <string.h>
#include <zephyr/kernel.h>
#include <zephyr/drivers/flash.h>
#include <zephyr/drivers/flash/spi_nor_ex.h>
#include <zephyr/net/net_if.h>
#include <zephyr/net/dhcpv4.h>
#include <zephyr/net/dhcpv4_server.h>
#include <zephyr/net/ethernet_bridge.h>
#include <zephyr/net/ethernet.h>
#include <zephyr/net/ethernet_mgmt.h>
#include <zephyr/net/net_mgmt.h>
#include <zephyr/net/ssh/keygen.h>
#include <zephyr/net/ssh/server.h>
#include <zephyr/settings/settings.h>
#include <zephyr/storage/flash_map.h>
#include <zephyr/shell/shell.h>
#include <zephyr/shell/shell_uart.h>

#include "config.h"

#include <zephyr/logging/log.h>
LOG_MODULE_REGISTER(netshell, LOG_LEVEL_INF);

#if DT_HAS_CHOSEN(zephyr_settings_partition)
#define SETTINGS_AREA DT_PARTITION_ID(DT_CHOSEN(zephyr_settings_partition))
#else
#define SETTINGS_AREA PARTITION_ID(storage_partition)
#endif

#define HOST_KEY_IDX 0
#define AUTH_KEY_IDX 1

#if defined(NETSHELL_HAVE_AUTHORIZED_KEY)
static const char authorized_key[] = {
#include "authorized_key.inc"
	0,
};
#endif

struct setting_read {
	void *buf;
	size_t len;
	bool found;
};

static int setting_read_cb(const char *key, size_t len, settings_read_cb read_cb, void *cb_arg,
			   void *param)
{
	struct setting_read *r = param;

	ARG_UNUSED(key);

	if (len == r->len && read_cb(cb_arg, r->buf, len) == len) {
		r->found = true;
	}
	return 0;
}

/*
 * MAC address from the SPI NOR factory unique ID (command 0x4B): the same
 * on every boot and after a settings erase, different per interface (n).
 * FNV-1a 64 over the ID and n; locally administered, unicast.
 */
static bool uid_mac(int n, uint8_t mac[NET_ETH_ADDR_LEN])
{
#if defined(CONFIG_NETSHELL_MAC_SPI_NOR_UID)
	static uint8_t uid[SPI_NOR_UID_LEN];
	static int uid_state; /* 0 not read, 1 valid, -1 none */
	uint64_t h = 0xcbf29ce484222325ULL;

	if (uid_state == 0) {
		const struct device *nor = DEVICE_DT_GET_ANY(jedec_spi_nor);
		bool blank = true;

		uid_state = -1;
		if (nor != NULL && device_is_ready(nor) &&
		    flash_ex_op(nor, FLASH_EX_OP_SPI_NOR_READ_UID, 0, uid) == 0) {
			for (int i = 0; i < SPI_NOR_UID_LEN; i++) {
				blank &= uid[i] == 0x00 || uid[i] == 0xff;
			}
			uid_state = blank ? -1 : 1;
		}
		if (uid_state < 0) {
			LOG_WRN("no SPI NOR unique ID, random MAC addresses");
		}
	}
	if (uid_state < 0) {
		return false;
	}

	for (int i = 0; i < SPI_NOR_UID_LEN + 1; i++) {
		h ^= i < SPI_NOR_UID_LEN ? uid[i] : (uint8_t)n;
		h *= 0x100000001b3ULL;
	}
	for (int i = 0; i < NET_ETH_ADDR_LEN; i++) {
		mac[i] = h >> (8 * i);
	}
	mac[0] = (mac[0] & ~0x01) | 0x02;
	return true;
#else
	ARG_UNUSED(n);
	ARG_UNUSED(mac);
	return false;
#endif
}

/*
 * Stable MAC address: one saved in settings (older images, or set by
 * hand) wins, else the one from the SPI NOR unique ID, else the random
 * one is saved and kept. A real (universal) address is left alone.
 * Interface 1 keeps the key of the single interface setup.
 */
static void stable_mac(struct net_if *iface)
{
	struct net_linkaddr *ll = net_if_get_link_addr(iface);
	struct ethernet_req_params params = {0};
	uint8_t mac[NET_ETH_ADDR_LEN];
	struct setting_read r = {.buf = mac, .len = sizeof(mac)};
	int idx = net_if_get_by_iface(iface);
	const char *how = "saved";
	char key[24];

	if (ll->len != NET_ETH_ADDR_LEN || (ll->addr[0] & 0x02) == 0) {
		return;
	}

	if (idx == 1) {
		snprintf(key, sizeof(key), "netshell/mac");
	} else {
		snprintf(key, sizeof(key), "netshell/mac%d", idx);
	}

	(void)settings_load_subtree_direct(key, setting_read_cb, &r);
	if (!r.found) {
		if (!uid_mac(idx, mac)) {
			(void)settings_save_one(key, ll->addr, NET_ETH_ADDR_LEN);
			LOG_INF("iface %d: saved MAC %02x:%02x:%02x:%02x:%02x:%02x", idx,
				ll->addr[0], ll->addr[1], ll->addr[2], ll->addr[3], ll->addr[4],
				ll->addr[5]);
			return;
		}
		how = "SPI NOR UID";
	}
	if (memcmp(mac, ll->addr, sizeof(mac)) == 0) {
		return;
	}

	memcpy(params.mac_address.addr, mac, sizeof(mac));
	(void)net_if_down(iface);
	if (net_mgmt(NET_REQUEST_ETHERNET_SET_MAC_ADDRESS, iface, &params, sizeof(params)) != 0) {
		LOG_WRN("could not set the MAC address");
	}
	(void)net_if_up(iface);
	LOG_INF("iface %d: MAC %02x:%02x:%02x:%02x:%02x:%02x (%s)", idx, mac[0], mac[1], mac[2],
		mac[3], mac[4], mac[5], how);
}

/* Drop the saved MAC addresses: the next boot takes them from the UID */
int netshell_mac_forget(void)
{
	char key[24];

	(void)settings_delete("netshell/mac");
	(void)settings_delete("netshell/brmac");
	for (int i = 2; i <= 16; i++) {
		snprintf(key, sizeof(key), "netshell/mac%d", i);
		(void)settings_delete(key);
	}
	return 0;
}

#if defined(CONFIG_NETSHELL_ROUTER)
static struct net_if *lan_bridge;

struct net_if *netshell_bridge(void)
{
	return lan_bridge;
}

static void find_bridge(struct eth_bridge_iface_context *br, void *user_data)
{
	struct net_if **found = user_data;

	if (*found == NULL) {
		*found = br->iface;
	}
}

/* Bridge MAC address, kept like the port ones; set while the bridge is
 * down and before the ports join (the switch gets it as a static entry)
 */
static void bridge_mac(struct net_if *br)
{
	struct net_linkaddr *ll = net_if_get_link_addr(br);
	uint8_t mac[NET_ETH_ADDR_LEN];
	struct setting_read r = {.buf = mac, .len = sizeof(mac)};

	(void)settings_load_subtree_direct("netshell/brmac", setting_read_cb, &r);
	if (!r.found && !uid_mac(0, mac)) {
		(void)settings_save_one("netshell/brmac", ll->addr, NET_ETH_ADDR_LEN);
		return;
	}
	(void)net_if_set_link_addr(br, mac, sizeof(mac), NET_LINK_ETHERNET);
}

/* Hand out the DNS server the wan lease names (there is no forwarder) */
static uint8_t wan_dns[4];
static struct net_dhcpv4_option_callback wan_dns_cb;

static void wan_dns_handler(struct net_dhcpv4_option_callback *cb, size_t length,
			    enum net_dhcpv4_msg_type msg_type, struct net_if *iface)
{
	char name[CONFIG_NET_INTERFACE_NAME_LEN + 1];
	struct net_in_addr dns;
	char str[NET_IPV4_ADDR_LEN];

	if (length < sizeof(wan_dns) || msg_type != NET_DHCPV4_MSG_TYPE_ACK ||
	    net_if_get_name(iface, name, sizeof(name)) < 0 ||
	    strcmp(name, CONFIG_NETSHELL_WAN_IFACE) != 0) {
		return;
	}

	memcpy(dns.s4_addr, wan_dns, sizeof(wan_dns));
	netshell_wan_dns = dns;
	if (!net_ipv4_is_addr_unspecified(&netshell_lan.dns)) {
		/* A fixed one is configured */
		return;
	}
	net_dhcpv4_server_set_dns_address(&dns);
	LOG_INF("LAN DNS server %s (from %s)",
		net_addr_ntop(NET_AF_INET, &dns, str, sizeof(str)), name);
}

/* The DHCP client only sets the interface gateway, forwarding needs a
 * default router: the router option of the wan lease
 */
static uint8_t wan_gw[4];
static struct net_dhcpv4_option_callback wan_gw_cb;
static struct net_if_router *wan_router;

static void wan_gw_handler(struct net_dhcpv4_option_callback *cb, size_t length,
			   enum net_dhcpv4_msg_type msg_type, struct net_if *iface)
{
	char name[CONFIG_NET_INTERFACE_NAME_LEN + 1];
	struct net_in_addr gw;
	char str[NET_IPV4_ADDR_LEN];

	if (length < sizeof(wan_gw) || msg_type != NET_DHCPV4_MSG_TYPE_ACK ||
	    net_if_get_name(iface, name, sizeof(name)) < 0 ||
	    strcmp(name, CONFIG_NETSHELL_WAN_IFACE) != 0) {
		return;
	}

	memcpy(gw.s4_addr, wan_gw, sizeof(wan_gw));
	if (wan_router != NULL) {
		if (net_ipv4_addr_cmp(net_if_router_ipv4(wan_router), &gw)) {
			return;
		}
		(void)net_if_ipv4_router_rm(wan_router);
	}
	wan_router = net_if_ipv4_router_add(iface, &gw, true, 0);
	LOG_INF("default router %s on %s%s", net_addr_ntop(NET_AF_INET, &gw, str, sizeof(str)),
		name, wan_router == NULL ? " failed" : "");
}

struct net_in_addr netshell_wan_dns;

/* (Re)configure the bridge from netshell_lan: one address, the DHCP
 * server handing out this address as router and the DNS server
 */
int netshell_lan_apply(struct net_if *br)
{
	struct net_if_ipv4 *ipv4;
	char name[CONFIG_NET_INTERFACE_NAME_LEN + 1];
	char a[NET_IPV4_ADDR_LEN], m[NET_IPV4_ADDR_LEN], p[NET_IPV4_ADDR_LEN];
	int ret;

	(void)net_dhcpv4_server_stop(br);

	if (net_if_config_ipv4_get(br, &ipv4) == 0) {
		ARRAY_FOR_EACH(ipv4->unicast, i) {
			if (ipv4->unicast[i].ipv4.is_used &&
			    !net_ipv4_addr_cmp(&ipv4->unicast[i].ipv4.address.in_addr,
					       &netshell_lan.addr)) {
				(void)net_if_ipv4_addr_rm(
					br, &ipv4->unicast[i].ipv4.address.in_addr);
			}
		}
	}

	if (net_if_ipv4_addr_lookup_by_iface(br, &netshell_lan.addr) == NULL &&
	    net_if_ipv4_addr_add(br, &netshell_lan.addr, NET_ADDR_MANUAL, 0) == NULL) {
		return -ENOMEM;
	}
	net_if_ipv4_set_netmask_by_addr(br, &netshell_lan.addr, &netshell_lan.mask);
	/* Handed out as the router option */
	net_if_ipv4_set_gw(br, &netshell_lan.addr);

	net_dhcpv4_server_set_dns_address(net_ipv4_is_addr_unspecified(&netshell_lan.dns)
						  ? &netshell_wan_dns
						  : &netshell_lan.dns);

	ret = net_if_up(br);
	if (ret < 0 && ret != -EALREADY) {
		LOG_ERR("bridge up: %d (no lan port?)", ret);
		return ret;
	}

	ret = net_dhcpv4_server_start(br, &netshell_lan.pool);
	(void)net_if_get_name(br, name, sizeof(name));
	LOG_INF("%s: %s/%s, DHCP from %s: %d", name,
		net_addr_ntop(NET_AF_INET, &netshell_lan.addr, a, sizeof(a)),
		net_addr_ntop(NET_AF_INET, &netshell_lan.mask, m, sizeof(m)),
		net_addr_ntop(NET_AF_INET, &netshell_lan.pool, p, sizeof(p)), ret);

	return ret;
}
#endif /* CONFIG_NETSHELL_ROUTER */

/* Interfaces that carry IP: all but a DSA conduit and the DSA CPU port.
 * The conduit (eth0, the default interface) still keeps its MAC address:
 * the unique hostname is derived from it. As a router the lan ports join
 * the bridge instead.
 */
static void start_iface(struct net_if *iface, void *user_data)
{
	ARG_UNUSED(user_data);

	if (net_if_l2(iface) != &NET_L2_GET_NAME(ETHERNET)) {
		return;
	}
#if defined(CONFIG_NET_DSA)
	enum ethernet_hw_caps caps = net_eth_get_hw_capabilities(iface);

	if (caps & ETHERNET_DSA_CONDUIT_PORT) {
		stable_mac(iface);
		return;
	}
	if ((caps & ETHERNET_DSA_USER_PORT) == 0) {
		return;
	}
#endif
	stable_mac(iface);

#if defined(CONFIG_NETSHELL_ROUTER)
	char name[CONFIG_NET_INTERFACE_NAME_LEN + 1];

	if (net_if_get_name(iface, name, sizeof(name)) > 0 && lan_bridge != NULL &&
	    strncmp(name, CONFIG_NETSHELL_LAN_PREFIX, strlen(CONFIG_NETSHELL_LAN_PREFIX)) == 0) {
		int ret = eth_bridge_iface_add(lan_bridge, iface);

		LOG_INF("%s: bridged (%d)", name, ret);
		return;
	}
	if (strcmp(name, CONFIG_NETSHELL_WAN_IFACE) != 0) {
		LOG_WRN("%s: neither wan nor lan, using DHCP", name);
	}
#endif
	net_dhcpv4_start(iface);
}

static int run(const char *cmd)
{
	int ret = shell_execute_cmd(shell_backend_uart_get_ptr(), cmd);

	if (ret != 0) {
		LOG_WRN("\"%s\": %d", cmd, ret);
	}
	return ret;
}

/*
 * The settings partition is the sector where the stock U-Boot kept its
 * environment: anything but erased flash or NVS makes the mount fail.
 * Erase it once and try again.
 */
static int settings_init(void)
{
	const struct flash_area *fa;
	int ret = settings_subsys_init();

	if (ret == 0) {
		return 0;
	}
	if (ret == -EDOM || ret == -EINVAL || ret == -ENOENT) {
		/* configuration problem, erasing would not help */
		LOG_ERR("settings init failed (%d)", ret);
		return ret;
	}
	LOG_WRN("settings init failed (%d), erasing the settings partition", ret);

	ret = flash_area_open(SETTINGS_AREA, &fa);
	if (ret == 0) {
		ret = flash_area_erase(fa, 0, fa->fa_size);
		flash_area_close(fa);
	}
	if (ret != 0) {
		LOG_ERR("erase failed: %d", ret);
		return ret;
	}
	return settings_subsys_init();
}

static int host_key(void)
{
	char cmd[64];

	if (run("net ssh_key load 0 priv id_rsa") == 0) {
		LOG_INF("SSH host key loaded");
		return 0;
	}

	LOG_INF("generating a %d bit RSA host key, this takes a while",
		CONFIG_NETSHELL_HOST_KEY_BITS);
	snprintf(cmd, sizeof(cmd), "net ssh_key gen %d rsa %d", HOST_KEY_IDX,
		 CONFIG_NETSHELL_HOST_KEY_BITS);
	if (run(cmd) != 0) {
		return -EIO;
	}
	if (run("net ssh_key save 0 priv id_rsa") != 0) {
		/* Still usable for this boot, just a new fingerprint next time */
		LOG_WRN("host key not saved");
	}
	return 0;
}

/*
 * SSH banner: board and serial number (the SPI NOR factory unique ID, the
 * one MAC addresses and the PCIe DSN are derived from), then the MAC of the
 * default interface.
 */
static char banner[160];

static void banner_set(void)
{
	int n = snprintf(banner, sizeof(banner), "Board %s", CONFIG_BOARD_TARGET);
	struct net_if *iface = net_if_get_default();

#if DT_HAS_COMPAT_STATUS_OKAY(jedec_spi_nor) && defined(CONFIG_FLASH_EX_OP_ENABLED)
	const struct device *nor = DEVICE_DT_GET_ANY(jedec_spi_nor);
	uint8_t uid[SPI_NOR_UID_LEN];

	if (device_is_ready(nor) && flash_ex_op(nor, FLASH_EX_OP_SPI_NOR_READ_UID, 0, uid) == 0) {
		n += snprintf(banner + n, sizeof(banner) - n, ", serial ");
		for (int i = 0; i < SPI_NOR_UID_LEN && n < (int)sizeof(banner) - 3; i++) {
			n += snprintf(banner + n, sizeof(banner) - n, "%02x", uid[i]);
		}
	}
#endif
	if (iface != NULL && net_if_get_link_addr(iface)->len == NET_ETH_ADDR_LEN &&
	    n < (int)sizeof(banner)) {
		const uint8_t *m = net_if_get_link_addr(iface)->addr;

		(void)snprintf(banner + n, sizeof(banner) - n,
			       ", MAC %02x:%02x:%02x:%02x:%02x:%02x", m[0], m[1], m[2], m[3], m[4],
			       m[5]);
	}
	ssh_server_set_banner_text(banner);
	LOG_INF("%s", banner);
}

int main(void)
{
	char cmd[128];
	int n;

	/* Let the shell instance come up before using it */
	while (!shell_ready(shell_backend_uart_get_ptr())) {
		k_msleep(10);
	}

	if (settings_init() != 0) {
		LOG_ERR("settings unavailable, host key and MAC will not persist");
	}

#if defined(CONFIG_NETSHELL_ROUTER)
	net_dhcpv4_init_option_callback(&wan_dns_cb, wan_dns_handler, 6 /* DNS server */, wan_dns,
					sizeof(wan_dns));
	(void)net_dhcpv4_add_option_callback(&wan_dns_cb);
	net_dhcpv4_init_option_callback(&wan_gw_cb, wan_gw_handler, 3 /* router */, wan_gw,
					sizeof(wan_gw));
	(void)net_dhcpv4_add_option_callback(&wan_gw_cb);

	net_eth_bridge_foreach(find_bridge, &lan_bridge);
	if (lan_bridge != NULL) {
		bridge_mac(lan_bridge);
	}
#endif

	net_if_foreach(start_iface, NULL);

#if defined(CONFIG_NETSHELL_ROUTER)
	netshell_config_load_lan();
	if (lan_bridge == NULL || netshell_lan_apply(lan_bridge) < 0) {
		LOG_ERR("LAN not started");
	}
#endif
	netshell_config_apply();

	if (host_key() != 0) {
		LOG_ERR("no SSH host key");
		return 0;
	}

	banner_set();
	n = snprintf(cmd, sizeof(cmd), "net sshd start -i 0 -k %d", HOST_KEY_IDX);

#if defined(NETSHELL_HAVE_AUTHORIZED_KEY)
	if (ssh_keygen_import(AUTH_KEY_IDX, false, SSH_HOST_KEY_FORMAT_PEM, authorized_key,
			      sizeof(authorized_key)) == 0) {
		n += snprintf(cmd + n, sizeof(cmd) - n, " -a %d", AUTH_KEY_IDX);
	} else {
		LOG_ERR("authorized key not accepted (PEM/PKCS8 expected)");
	}
#endif
	if (CONFIG_NETSHELL_USERNAME[0] != '\0') {
		n += snprintf(cmd + n, sizeof(cmd) - n, " -u %s", CONFIG_NETSHELL_USERNAME);
	}
	if (CONFIG_NETSHELL_PASSWORD[0] != '\0') {
		n += snprintf(cmd + n, sizeof(cmd) - n, " -p %s", CONFIG_NETSHELL_PASSWORD);
	}

	if (run(cmd) == 0) {
		LOG_INF("SSH server listening on port %d", CONFIG_SSH_PORT);
	}

	return 0;
}
```

## src/config.c
```c
/*
 * Copyright (c) 2026 Jiri Kastner
 *
 * SPDX-License-Identifier: Apache-2.0
 *
 * Saved configuration, as on network gear: changes apply at once and
 * are kept only after "config save", so a rule that locks one out goes
 * away with a reboot.
 *
 *   config save | show | erase
 *   router lan <addr>/<len> | pool <addr> | dns <addr>|auto | show
 *
 * Kept in settings under netshell/cfg/: the router LAN, the TCAM rules
 * (one key per rule) and the Qav state of every interface with Qav.
 */

#include <stdio.h>
#include <stdlib.h>
#include <string.h>
#include <zephyr/kernel.h>
#include <zephyr/net/net_if.h>
#include <zephyr/net/ethernet.h>
#include <zephyr/net/ethernet_mgmt.h>
#include <zephyr/net/net_mgmt.h>
#include <zephyr/net/dhcpv4_server.h>
#include <zephyr/settings/settings.h>
#include <zephyr/shell/shell.h>
#include <zephyr/logging/log.h>

#include "config.h"

#if defined(CONFIG_PHY_MARVELL_MV88E6XXX_TCAM)
#include "phy_marvell_mv88e6xxx_tcam.h"

#define SW_NODE DT_COMPAT_GET_ANY_STATUS_OKAY(marvell_mv88e6085)
static const struct device *const sw = DEVICE_DT_GET(SW_NODE);
#endif

LOG_MODULE_REGISTER(netshell_cfg, LOG_LEVEL_INF);

#define KEY_LAN    "netshell/cfg/lan"
#define KEY_TCAM_N "netshell/cfg/tcam/n"
#define KEY_TCAM   "netshell/cfg/tcam/%d"
#define KEY_QAV    "netshell/cfg/qav/%s"

#define QAV_MAX_QUEUES 8

struct qav_saved {
	uint8_t queues;
	uint8_t enabled;
	uint32_t idle_slope[QAV_MAX_QUEUES];
};

struct netshell_lan netshell_lan;

struct read_ctx {
	void *buf;
	size_t len;
	bool found;
};

static int read_cb(const char *key, size_t len, settings_read_cb read_cb, void *cb_arg,
		   void *param)
{
	struct read_ctx *r = param;

	ARG_UNUSED(key);

	if (len == r->len && read_cb(cb_arg, r->buf, len) == len) {
		r->found = true;
	}
	return 0;
}

static bool load(const char *key, void *buf, size_t len)
{
	struct read_ctx r = {.buf = buf, .len = len};

	(void)settings_load_subtree_direct(key, read_cb, &r);
	return r.found;
}

void netshell_config_load_lan(void)
{
#if defined(CONFIG_NETSHELL_ROUTER)
	struct netshell_lan saved;

	(void)net_addr_pton(NET_AF_INET, CONFIG_NETSHELL_LAN_ADDR, &netshell_lan.addr);
	(void)net_addr_pton(NET_AF_INET, CONFIG_NETSHELL_LAN_NETMASK, &netshell_lan.mask);
	(void)net_addr_pton(NET_AF_INET, CONFIG_NETSHELL_DHCP_POOL, &netshell_lan.pool);
	netshell_lan.dns.s_addr = 0;

	if (load(KEY_LAN, &saved, sizeof(saved))) {
		netshell_lan = saved;
		LOG_INF("saved LAN configuration");
	}
#endif
}

/* Qav of one interface, through Ethernet management as "mvneta qav" */
static int qav_get(struct net_if *iface, struct qav_saved *q)
{
	struct ethernet_req_params p = {0};

	if (net_if_l2(iface) != &NET_L2_GET_NAME(ETHERNET) ||
	    (net_eth_get_hw_capabilities(iface) & ETHERNET_QAV) == 0 ||
	    net_mgmt(NET_REQUEST_ETHERNET_GET_PRIORITY_QUEUES_NUM, iface, &p, sizeof(p)) < 0) {
		return -ENOTSUP;
	}

	memset(q, 0, sizeof(*q));
	q->queues = MIN(p.priority_queues_num, QAV_MAX_QUEUES);
	for (int i = 0; i < q->queues; i++) {
		p.qav_param.queue_id = i;
		p.qav_param.type = ETHERNET_QAV_PARAM_TYPE_STATUS;
		if (net_mgmt(NET_REQUEST_ETHERNET_GET_QAV_PARAM, iface, &p, sizeof(p)) == 0 &&
		    p.qav_param.enabled) {
			q->enabled |= BIT(i);
		}
		p.qav_param.type = ETHERNET_QAV_PARAM_TYPE_IDLE_SLOPE;
		if (net_mgmt(NET_REQUEST_ETHERNET_GET_QAV_PARAM, iface, &p, sizeof(p)) == 0) {
			q->idle_slope[i] = p.qav_param.idle_slope;
		}
	}

	return 0;
}

static void qav_set(struct net_if *iface, const struct qav_saved *q)
{
	struct ethernet_req_params p = {0};

	for (int i = 0; i < q->queues; i++) {
		p.qav_param.queue_id = i;
		if (q->idle_slope[i] != 0) {
			p.qav_param.type = ETHERNET_QAV_PARAM_TYPE_IDLE_SLOPE;
			p.qav_param.idle_slope = q->idle_slope[i];
			(void)net_mgmt(NET_REQUEST_ETHERNET_SET_QAV_PARAM, iface, &p, sizeof(p));
		}
		p.qav_param.type = ETHERNET_QAV_PARAM_TYPE_STATUS;
		p.qav_param.enabled = (q->enabled & BIT(i)) != 0;
		(void)net_mgmt(NET_REQUEST_ETHERNET_SET_QAV_PARAM, iface, &p, sizeof(p));
	}
}

static void qav_apply_cb(struct net_if *iface, void *user_data)
{
	char name[CONFIG_NET_INTERFACE_NAME_LEN + 1];
	char key[sizeof(KEY_QAV) + CONFIG_NET_INTERFACE_NAME_LEN];
	struct qav_saved q;

	ARG_UNUSED(user_data);

	if (net_if_get_name(iface, name, sizeof(name)) <= 0) {
		return;
	}
	snprintf(key, sizeof(key), KEY_QAV, name);
	if (load(key, &q, sizeof(q)) && q.queues <= QAV_MAX_QUEUES) {
		qav_set(iface, &q);
		LOG_INF("%s: saved Qav (queues 0x%02x)", name, q.enabled);
	}
}

void netshell_config_apply(void)
{
#if defined(CONFIG_PHY_MARVELL_MV88E6XXX_TCAM)
	struct mv88e6xxx_tcam_rule r;
	char key[sizeof(KEY_TCAM) + 12];
	int n = 0, added = 0;

	if (device_is_ready(sw) && load(KEY_TCAM_N, &n, sizeof(n))) {
		for (int i = 0; i < n; i++) {
			snprintf(key, sizeof(key), KEY_TCAM, i);
			if (load(key, &r, sizeof(r)) && mv88e6xxx_tcam_add(sw, &r) == 0) {
				added++;
			}
		}
		LOG_INF("%d of %d saved TCAM rules", added, n);
	}
#endif
	net_if_foreach(qav_apply_cb, NULL);
}

/* "config save" */
struct save_ctx {
	const struct shell *sh;
	int n;
	int ret;
};

#if defined(CONFIG_PHY_MARVELL_MV88E6XXX_TCAM)
static void tcam_save_cb(const struct mv88e6xxx_tcam_rule *rule, int hw_idx, void *user_data)
{
	struct save_ctx *c = user_data;
	char key[sizeof(KEY_TCAM) + 12];

	ARG_UNUSED(hw_idx);

	snprintf(key, sizeof(key), KEY_TCAM, c->n);
	if (settings_save_one(key, rule, sizeof(*rule)) < 0) {
		c->ret = -EIO;
	}
	c->n++;
}
#endif

static void qav_save_cb(struct net_if *iface, void *user_data)
{
	struct save_ctx *c = user_data;
	char name[CONFIG_NET_INTERFACE_NAME_LEN + 1];
	char key[sizeof(KEY_QAV) + CONFIG_NET_INTERFACE_NAME_LEN];
	struct qav_saved q;
	bool any = false;

	if (net_if_get_name(iface, name, sizeof(name)) <= 0 || qav_get(iface, &q) < 0) {
		return;
	}
	for (int i = 0; i < q.queues; i++) {
		any |= q.idle_slope[i] != 0 || (q.enabled & BIT(i));
	}
	snprintf(key, sizeof(key), KEY_QAV, name);
	if (!any) {
		(void)settings_delete(key);
		return;
	}
	if (settings_save_one(key, &q, sizeof(q)) < 0) {
		c->ret = -EIO;
	}
	c->n++;
}

static void tcam_erase(int from)
{
	char key[sizeof(KEY_TCAM) + 12];
	int old = 0;

	(void)load(KEY_TCAM_N, &old, sizeof(old));
	for (int i = from; i < old; i++) {
		snprintf(key, sizeof(key), KEY_TCAM, i);
		(void)settings_delete(key);
	}
}

static int cmd_save(const struct shell *sh, size_t argc, char **argv)
{
	struct save_ctx c = {.sh = sh};

#if defined(CONFIG_NETSHELL_ROUTER)
	if (settings_save_one(KEY_LAN, &netshell_lan, sizeof(netshell_lan)) < 0) {
		c.ret = -EIO;
	}
#endif
#if defined(CONFIG_PHY_MARVELL_MV88E6XXX_TCAM)
	mv88e6xxx_tcam_foreach(sw, tcam_save_cb, &c);
	tcam_erase(c.n);
	if (settings_save_one(KEY_TCAM_N, &c.n, sizeof(c.n)) < 0) {
		c.ret = -EIO;
	}
	shell_print(sh, "TCAM rules: %d", c.n);
#endif
	c.n = 0;
	net_if_foreach(qav_save_cb, &c);
	shell_print(sh, "interfaces with Qav: %d", c.n);

	if (c.ret < 0) {
		shell_error(sh, "saving failed");
	}
	return c.ret;
}

static void qav_erase_cb(struct net_if *iface, void *user_data)
{
	char name[CONFIG_NET_INTERFACE_NAME_LEN + 1];
	char key[sizeof(KEY_QAV) + CONFIG_NET_INTERFACE_NAME_LEN];

	ARG_UNUSED(user_data);

	if (net_if_get_name(iface, name, sizeof(name)) > 0) {
		snprintf(key, sizeof(key), KEY_QAV, name);
		(void)settings_delete(key);
	}
}

static int cmd_erase(const struct shell *sh, size_t argc, char **argv)
{
	int zero = 0;

	(void)settings_delete(KEY_LAN);
	tcam_erase(0);
	(void)settings_save_one(KEY_TCAM_N, &zero, sizeof(zero));
	net_if_foreach(qav_erase_cb, NULL);
	shell_print(sh, "saved configuration erased, defaults after a reboot");

	return 0;
}

static int cmd_mac_uid(const struct shell *sh, size_t argc, char **argv)
{
	ARG_UNUSED(argc);
	ARG_UNUSED(argv);

	(void)netshell_mac_forget();
	shell_print(sh, "saved MAC addresses dropped, the next boot derives them from the "
			"SPI NOR unique ID (new addresses: new DHCP leases and .local name)");
	return 0;
}

static int cmd_show(const struct shell *sh, size_t argc, char **argv)
{
#if defined(CONFIG_NETSHELL_ROUTER)
	struct netshell_lan l;
	char a[NET_IPV4_ADDR_LEN], m[NET_IPV4_ADDR_LEN], p[NET_IPV4_ADDR_LEN], d[NET_IPV4_ADDR_LEN];

	if (load(KEY_LAN, &l, sizeof(l))) {
		shell_print(sh, "lan %s/%s pool %s dns %s",
			    net_addr_ntop(NET_AF_INET, &l.addr, a, sizeof(a)),
			    net_addr_ntop(NET_AF_INET, &l.mask, m, sizeof(m)),
			    net_addr_ntop(NET_AF_INET, &l.pool, p, sizeof(p)),
			    net_ipv4_is_addr_unspecified(&l.dns)
				    ? "auto"
				    : net_addr_ntop(NET_AF_INET, &l.dns, d, sizeof(d)));
	} else {
		shell_print(sh, "lan: defaults");
	}
#endif
#if defined(CONFIG_PHY_MARVELL_MV88E6XXX_TCAM)
	int n = 0;

	(void)load(KEY_TCAM_N, &n, sizeof(n));
	shell_print(sh, "TCAM rules: %d", n);
#endif
	return 0;
}

#if defined(CONFIG_NETSHELL_ROUTER)
static int parse_ip(const struct shell *sh, const char *arg, struct net_in_addr *addr)
{
	if (net_addr_pton(NET_AF_INET, arg, addr) < 0) {
		shell_error(sh, "bad address %s", arg);
		return -EINVAL;
	}
	return 0;
}

static int lan_reapply(const struct shell *sh)
{
	struct net_if *br = netshell_bridge();
	int ret;

	if (br == NULL) {
		shell_error(sh, "no LAN bridge");
		return -ENODEV;
	}
	ret = netshell_lan_apply(br);
	if (ret < 0) {
		shell_error(sh, "LAN: %d (pool outside the subnet or over the address?)", ret);
	}
	return ret;
}

static int cmd_router_lan(const struct shell *sh, size_t argc, char **argv)
{
	char buf[NET_IPV4_ADDR_LEN + 4];
	char *slash;
	struct net_in_addr addr;
	int len;

	strncpy(buf, argv[1], sizeof(buf) - 1);
	buf[sizeof(buf) - 1] = '\0';
	slash = strchr(buf, '/');
	len = slash != NULL ? atoi(slash + 1) : 24;
	if (slash != NULL) {
		*slash = '\0';
	}
	if (len < 8 || len > 30 || parse_ip(sh, buf, &addr) < 0) {
		shell_error(sh, "use <addr>/<8..30>");
		return -EINVAL;
	}

	netshell_lan.addr = addr;
	netshell_lan.mask.s_addr = net_htonl(GENMASK(31, 32 - len));
	/* Pool .100 of the new subnet unless it is still inside */
	if ((netshell_lan.pool.s_addr & netshell_lan.mask.s_addr) !=
	    (addr.s_addr & netshell_lan.mask.s_addr)) {
		netshell_lan.pool.s_addr = (addr.s_addr & netshell_lan.mask.s_addr) |
					   (net_htonl(100) & ~netshell_lan.mask.s_addr);
	}

	return lan_reapply(sh);
}

static int cmd_router_pool(const struct shell *sh, size_t argc, char **argv)
{
	if (parse_ip(sh, argv[1], &netshell_lan.pool) < 0) {
		return -EINVAL;
	}
	return lan_reapply(sh);
}

static int cmd_router_dns(const struct shell *sh, size_t argc, char **argv)
{
	if (strcmp(argv[1], "auto") == 0) {
		netshell_lan.dns.s_addr = 0;
	} else if (parse_ip(sh, argv[1], &netshell_lan.dns) < 0) {
		return -EINVAL;
	}
	net_dhcpv4_server_set_dns_address(net_ipv4_is_addr_unspecified(&netshell_lan.dns)
						  ? &netshell_wan_dns
						  : &netshell_lan.dns);
	return 0;
}

static int cmd_router_show(const struct shell *sh, size_t argc, char **argv)
{
	char a[NET_IPV4_ADDR_LEN], m[NET_IPV4_ADDR_LEN], p[NET_IPV4_ADDR_LEN], d[NET_IPV4_ADDR_LEN];

	shell_print(sh, "lan %s/%s pool %s (%d addresses) dns %s%s",
		    net_addr_ntop(NET_AF_INET, &netshell_lan.addr, a, sizeof(a)),
		    net_addr_ntop(NET_AF_INET, &netshell_lan.mask, m, sizeof(m)),
		    net_addr_ntop(NET_AF_INET, &netshell_lan.pool, p, sizeof(p)),
		    CONFIG_NET_DHCPV4_SERVER_ADDR_COUNT,
		    net_ipv4_is_addr_unspecified(&netshell_lan.dns)
			    ? net_addr_ntop(NET_AF_INET, &netshell_wan_dns, d, sizeof(d))
			    : net_addr_ntop(NET_AF_INET, &netshell_lan.dns, d, sizeof(d)),
		    net_ipv4_is_addr_unspecified(&netshell_lan.dns) ? " (from wan)" : "");
	return 0;
}

/* clang-format off */
SHELL_STATIC_SUBCMD_SET_CREATE(router_cmds,
	SHELL_CMD_ARG(lan, NULL, "<addr>/<len>: LAN address of the bridge", cmd_router_lan, 2, 0),
	SHELL_CMD_ARG(pool, NULL, "<addr>: first DHCP address", cmd_router_pool, 2, 0),
	SHELL_CMD_ARG(dns, NULL, "<addr>|auto: DNS server for the LAN", cmd_router_dns, 2, 0),
	SHELL_CMD_ARG(show, NULL, "current LAN settings", cmd_router_show, 1, 0),
	SHELL_SUBCMD_SET_END);
/* clang-format on */

SHELL_CMD_REGISTER(router, &router_cmds, "Router LAN (keep with \"config save\")", NULL);
#endif /* CONFIG_NETSHELL_ROUTER */

/* clang-format off */
SHELL_STATIC_SUBCMD_SET_CREATE(config_cmds,
	SHELL_CMD_ARG(save, NULL, "keep LAN, TCAM rules and Qav over reboots", cmd_save, 1, 0),
	SHELL_CMD_ARG(show, NULL, "what is saved", cmd_show, 1, 0),
	SHELL_CMD_ARG(erase, NULL, "back to the defaults on the next boot", cmd_erase, 1, 0),
	SHELL_CMD_ARG(mac-uid, NULL, "MAC addresses from the SPI NOR unique ID from the next boot",
		      cmd_mac_uid, 1, 0),
	SHELL_SUBCMD_SET_END);
/* clang-format on */

SHELL_CMD_REGISTER(config, &config_cmds, "Saved configuration", NULL);
```

## src/config.h
```c
/*
 * Copyright (c) 2026 Jiri Kastner
 *
 * SPDX-License-Identifier: Apache-2.0
 */

#ifndef NETSHELL_CONFIG_H_
#define NETSHELL_CONFIG_H_

#include <zephyr/net/net_if.h>

/* LAN of the router; dns unspecified: the DNS server of the wan lease */
struct netshell_lan {
	struct net_in_addr addr;
	struct net_in_addr mask;
	struct net_in_addr pool;
	struct net_in_addr dns;
};

extern struct netshell_lan netshell_lan;

/* DNS server of the last wan lease */
extern struct net_in_addr netshell_wan_dns;

/* Saved configuration ("config save"): LAN, TCAM rules and Qav. The LAN
 * part is read before the LAN starts, the rest applied once the
 * interfaces exist.
 */
void netshell_config_load_lan(void);
void netshell_config_apply(void);

/* Bring the bridge to netshell_lan (address, DHCP server, DNS) */
int netshell_lan_apply(struct net_if *br);

/* The LAN bridge, NULL without one */
struct net_if *netshell_bridge(void);

/* Forget the saved MAC addresses (next boot: from the SPI NOR UID) */
int netshell_mac_forget(void);

#endif /* NETSHELL_CONFIG_H_ */
```

## src/dbg_exports.c
```c
/*
 * Copyright (c) 2026 Jiri Kastner
 * SPDX-License-Identifier: Apache-2.0
 *
 * Firmware functions the ESPRESSObin debug modules (dbg/, the Aardvark
 * irqtest and xortest) call. A change here is a firmware change: bump
 * CONFIG_LAB_IMAGE.
 */

#include <zephyr/drivers/pcie/aardvark.h>
#include <zephyr/lab/lab.h>
#include <zephyr/llext/symbol.h>

#if defined(CONFIG_GIC)
#include <zephyr/drivers/interrupt_controller/gic.h>
#endif

#include <soc.h>

#include "pcie_epc_aardvark_a3700_xor.h"

EXPORT_SYMBOL(a3700_probe_read32);
EXPORT_SYMBOL(advk_mode_get);

EXPORT_SYMBOL(a3700_xor_memcpy);
EXPORT_SYMBOL(a3700_xor_memcpy_sg);
EXPORT_SYMBOL(a3700_xor_xor);
EXPORT_SYMBOL(a3700_xor_get_stats);
EXPORT_SYMBOL(a3700_xor_pcie_window);

EXPORT_SYMBOL(lab_local_exec);
EXPORT_SYMBOL(lab_peer_exec);
EXPORT_SYMBOL(lab_now_ns);
EXPORT_SYMBOL(lab_peer_offset_ns);

#if defined(CONFIG_GIC)
EXPORT_SYMBOL(arm_gic_irq_set_pending);
EXPORT_SYMBOL(arm_gic_irq_is_pending);
EXPORT_SYMBOL(arm_gic_irq_clear_pending);
#endif
```

## src/lab_selftest.c
```c
/*
 * Copyright (c) 2026 Jiri Kastner
 * SPDX-License-Identifier: Apache-2.0
 *
 * "lab selftest": run the built-in test extension (subsys/lab/ext/lab_hello.c,
 * embedded at build time) through the same loader as lab ext.
 */

#include <stdlib.h>

#include <zephyr/lab/lab.h>
#include <zephyr/shell/shell.h>

static const uint8_t lab_hello_llext[] __aligned(8) = {
#include "lab_hello.inc"
};

static int cmd_selftest(const struct shell *sh, size_t argc, char **argv)
{
	int runs = argc > 1 ? atoi(argv[1]) : 1;
	char *xargv[] = {"lab_hello", NULL};

	for (int i = 0; i < runs; i++) {
		int ret = lab_ext_run(sh, "lab_hello", lab_hello_llext, sizeof(lab_hello_llext), NULL,
				      1, xargv, false);

		if (ret != 0) {
			shell_error(sh, "selftest run %d: FAIL %d", i, ret);
			return ret;
		}
	}
	shell_print(sh, "selftest: PASS (%d run%s, %zu byte extension)", runs, runs > 1 ? "s" : "",
		    sizeof(lab_hello_llext));
	return 0;
}

SHELL_SUBCMD_ADD((lab), selftest, NULL, "selftest [runs]: load/run/unload the built-in LLEXT",
		 cmd_selftest, 1, 1);
```

## src/top.c
```c
/*
 * Copyright (c) 2026 Jiri Kastner
 *
 * SPDX-License-Identifier: Apache-2.0
 *
 * "top": CPU use per thread and per CPU over an interval, from the
 * scheduler's runtime statistics (THREAD_RUNTIME_STATS).
 */

#include <stdlib.h>
#include <string.h>

#include <zephyr/kernel.h>
#include <zephyr/shell/shell.h>

#define TOP_MAX_THREADS 48

struct top_entry {
	k_tid_t tid;
	char name[CONFIG_THREAD_MAX_NAME_LEN];
	uint64_t cycles;
	uint64_t delta;
	int prio;
};

struct top_snap {
	struct top_entry t[TOP_MAX_THREADS];
	int n;
};

static struct top_snap snap[2];

static void collect_cb(const struct k_thread *thread, void *user_data)
{
	struct top_snap *s = user_data;
	k_thread_runtime_stats_t st;
	struct top_entry *e;
	const char *name;

	if (s->n >= TOP_MAX_THREADS) {
		return;
	}
	e = &s->t[s->n++];
	e->tid = (k_tid_t)thread;
	e->prio = k_thread_priority_get(e->tid);
	name = k_thread_name_get(e->tid);
	strncpy(e->name, name != NULL ? name : "?", sizeof(e->name) - 1);
	e->name[sizeof(e->name) - 1] = '\0';
	e->cycles = (k_thread_runtime_stats_get(e->tid, &st) == 0) ? st.execution_cycles : 0;
}

static void collect(struct top_snap *s)
{
	s->n = 0;
	k_thread_foreach_unlocked(collect_cb, s);
}

static int cmp_delta(const void *a, const void *b)
{
	const struct top_entry *x = a, *y = b;

	return (x->delta < y->delta) - (x->delta > y->delta);
}

/* xx.x % */
static void pct(char *buf, size_t len, uint64_t part, uint64_t whole)
{
	uint32_t p = whole != 0 ? (uint32_t)((part * 1000U) / whole) : 0;

	snprintk(buf, len, "%3u.%u", p / 10, p % 10);
}

static int cmd_top(const struct shell *sh, size_t argc, char **argv)
{
	uint32_t interval = argc > 1 ? strtoul(argv[1], NULL, 0) : 1000;
	uint32_t count = argc > 2 ? strtoul(argv[2], NULL, 0) : 1;
	k_thread_runtime_stats_t c0[CONFIG_MP_MAX_NUM_CPUS], c1;
	char b[16];

	interval = CLAMP(interval, 100, 60000);

	for (uint32_t it = 0; it < MAX(count, 1); it++) {
		uint64_t all = 0;

		for (int cpu = 0; cpu < arch_num_cpus(); cpu++) {
			(void)k_thread_runtime_stats_cpu_get(cpu, &c0[cpu]);
		}
		collect(&snap[0]);
		k_msleep(interval);
		collect(&snap[1]);

		shell_print(sh, "--- %u ms ---", interval);
		for (int cpu = 0; cpu < arch_num_cpus(); cpu++) {
			uint64_t tot, idle;

			(void)k_thread_runtime_stats_cpu_get(cpu, &c1);
			tot = c1.execution_cycles - c0[cpu].execution_cycles;
			idle = c1.idle_cycles - c0[cpu].idle_cycles;
			all += tot;
			pct(b, sizeof(b), tot - MIN(idle, tot), tot);
			shell_print(sh, "CPU%d busy %s %%", cpu, b);
		}

		for (int i = 0; i < snap[1].n; i++) {
			struct top_entry *e = &snap[1].t[i];

			e->delta = e->cycles;
			for (int j = 0; j < snap[0].n; j++) {
				if (snap[0].t[j].tid == e->tid) {
					e->delta = e->cycles - MIN(snap[0].t[j].cycles, e->cycles);
					break;
				}
			}
		}
		qsort(snap[1].t, snap[1].n, sizeof(snap[1].t[0]), cmp_delta);

		shell_print(sh, "  %%CPU  prio  thread");
		for (int i = 0; i < snap[1].n; i++) {
			struct top_entry *e = &snap[1].t[i];

			pct(b, sizeof(b), e->delta, all);
			shell_print(sh, "%s %5d  %s", b, e->prio, e->name);
		}
	}
	return 0;
}

SHELL_CMD_ARG_REGISTER(top, NULL, "[interval ms] [count] CPU use per thread", cmd_top, 1, 2);
```
