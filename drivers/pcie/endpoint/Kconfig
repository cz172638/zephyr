## drivers/ptp_clock/Kconfig.mv88e6xxx
```kconfig
# Copyright (c) 2026 Jiri Kastner
# SPDX-License-Identifier: Apache-2.0

config PTP_CLOCK_MV88E6XXX
	bool "Marvell 88E6xxx switch PTP clock"
	default y
	depends on DT_HAS_MARVELL_MV88E6XXX_PTP_ENABLED
	depends on PHY_MARVELL_MV88E6XXX
	select NET_L2_PTP_TIMESTAMPING
	help
	  PTP clock of a Marvell 88E6xxx switch: a software time counter on
	  top of the free running 32 bit TAI counter, as in Linux. Port
	  time stamps are read by the DSA driver.
```

## drivers/reset/Kconfig.rockchip
```kconfig
# SPDX-FileCopyrightText: Copyright (c) 2026 KylinSoft Corporation
# SPDX-License-Identifier: Apache-2.0

config RESET_ROCKCHIP_RK3588
	bool "Rockchip RK3588 CRU reset controller"
	default y
	depends on DT_HAS_ROCKCHIP_RK3588_CRU_RST_ENABLED
	help
	  Enable reset control for the Rockchip RK3588 CRU.

config RESET_ROCKCHIP_RK3399
	bool "Rockchip RK3399 CRU reset controller"
	default y
	depends on DT_HAS_ROCKCHIP_RK3399_CRU_RST_ENABLED
	help
	  Enable soft reset control for the Rockchip RK3399 CRU and PMUCRU.
```

## drivers/sdhc/Kconfig.dw_mshc
```kconfig
# Copyright (c) 2026 Jiri Kastner
# SPDX-License-Identifier: Apache-2.0

config SDHC_DW_MSHC
	bool "DesignWare MSHC (dw_mmc), Rockchip RK3399"
	default y
	depends on DT_HAS_ROCKCHIP_RK3399_DW_MSHC_ENABLED
	select SDHC_SUPPORTS_NATIVE_MODE
	select PINCTRL
	depends on CLOCK_CONTROL
	help
	  Synopsys DesignWare Mobile Storage Host in the RK3399 SDMMC slot:
	  polled FIFO PIO, 3.3 V, up to high speed (50 MHz), 1/4-bit.
```

## drivers/sdhc/Kconfig.rk3399_emmc
```kconfig
# Copyright (c) 2026 Jiri Kastner
# SPDX-License-Identifier: Apache-2.0

config SDHC_RK3399_EMMC
	bool "RK3399 eMMC (Arasan SDHCI 5.1 + GRF PHY)"
	default y
	depends on DT_HAS_ROCKCHIP_RK3399_SDHCI_5_1_ENABLED
	depends on CLOCK_CONTROL && SYSCON
	select SDHC_SUPPORTS_NATIVE_MODE
	help
	  RK3399 eMMC controller: polled PIO, 1/4/8-bit, legacy and high
	  speed SDR up to 52 MHz.
```

## drivers/sdhc/Kconfig.xenon
```kconfig
# Copyright (c) 2026 Jiri Kastner
# SPDX-License-Identifier: Apache-2.0

config SDHC_XENON
	bool "Marvell Xenon SDHC (Armada 3700)"
	default y
	depends on DT_HAS_MARVELL_ARMADA_3700_SDHCI_ENABLED
	select SDHC_SUPPORTS_NATIVE_MODE
	select SDHC_SUPPORTS_UHS
	help
	  Polled driver for the Xenon SD host controller of the Armada 3700
	  (microSD and eMMC slots), ADMA2 or PIO.

config SDHC_XENON_ADMA
	bool "ADMA2 data transfers"
	default y
	depends on SDHC_XENON
	help
	  Block data by 32-bit ADMA2 instead of the CPU copying through the
	  buffer port. Buffers must be cache line aligned (the SD stack
	  bounces unaligned ones through its card buffer); short transfers
	  (SCR, status) stay PIO.

config SDHC_XENON_ADMA_DESC
	int "ADMA2 descriptors"
	default 32
	depends on SDHC_XENON_ADMA
	help
	  32 KiB per descriptor; larger requests fall back to PIO.

if SDHC_XENON_ADMA
# DMA buffers by whole cache lines
configdefault SDHC_BUFFER_ALIGNMENT
	default DCACHE_LINE_SIZE if DCACHE
endif
```

## drivers/serial/Kconfig.mvebu_a3700
```kconfig
# Copyright (c) 2026 Jiri Kastner
# SPDX-License-Identifier: Apache-2.0

config UART_MVEBU_A3700
	bool "Marvell Armada 3700 UART"
	default y
	depends on DT_HAS_MARVELL_ARMADA_3700_UART_ENABLED
	select SERIAL_HAS_DRIVER
	select SERIAL_SUPPORT_INTERRUPT
	help
	  Standard UART (UART0) of the Marvell Armada 37xx SoCs.
```

## drivers/serial/Kconfig.uart_ipc
```kconfig
# Copyright (c) 2026 Jiri Kastner
# SPDX-License-Identifier: Apache-2.0

config UART_IPC
	bool "UART over an IPC service endpoint"
	default y
	depends on DT_HAS_ZEPHYR_UART_IPC_ENABLED
	depends on IPC_SERVICE
	select SERIAL_HAS_DRIVER
	select SERIAL_SUPPORT_INTERRUPT
	help
	  A UART whose bytes travel over an IPC service endpoint to another
	  core. Output before the endpoint binds is kept in the TX buffer.

if UART_IPC

config UART_IPC_TX_BUF_SIZE
	int "TX buffer"
	default 4096
	help
	  Holds the output until the remote binds (boot messages) and while
	  the shared ring is full.

config UART_IPC_RX_BUF_SIZE
	int "RX buffer"
	default 256

config UART_IPC_CHUNK
	int "Largest message"
	default 128

config UART_IPC_INIT_PRIORITY
	int "Endpoint registration priority (POST_KERNEL)"
	default 48
	help
	  After the IPC backends (IPC_SERVICE_REG_BACKEND_PRIORITY).

endif
```

## drivers/spi/Kconfig.mvebu_a3700
```kconfig
# Copyright (c) 2026 Jiri Kastner
# SPDX-License-Identifier: Apache-2.0

config SPI_MVEBU_A3700
	bool "Marvell Armada 3700 SPI controller"
	default y
	depends on DT_HAS_MARVELL_ARMADA_3700_SPI_ENABLED
	select PINCTRL
	help
	  Polled, byte-at-a-time (legacy mode) driver for the SPI controller
	  of the Armada 3700, used for the boot SPI NOR flash.
```

## drivers/spi/Kconfig.rockchip
```kconfig
# Copyright (c) 2026 Jiri Kastner
# SPDX-License-Identifier: Apache-2.0

config SPI_ROCKCHIP
	bool "Rockchip SPI controller"
	default y
	depends on DT_HAS_ROCKCHIP_RK3066_SPI_ENABLED
	select PINCTRL
	depends on CLOCK_CONTROL
	help
	  Rockchip SPI (RK3066 and later), master, 8-bit frames, polled.
```

## dts/bindings/ata/marvell,armada-3700-ahci.yaml
```yaml
# Copyright (c) 2026 Jiri Kastner
# SPDX-License-Identifier: Apache-2.0

description: |
  Marvell Armada 3700 SATA 3.0 AHCI host controller (one port).

  The SATA PHY is COMPHY lane 2, powered on through the TF-A SiP service
  (MV_SIP_COMPHY_POWER_ON). Its registers are reached indirectly through
  the controller window at +0x178/+0x17c, so reg covers 0x180 bytes.

compatible: "marvell,armada-3700-ahci"

include: base.yaml

properties:
  reg:
    required: true

  interrupts:
    required: true

  clocks:
    required: true

  disk-name:
    type: string
    default: "sata0"
    description: Name under which the disk is registered (fs mount "/<name>:").

  marvell,comphy-lane:
    type: int
    default: 2

  marvell,comphy-polarity-invert:
    type: int
    default: 0
    enum: [0, 1, 2, 3]
    description: Bit 0 TX, bit 1 RX polarity inversion.
```

## dts/bindings/clock/marvell,armada-3700-periph-clock-nb.yaml
```yaml
# Copyright (c) 2026 Jiri Kastner
# SPDX-License-Identifier: Apache-2.0

description: |
  Marvell Armada 37xx north bridge peripheral clocks (gates only).
  The cell is the index of the clock in the Linux armada-37xx-periph table.

compatible: "marvell,armada-3700-periph-clock-nb"

include: [clock-controller.yaml, base.yaml]

properties:
  reg:
    required: true

  "#clock-cells":
    const: 1

clock-cells:
  - index
```

## dts/bindings/clock/marvell,armada-3700-tbg-clock.yaml
```yaml
# Copyright (c) 2026 Jiri Kastner
# SPDX-License-Identifier: Apache-2.0

description: |
  Marvell Armada 37xx time base generator: four PLL outputs from the
  crystal, read-only. Cells: 0 TBG-A-P, 1 TBG-B-P, 2 TBG-A-S, 3 TBG-B-S.

compatible: "marvell,armada-3700-tbg-clock"

include: [clock-controller.yaml, base.yaml]

properties:
  reg:
    required: true

  clocks:
    required: true
    description: The crystal, a fixed-clock node.

  "#clock-cells":
    const: 1

clock-cells:
  - index
```

## dts/bindings/clock/rockchip,rk3399-cru-clk.yaml
```yaml
# Copyright The Zephyr Project Contributors
# SPDX-License-Identifier: Apache-2.0

title: Rockchip RK3399 CRU clock gate controller

description: |
  Clock gate controller of an RK3399 CRU or PMUCRU. Clock specifiers are
  (CLKGATE_CON index * 16) + bit, see
  include/zephyr/dt-bindings/clock/rk3399-cru.h.

compatible: "rockchip,rk3399-cru-clk"

include: [clock-controller.yaml, base.yaml]

properties:
  "#clock-cells":
    const: 1

  rockchip,gate-offset:
    type: int
    required: true
    description: Offset of CLKGATE_CON0 in the parent block (CRU 0x300, PMUCRU 0x100).

clock-cells:
  - clkid
```

## dts/bindings/clock/rockchip,rk3399-cru.yaml
```yaml
# Copyright The Zephyr Project Contributors
# SPDX-License-Identifier: Apache-2.0

title: Rockchip RK3399 CRU / PMUCRU

description: |
  Rockchip RK3399 Clock and Reset Unit register block (CRU at 0xff760000 or
  PMUCRU at 0xff750000). Child nodes provide the clock gate and soft reset
  controller interfaces.

compatible: "rockchip,rk3399-cru"

include: base.yaml

properties:
  reg:
    required: true

child-binding:
  description: |
    Clock or reset controller node sharing the parent register block.
```

## dts/bindings/dsa/marvell,mv88e6xxx-dsa.yaml
```yaml
# Copyright (c) 2026 Jiri Kastner
# SPDX-License-Identifier: Apache-2.0

description: |
  DSA ports of a Marvell 88E6xxx switch. The switch itself is the
  marvell,mv88e6085 node on the SMI bus, referenced by marvell,switch;
  it remains the PHY of the conduit MAC.

  One child per switch port (reg = port number). The CPU port has the
  "ethernet" phandle of the conduit and the tag protocol
  (DSA_TAG_PROTO_DSA or DSA_TAG_PROTO_EDSA, set CONFIG_DSA_TAG_SIZE to 4
  or 8 to match). User ports have a phy-handle, normally an
  "ethernet-phy" on the switch's internal MDIO bus.

    dsa {
        compatible = "marvell,mv88e6xxx-dsa";
        marvell,switch = <&switch0>;
        #address-cells = <1>;
        #size-cells = <0>;

        port@0 {
            compatible = "zephyr,dsa-port";
            reg = <0>;
            ethernet = <&eth0>;
            dsa-tag-protocol = <DSA_TAG_PROTO_DSA>;
        };
        port@1 {
            compatible = "zephyr,dsa-port";
            reg = <1>;
            phy-handle = <&switch0phy1>;
            zephyr,random-mac-address;
        };
    };

compatible: "marvell,mv88e6xxx-dsa"

include: [dsa.yaml, base.yaml]

properties:
  marvell,switch:
    type: phandle
    required: true
    description: The marvell,mv88e6085 switch node.
```

## dts/bindings/ethernet/marvell,armada-3700-neta.yaml
```yaml
# Copyright (c) 2026 Jiri Kastner
# SPDX-License-Identifier: Apache-2.0

description: |
  Marvell NETA gigabit Ethernet controller, Armada 3700 variant.

  Only RGMII is supported (SGMII on eth1 needs the COMPHY). The link is
  taken from the PHY given by phy-handle; for a fixed link (a switch CPU
  port) point it to an "ethernet-phy-fixed-link" node or to the switch.

compatible: "marvell,armada-3700-neta"

include: [ethernet-controller.yaml, pinctrl-device.yaml]

properties:
  reg:
    required: true

  interrupts:
    required: true

  clocks:
    required: true

  phy-handle:
    required: true

  phy-connection-type:
    default: "rgmii"
```

## dts/bindings/ethernet/marvell,mv88e6xxx-ptp.yaml
```yaml
# Copyright (c) 2026 Jiri Kastner
# SPDX-License-Identifier: Apache-2.0

description: |
  PTP clock (TAI) of a Marvell 88E6xxx switch. Must be a child of the
  marvell,mv88e6085 switch node; DSA ports refer to it with ptp-clock.

compatible: "marvell,mv88e6xxx-ptp"

include: base.yaml
```

## dts/bindings/ethernet/mdio/marvell,mv88e6xxx-mdio.yaml
```yaml
# Copyright (c) 2026 Jiri Kastner
# SPDX-License-Identifier: Apache-2.0

description: |
  Internal MDIO bus of a Marvell 88E6xxx switch. Must be a child of the
  switch node; the internal PHYs are its children, at the addresses the
  switch uses for them (0x10 + port number on the 88E6341/6390 families).

    switch0: ethernet-switch@1 {
        compatible = "marvell,mv88e6085";
        ...
        mdio {
            compatible = "marvell,mv88e6xxx-mdio";
            #address-cells = <1>;
            #size-cells = <0>;

            switch0phy1: ethernet-phy@11 {
                compatible = "ethernet-phy";
                reg = <0x11>;
            };
        };
    };

compatible: "marvell,mv88e6xxx-mdio"

include: mdio-controller.yaml
```
