## drivers/pcie/endpoint/Kconfig
```kconfig
# PCIe Endpoint configuration options

# Copyright 2020 Broadcom
# SPDX-License-Identifier: Apache-2.0

menuconfig PCIE_ENDPOINT
	bool "PCIe Endpoint support"
	help
	  This option enables PCIe Endpoint support.

if PCIE_ENDPOINT

module = PCIE_EP
module-str = PCIE_EP
source "subsys/logging/Kconfig.template.log_config"

comment "Legacy PCIe Endpoint API (pcie_ep.h)"

source "drivers/pcie/endpoint/Kconfig.iproc"
source "drivers/pcie/endpoint/Kconfig.rk3399"

comment "Endpoint Controller / Endpoint Function API (pcie_epc.h, pcie_epf.h)"

config PCIE_EPC
	bool "Endpoint controller core"
	help
	  Hardware independent part of the split endpoint stack: function
	  bookkeeping, outbound window allocator, event delivery and link
	  autostart. Selected by EPC controller drivers.

if PCIE_EPC

config PCIE_EPC_INIT_PRIORITY
	int "Endpoint controller init priority"
	default 70
	help
	  POST_KERNEL priority of EPC controller drivers. Must be after the
	  firmware (TISCI), power domain and syscon drivers.

config PCIE_EPF_DEFAULT_FUNCTION
	string "Endpoint function that binds when none is saved"
	default ""
	help
	  Name of the function ("test", "nvme", "vntb", ...) that claims the
	  controller when the setting pcie/ep/func is not set; empty: the
	  first function in devicetree order. "pcie controller ep function"
	  saves another one for the next boot.

config PCIE_EPF_INIT_PRIORITY
	int "Endpoint function init priority"
	default 75
	help
	  POST_KERNEL priority of EPF drivers, after PCIE_EPC_INIT_PRIORITY.

config PCIE_EPC_AUTOSTART_PRIORITY
	int "Endpoint link autostart priority"
	default 90 if PCIE_EPC_DSN_SETTINGS
	default 80
	help
	  POST_KERNEL priority at which controllers with at least one bound
	  function start link training. After PCIE_EPF_INIT_PRIORITY.

config PCIE_EPC_DSN_SETTINGS
	bool "Device Serial Number kept in settings"
	depends on SETTINGS
	help
	  Generate a locally administered EUI-64 on the first boot, keep it
	  in settings (pcie/ep/dsn<n>) and program it into every endpoint
	  controller with a DSN capability before link autostart, as the
	  netshell does with its MAC addresses. A root port driver keeps its
	  own (pcie/rc/dsn<n>). Shell: pcie controller dsn.

config PCIE_EPC_DSN_SPI_NOR_UID
	bool "First DSN from the SPI NOR unique ID"
	default y
	depends on PCIE_EPC_DSN_SETTINGS && SPI_NOR
	select FLASH_EX_OP_ENABLED
	help
	  On the first boot (nothing in settings) the DSN is made from the
	  64-bit factory unique ID of the SPI NOR (command 0x4B), with the
	  locally administered bit set; random without it.

config PCIE_EPC_DSN_POLL_MS
	int "Poll for a DSN written by the host [ms]"
	default 1000
	depends on PCIE_EPC_DSN_SETTINGS
	help
	  Some controllers let the host write the DSN capability (setpci
	  ECAP_DSN+4.l=... ECAP_DSN+8.l=...). A changed value is saved to
	  settings. 0 disables the poll.

config PCIE_EPC_DSN_INIT_PRIORITY
	int "DSN init priority"
	default 85
	depends on PCIE_EPC_DSN_SETTINGS
	help
	  POST_KERNEL priority: after the settings flash (SPI_NOR_INIT_PRIORITY)
	  and the controllers, before PCIE_EPC_AUTOSTART_PRIORITY.

config PCIE_EPC_OB_PAGES
	int "Outbound window allocator granules"
	default 64
	range 8 1024
	help
	  Number of allocation units the outbound window is split into. The
	  granule grows (power of two, min 4 KiB) until the window fits.

config PCIE_EPC_EVENT_QUEUE_DEPTH
	int "Pending controller events"
	default 16

endif # PCIE_EPC

source "drivers/pcie/endpoint/Kconfig.aardvark"

source "drivers/pcie/endpoint/functions/Kconfig"

endif # PCIE_ENDPOINT
```

## drivers/pcie/endpoint/Kconfig.aardvark
```kconfig
# Copyright (c) 2026 Jiri Kastner
# SPDX-License-Identifier: Apache-2.0

config PCIE_EPC_AARDVARK
	bool "Marvell Armada 3700 (Aardvark) endpoint controller"
	default y
	depends on DT_HAS_MARVELL_ARMADA_3700_PCIE_EP_ENABLED
	depends on ARM64
	select PCIE_EPC
	help
	  The Armada 3700 PCIe controller in endpoint mode, its reset
	  default. Header, outbound windows, MSI and link events; BAR
	  sizing and inbound translation are undocumented and left at the
	  reset defaults.

if PCIE_EPC_AARDVARK

config PCIE_EPC_AARDVARK_DMA
	bool "System DMA through the XOR engine"
	default y
	help
	  pcie_epc_xfer_dma() with the Armada 3700 XOR engine. The DMA
	  unit's IO decode window 1 is pointed at the outbound region.

config PCIE_EPC_AARDVARK_DMA_ATTR
	hex "Attribute of the DMA unit's IO decode window toward PCIe"
	default 0x0
	depends on PCIE_EPC_AARDVARK_DMA
	help
	  The CPU decode window for PCIe (target 2) has attribute 0.

config PCIE_EPC_AARDVARK_INBOUND_LIMIT
	hex "Inbound window (host access to DDR from 0)"
	default 0x80000
	help
	  Inbound TLPs reach DDR through the PCIe IO decode window; it is
	  shrunk to DDR 0..this size so the host cannot reach anything
	  else. Each BAR's inbound translation places it in that range,
	  aligned to the fixed BAR size, so the BAR backing store has to be
	  there and BL33 above it (TF-A A3700_NS_IMAGE_OFFSET). 0 keeps
	  TF-A's window (all of DRAM).

config PCIE_EPC_AARDVARK_POLL_MS
	int "Link poll period [ms]"
	default 20
	help
	  The controller interrupt sources of endpoint mode are not known,
	  link state, bus master enable and PERST# are polled.

config PCIE_EPC_AARDVARK_TRACE_INIT
	bool "printk checkpoints in the driver init"
	help
	  For bring-up: shows how far the init got when it hangs before the
	  console (deferred) log comes out.

config PCIE_EPC_AARDVARK_SHELL
	bool "pcie shell backend and debug commands"
	default y
	depends on PCIE_CTRL_SHELL
	help
	  Register dumps, writable bit probing, LTSSM tracing, INTx/MSI
	  and host memory access through an outbound window.

endif # PCIE_EPC_AARDVARK
```

## drivers/pcie/endpoint/Kconfig.rk3399
```kconfig
# Copyright The Zephyr Project Contributors
# SPDX-License-Identifier: Apache-2.0

config PCIE_EP_CDNS
	bool
	help
	  Register level support for the Cadence PCIe controller in endpoint
	  mode, used by SoC specific glue drivers.

config PCIE_EPC_RK3399
	bool "Rockchip RK3399 PCIe endpoint controller"
	default y
	depends on DT_HAS_ROCKCHIP_RK3399_PCIE_EP_ENABLED
	depends on SYSCON && RESET && CLOCK_CONTROL && GPIO
	select PCIE_EPC
	select PCIE_EP_CDNS
	select PCIE_RK3399_PORT
	help
	  The Cadence based PCIe controller of the RK3399 in endpoint mode,
	  on the EPC API: header, BARs, outbound windows (32 x 1 MiB, region
	  0 for MSI), MSI and INTx, PERST# and link events. MSI-X is hidden
	  (not functional on this silicon). With PCIE_ROLE the same
	  controller is the root complex when that role is saved.

config PCIE_EPC_RK3399_SRIOV
	bool "SR-IOV strap (1 PF + up to 8 VFs)"
	depends on PCIE_EPC_RK3399
	help
	  Set sr_iov_en in PCIE_CLIENT_CONFIG (with ari_en, always set) in
	  endpoint mode, so the core exposes its SR-IOV capability. VF BARs,
	  inbound windows and MSI per VF are not handled yet: this only shows
	  the capability and its reset values to the host.
```

## drivers/pcie/endpoint/functions/Kconfig
```kconfig
# Copyright (c) 2026 Jiri Kastner
# SPDX-License-Identifier: Apache-2.0

if PCIE_EPC

comment "PCIe Endpoint Functions"

config PCIE_EPF_TEST
	bool "Linux pci_endpoint_test compatible test function"
	default y
	depends on DT_HAS_ZEPHYR_PCIE_EPF_TEST_ENABLED
	select CRC
	help
	  Endpoint function speaking the register protocol of the Linux
	  pci_endpoint_test host driver. On the host:
	    modprobe pci_endpoint_test
	    pcitest -b 0 / -r -s 65536 / -w -s 65536 / -c -s 65536 / -m 1
	  or the kselftest "pci_endpoint" suite.

config PCIE_EPF_TEST_POLL_US
	int "Command register poll period [us]"
	default 1000
	depends on PCIE_EPF_TEST

config PCIE_EPF_TEST_SETTINGS
	bool "Keep a header set by the epf_hdr shell command in settings"
	default y if !PCIE_CTRL_SHELL
	depends on PCIE_EPF_TEST && SETTINGS

config PCIE_EPF_TEST_SETTINGS_PRIORITY
	int "Saved header init priority"
	default 86
	depends on PCIE_EPF_TEST_SETTINGS
	help
	  POST_KERNEL priority: after the settings flash and the EPF, before
	  PCIE_EPC_AUTOSTART_PRIORITY.

config PCIE_EPF_TEST_CHUNK
	int "Transfer chunk size"
	default 65536
	depends on PCIE_EPF_TEST
	help
	  Host transfers are mapped and copied in chunks of this size, which
	  also sizes the bounce buffer.

config PCIE_EPF_NVME
	bool "NVMe endpoint function"
	default y
	depends on DT_HAS_ZEPHYR_PCIE_EPF_NVME_ENABLED
	depends on DISK_ACCESS
	help
	  The endpoint as an NVM Express controller with one namespace per
	  Zephyr disk, modelled on the Linux NVMe PCI endpoint target
	  (nvmet-pci-epf). The host's stock nvme driver binds to it by class
	  code 01:08:02.

if PCIE_EPF_NVME

config PCIE_EPF_NVME_MAX_IO_QUEUES
	int "Most I/O queue pairs of any instance"
	default 8
	range 1 64
	help
	  Sizes the per-instance queue tables and the doorbell area in BAR0;
	  the io-queues property picks the number offered.

config PCIE_EPF_NVME_MAX_NAMESPACES
	int "Most namespaces (disk-names entries) of any instance"
	default 5
	range 1 32

config PCIE_EPF_NVME_MDTS_KB
	int "Maximum data transfer size [KiB]"
	default 128
	help
	  Power of two, at least 4. Every instance holds a buffer of this
	  size; a command is fetched into it, executed on the disk and sent
	  back. The host splits larger requests.

config PCIE_EPF_NVME_DMA
	bool "Move data with the controller DMA"
	default y
	help
	  pcie_epc_xfer_dma() where the controller has it, CPU copies
	  through an outbound window otherwise.

config PCIE_EPF_NVME_VWC
	bool "Report a volatile write cache"
	default y
	help
	  The host then sends Flush, executed as DISK_IOCTL_CTRL_SYNC
	  (FLUSH CACHE EXT on a SATA disk).

config PCIE_EPF_NVME_READY_TIMEOUT_MS
	int "CAP.TO: how long the host waits for CSTS.RDY [ms]"
	default 15000
	range 500 127500

config PCIE_EPF_NVME_CC_POLL_MS
	int "CC poll period while the controller is disabled [ms]"
	default 10

config PCIE_EPF_NVME_BUSY_POLL_MS
	int "Busy polling of the doorbells after the last command [ms]"
	default 100
	help
	  The polling thread yields but does not sleep for this long after
	  the last command, then polls every PCIE_EPF_NVME_IDLE_POLL_US.

config PCIE_EPF_NVME_IDLE_POLL_US
	int "Doorbell poll period when idle [us]"
	default 1000

config PCIE_EPF_NVME_THREAD_PRIORITY
	int "Polling thread priority"
	default 14
	help
	  Preemptible; busy polling yields to threads of the same priority
	  only, so keep it at the shell's or lower.

config PCIE_EPF_NVME_STACK_SIZE
	int "Polling thread stack size"
	default 4096

config PCIE_EPF_NVME_TEMPERATURE_K
	int "Composite temperature reported in the SMART log [K]"
	default 313

config PCIE_EPF_NVME_SHELL
	bool "nvme_epf shell command"
	default y
	depends on SHELL

endif # PCIE_EPF_NVME

config PCIE_EPF_VNTB
	bool "vNTB endpoint function"
	default y
	depends on DT_HAS_ZEPHYR_PCIE_EPF_VNTB_ENABLED
	select NTB
	help
	  Non-Transparent Bridge between the PCIe host and Zephyr, the
	  counterpart of the Linux pci-epf-vntb function. The host binds
	  its ntb_hw_epf driver by vendor/device ID and runs ntb_tool,
	  ntb_transport and friends; Zephyr gets the NTB API
	  (zephyr/drivers/ntb.h).

if PCIE_EPF_VNTB

config PCIE_EPF_VNTB_POLL_US
	int "Command and doorbell poll period [us]"
	default 1000
	help
	  The host's commands (it waits up to 1 s for each) and doorbells
	  land in BAR memory and are polled. Linux polls every 5 ms.

config PCIE_EPF_VNTB_THREAD_PRIORITY
	int "Polling thread priority"
	default 10
	help
	  Client callbacks (link and doorbell events) run in this thread.

config PCIE_EPF_VNTB_STACK_SIZE
	int "Polling thread stack size"
	default 2048

config PCIE_EPF_VNTB_DMA
	bool "Copy to and from host windows with the controller DMA"
	default y
	help
	  ntb_peer_mw_xfer() uses pcie_epc_xfer_dma() where the controller
	  has it, CPU copies through the outbound window otherwise.

config PCIE_EPF_VNTB_STATIC_MEM_SIZE
	hex "BAR memory without memory-region"
	default 0x40000
	help
	  Without a memory-region the BARs (config, doorbell, windows) live
	  in a static buffer of this size, a power of two.

config PCIE_EPF_VNTB_SHELL
	bool "vntb shell command"
	default y
	depends on SHELL

endif # PCIE_EPF_VNTB

config PCIE_EPF_FABRIC
	bool "PCIe fabric endpoint function"
	default y
	depends on DT_HAS_ZEPHYR_PCIE_EPF_FABRIC_ENABLED
	select PCIE_FABRIC
	help
	  This endpoint becomes a node of the PCIe fabric the root complex
	  runs: BAR0 is its region (info, card, rings, RMA window), the
	  peers are reached through the outbound window.

config PCIE_EPF_FABRIC_STATIC_MEM
	hex "BAR0 memory without memory-region"
	default 0x10000
	depends on PCIE_EPF_FABRIC

endif # PCIE_EPC
```

## drivers/pcie/fabric/Kconfig
```kconfig
# Copyright (c) 2026 Jiri Kastner
# SPDX-License-Identifier: Apache-2.0

menuconfig PCIE_FABRIC
	bool "PCIe fabric: nodes talking over PCIe writes"
	help
	  Nodes behind one root complex (endpoints and the root complex
	  itself) exchange messages and one-sided writes directly, peer to
	  peer through the switches. The root complex hands out node IDs,
	  roles and the peer tables ("cards"); see
	  include/zephyr/drivers/pcie/fabric.h for the wire format.

if PCIE_FABRIC

module = PCIE_FABRIC
module-str = pcie_fabric
source "subsys/logging/Kconfig.template.log_config"

config PCIE_FABRIC_MAX_NODES
	int "Nodes in a fabric (receive rings per region)"
	range 2 16
	default 8

config PCIE_FABRIC_SLOTS
	int "Slots per receive ring"
	range 2 256
	default 16

config PCIE_FABRIC_SLOT_SIZE
	int "Slot size, bytes (16 of them header)"
	range 32 4096
	default 256

config PCIE_FABRIC_RXQ_DEPTH
	int "Messages queued for pfab_recv()"
	default 8

config PCIE_FABRIC_POLL_US
	int "Service thread poll interval, us (0: busy, yields only)"
	default 50

config PCIE_FABRIC_THREAD_PRIORITY
	int "Service thread priority"
	default 10

config PCIE_FABRIC_STACK_SIZE
	int "Service thread stack"
	default 2048

config PCIE_FABRIC_MGR
	bool "Fabric manager (root complex)"
	default y
	depends on PCIE_CONTROLLER
	select PCIE_AER
	help
	  Finds the fabric endpoints after the enumeration (BAR0 with the
	  PFAB magic), assigns node IDs and roles, sets the switch ports for
	  direct P2P and writes the cards.

config PCIE_FABRIC_RC_NODE
	bool "The root complex is node 0"
	default y
	depends on PCIE_FABRIC_MGR
	help
	  A region in RAM the endpoints write into (inbound DMA): the root
	  complex takes part in the fabric like any endpoint.

config PCIE_FABRIC_RC_REGION_SIZE
	hex "Root complex node region, bytes"
	default 0x10000
	depends on PCIE_FABRIC_RC_NODE

config PCIE_FABRIC_RC_INBOUND_OFFSET
	hex "Root complex RAM: bus address minus physical address"
	default 0x0
	depends on PCIE_FABRIC_RC_NODE
	help
	  What the endpoints write to reach the root complex's node region:
	  its physical address plus this. 0 for an identity inbound window
	  (Armada 3700: TF-A maps all of DRAM 1:1).

config PCIE_FABRIC_MGR_AUTO
	bool "Bring the fabric up after every enumeration"
	default y
	depends on PCIE_FABRIC_MGR

config PCIE_FABRIC_SHELL
	bool "pcie fabric shell commands"
	default y
	depends on PCIE_CTRL_SHELL

endif
```

## drivers/pinctrl/Kconfig.armada37xx
```kconfig
# Copyright (c) 2026 Jiri Kastner
# SPDX-License-Identifier: Apache-2.0

config PINCTRL_ARMADA37XX
	bool "Marvell Armada 37xx pin controller"
	default y
	depends on DT_HAS_MARVELL_ARMADA3710_SB_PINCTRL_ENABLED
	help
	  Group based pin muxing through the north and south bridge
	  selection registers.
```

## drivers/pinctrl/Kconfig.rk3399
```kconfig
# Copyright (c) 2026 Jiri Kastner
# SPDX-License-Identifier: Apache-2.0

config PINCTRL_RK3399
	bool "Rockchip RK3399 pin controller"
	default y
	depends on DT_HAS_ROCKCHIP_RK3399_PINCTRL_ENABLED
	help
	  Iomux and pulls in the GRF (banks 2-4) and PMUGRF (banks 0-1).
```
