## dts/bindings/usb/rockchip,rk3308-usb.yaml
```yaml
# Copyright The Zephyr Project Contributors
# SPDX-License-Identifier: Apache-2.0

description: |
  Rockchip RK3308 OTG controller (DWC2) with the INNO USB2 PHY, device
  mode. The PHY's OTG port is set up through the USB2PHY GRF.

compatible: "rockchip,rk3308-usb"

include: ["snps,dwc2.yaml"]

properties:
  rockchip,usb2phy-grf:
    type: phandle
    required: true
    description: USB2PHY GRF (0xff008000)
```

## soc/allwinner/sun55i_a523/Kconfig
```kconfig
# Copyright The Zephyr Project Contributors
# SPDX-License-Identifier: Apache-2.0

config SOC_SUN55I_A523
	select ARM64
	select CPU_CORTEX_A55
	select ARM_ARCH_TIMER if SYS_CLOCK_EXISTS
```

## soc/allwinner/sun55i_a523/Kconfig.soc
```kconfig
# Copyright The Zephyr Project Contributors
# SPDX-License-Identifier: Apache-2.0

config SOC_SUN55I_A523
	bool

config SOC
	default "sun55i_a523" if SOC_SUN55I_A523
```

## soc/nxp/layerscape/ls1012a/Kconfig
```kconfig
# Copyright The Zephyr Project Contributors
# SPDX-License-Identifier: Apache-2.0

config SOC_LS1012A
	select ARM64
	select CPU_CORTEX_A53
	select ARM_ARCH_TIMER if SYS_CLOCK_EXISTS
```

## soc/nxp/layerscape/ls1012a/Kconfig.defconfig
```kconfig
# Copyright The Zephyr Project Contributors
# SPDX-License-Identifier: Apache-2.0

if SOC_LS1012A

config NUM_IRQS
	default 192

config FLASH_SIZE
	default 0

config FLASH_BASE_ADDRESS
	default 0

endif # SOC_LS1012A
```

## soc/nxp/layerscape/ls1012a/Kconfig.soc
```kconfig
# Copyright The Zephyr Project Contributors
# SPDX-License-Identifier: Apache-2.0

config SOC_SERIES_LS1012A
	bool
	select SOC_FAMILY_NXP_LAYERSCAPE

config SOC_LS1012A
	bool
	select SOC_SERIES_LS1012A
	help
	  NXP Layerscape LS1012A

config SOC
	default "ls1012a" if SOC_LS1012A

config SOC_SERIES
	default "ls1012a" if SOC_SERIES_LS1012A
```
