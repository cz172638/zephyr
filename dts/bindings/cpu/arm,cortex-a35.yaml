## dts/bindings/cpu/arm,cortex-a35.yaml
```yaml
# Copyright (c) 2026 Jiri Kastner <cz172638@gmail.com>
# SPDX-License-Identifier: Apache-2.0

description: ARM Cortex-A35 CPU

compatible: "arm,cortex-a35"

include: cpu.yaml
```

## dts/bindings/debug/rockchip,rk3399-sd-jtag.yaml
```yaml
# Copyright The Zephyr Project Contributors
# SPDX-License-Identifier: Apache-2.0

description: |
  RK3399 debug port on the micro SD pins. The AP (Cortex-A) and MCU
  (Cortex-M0) JTAG ports are two-wire (SWD): TCK = SWCLK, TMS = SWDIO.

    GPIO4_B2  SDMMC_D2   APJTAG_TCK
    GPIO4_B3  SDMMC_D3   APJTAG_TMS
    GPIO4_B4  SDMMC_CLK  MCUJTAG_TCK
    GPIO4_B5  SDMMC_CMD  MCUJTAG_TMS

  Enabled, the selected pairs are muxed to JTAG at boot (PRE_KERNEL_1)
  and GRF_SOC_CON7.force_jtag is set, so the port works with an empty
  slot as well as with a breakout that card detect sees as a card. The
  SD host (sdmmc) must then stay disabled, it would take the pins back.

compatible: "rockchip,rk3399-sd-jtag"

include: base.yaml

properties:
  reg:
    required: true
    description: GRF_GPIO4B_IOMUX and GRF_SOC_CON7, as the core sees them.

  ap-jtag:
    type: boolean
    description: Mux the AP pair (GPIO4_B2/B3).

  mcu-jtag:
    type: boolean
    description: Mux the MCU pair (GPIO4_B4/B5).
```

## dts/bindings/ethernet/rockchip,rk3308-mac.yaml
```yaml
# SPDX-FileCopyrightText: Copyright (c) 2026 Jiri Kastner <cz172638@gmail.com>
# SPDX-License-Identifier: Apache-2.0

title: Rockchip RK3308 MAC

description: |
  10/100 RMII Ethernet MAC of the Rockchip RK3308 (MAC2IO), a Synopsys
  DesignWare MAC v3.x. The driver programs the CRU and GRF itself (clock,
  gates, reset, RMII pin group M0) until RK3308 clock and pinctrl drivers
  exist.

compatible: "rockchip,rk3308-mac"

include: snps,dwmac.yaml

properties:
  reg:
    required: true

  interrupts:
    required: true

  phy-connection-type:
    required: true

  phy-handle:
    required: true

  rockchip,grf:
    type: phandle
    required: true
    description: GRF syscon (MAC interface/speed select, RMII pin mux).

  rockchip,cru:
    type: phandle
    required: true
    description: CRU syscon (MAC clock, gates and reset).

  clock-in-out:
    type: string
    enum:
      - "input"
      - "output"
    default: "output"
    description: |
      Direction of the 50 MHz RMII reference on the MAC_CLK pin. "output":
      the SoC generates it from one of its PLLs, "input": it comes from the
      PHY or an oscillator.
```

## dts/bindings/ethernet/rockchip,rk3399-gmac.yaml
```yaml
# Copyright The Zephyr Project Contributors
# SPDX-License-Identifier: Apache-2.0

title: Rockchip RK3399 GMAC

description: |
  Rockchip RK3399 Gigabit Ethernet MAC, a Synopsys DesignWare MAC 3.70a
  (dwc_ether_1000 core) with RGMII or RMII. The GRF holds the interface
  select, the RGMII clock divider and the RGMII delay lines; the CRU the
  choice between the internal MAC clock and the clock from the PHY.

compatible: "rockchip,rk3399-gmac"

include:
  - name: snps,dwmac.yaml
  - name: reset-device.yaml
  - name: pinctrl-device.yaml

properties:
  reg:
    required: true

  interrupts:
    required: true

  clocks:
    required: true
    description: |
      CRU gates turned on at init, see
      include/zephyr/dt-bindings/clock/rk3399-cru.h.

  resets:
    required: true

  rockchip,grf:
    type: phandle
    required: true
    description: GRF syscon (GRF_SOC_CON5, GRF_SOC_CON6).

  rockchip,cru:
    type: phandle
    required: true
    description: CRU node, for the clk_rmii_src select in CRU_CLKSEL_CON19.

  clock-in-out:
    type: string
    enum:
      - "input"
      - "output"
    default: "input"
    description: |
      "input": the MAC clock (125 MHz RGMII, 50 MHz RMII) comes from the PHY
      on the mac_clk pin. "output": the MAC uses the CRU clk_gmac.

  tx-delay:
    type: int
    default: 0x30
    description: RGMII TX clock delay line value (GRF_SOC_CON6[6:0]), 0 disables it.

  rx-delay:
    type: int
    default: 0x10
    description: RGMII RX clock delay line value (GRF_SOC_CON6[14:8]), 0 disables it.
```

## dts/bindings/flash_controller/fsl,ls1021a-qspi.yaml
```yaml
# Copyright The Zephyr Project Contributors
# SPDX-License-Identifier: Apache-2.0

description: |
  Freescale QuadSPI controller of the NXP Layerscape LS1021A and LS1012A
  with one SPI NOR flash on chip select A1. The flash is a child node
  "flash@0" (soc-nv-flash) giving its size, erase block size and the
  partitions.

compatible: "fsl,ls1021a-qspi"

include: flash-controller.yaml

properties:
  reg:
    required: true

  reg-names:
    required: true
    description: |
      "ctrl": controller registers, "mem": the AHB window
      onto the flash.

  interrupts:
    description: Controller interrupt (not used, the driver polls).
```

## dts/bindings/gpio/allwinner,sun55i-a523-gpio.yaml
```yaml
# Copyright The Zephyr Project Contributors
# SPDX-License-Identifier: Apache-2.0

description: |
  Allwinner A523 GPIO bank (pin controller layout with 0x30 bytes per
  bank: four drive level registers, pull registers at 0x24).

compatible: "allwinner,sun55i-a523-gpio"

include: allwinner,sunxi-gpio.yaml
```

## dts/bindings/hwinfo/rockchip,rk3308-otp.yaml
```yaml
# Copyright The Zephyr Project Contributors
# SPDX-License-Identifier: Apache-2.0

description: |
  Rockchip RK3308 OTP, read by the hwinfo driver: the device ID is the
  16-byte CPU ID at byte 7.

compatible: "rockchip,rk3308-otp"

include: base.yaml

properties:
  reg:
    required: true
```

## dts/bindings/hwinfo/rockchip,rk3399-efuse.yaml
```yaml
# Copyright The Zephyr Project Contributors
# SPDX-License-Identifier: Apache-2.0

description: |
  Rockchip RK3399 non-secure eFuse, read by the hwinfo driver: the device
  ID is the 16-byte CPU ID at byte 7.

compatible: "rockchip,rk3399-efuse"

include: base.yaml

properties:
  reg:
    required: true

  clocks:
    required: true
```

## dts/bindings/i2c/rockchip,rk3399-i2c.yaml
```yaml
# SPDX-FileCopyrightText: Copyright The Zephyr Project Contributors
# SPDX-License-Identifier: Apache-2.0

description: Rockchip RK3399 I2C controller

compatible: "rockchip,rk3399-i2c"

include: [i2c-controller.yaml, pinctrl-device.yaml]

properties:
  reg:
    required: true

  clocks:
    required: true

  clock-names:
    required: true
    description: |
      "i2c" for the controller input clock, "pclk" for the bus clock.
```

## dts/bindings/mfd/rockchip,rk808.yaml
```yaml
# Copyright The Zephyr Project Contributors
# SPDX-License-Identifier: Apache-2.0

description: |
  Rockchip RK808 PMIC: four buck converters, eight LDOs, two switches, an
  RTC and a 32 kHz clock output, on I2C. The functions are child nodes; the
  PMIC node itself has no driver.

compatible: "rockchip,rk808"

include: i2c-device.yaml
```

## dts/bindings/pcie/controller/allwinner,sun55i-a523-pcie.yaml
```yaml
# Copyright The Zephyr Project Contributors
# SPDX-License-Identifier: Apache-2.0

description: |
  Allwinner A523/A527/T527 PCIe controller: Synopsys DesignWare core,
  root complex only, PCIe 2.1 x1, unrolled iATU with 8 outbound regions.

  "dbi" (0x480000): DBI at 0, DBI2 at 0x100000, iATU at 0x300000 and the
  Allwinner application registers at 0x400000.
  "config": configuration requests through outbound region 0. It must
  start the 256 MiB window of the controller's AXI slave port
  (0x20000000): the iATU sees addresses relative to it.
  "combo": PCIe/USB 3.0 combo sub-system registers at 0, INNO PHY at
  0x80000.

  The driver also programs the PCIe power domain of the PCK-600, the CCU
  clocks and the PHY itself: the SoC has no clock, reset or power domain
  drivers yet.

compatible: "allwinner,sun55i-a523-pcie"

include: pcie-controller.yaml

properties:
  reg:
    required: true

  reg-names:
    required: true
    description: Must be "dbi", "config", "combo".

  ranges:
    required: true

  num-lanes:
    type: int
    default: 1
    enum: [1]

  max-link-speed:
    type: int
    default: 2
    enum: [1, 2]

  perst-gpios:
    type: phandle-array
    description: PERST# to the slot.

  slot-power-gpios:
    type: phandle-array
    description: Switch of the slot's 3.3 V supply.
```

## dts/bindings/pcie/endpoint/fsl,ls-pcie-ep.yaml
```yaml
# Copyright The Zephyr Project Contributors
# SPDX-License-Identifier: Apache-2.0

description: |
  NXP Layerscape PCIe controller (Synopsys DesignWare) in endpoint mode.

  The role is selected by the RCW (HOST_AGT_PEX on LS1012A); the driver
  leaves the controller alone when it reads a type 1 header.

compatible: "fsl,ls-pcie-ep"

include: pcie-ep-controller.yaml

properties:
  reg:
    required: true

  reg-names:
    required: true
    description: |
      "regs": controller registers (DBI, DBI2 shadow, PF block),
      "addr_space": the AXI range the controller forwards to PCIe, used
      for outbound windows.

  interrupts:
    description: Controller interrupt (not used, the driver polls).

  big-endian:
    type: boolean
    description: The PF block is big-endian.

  dbi2-offset:
    type: int
    default: 0x1000
    description: Offset of the DBI2 shadow (BAR masks) from the DBI base.

  pf-offset:
    type: int
    default: 0xc0000
    description: Offset of the PF block from the DBI base.

  bar-fixed-64bit:
    type: int
    default: 0
    description: Bit mask of the BARs that are 64-bit prefetchable in hardware.
```

## dts/bindings/pinctrl/rockchip,rk3308-pinctrl.yaml
```yaml
# Copyright (c) 2026 Jiri Kastner <cz172638@gmail.com>
# SPDX-License-Identifier: Apache-2.0

description: |
  Rockchip RK3308 pin controller (GRF iomux).

  A pin configuration state is a child of the controller; each of its group
  grandchildren holds a 'pinmux' array built with the RK3308_PINMUX() helper
  and the named macros from <zephyr/dt-bindings/pinctrl/rk3308-pinctrl.h>:

    &pinctrl {
            uart0_default: uart0-default {
                    group1 {
                            pinmux = <UART0_RX_M0>, <UART0_TX_M0>;
                            bias-pull-up;
                    };
            };
    };

  The controller is a child of the GRF syscon node and uses its register block.

compatible: "rockchip,rk3308-pinctrl"

include: base.yaml

child-binding:
  child-binding:
    description: |
      RK3308 pin configuration group; bias-pull-up, bias-pull-down or
      bias-disable set the pull of all its pins, without one the pull is
      left as it is.

    include:
      - name: pincfg-node.yaml
        property-allowlist:
          - bias-disable
          - bias-pull-up
          - bias-pull-down

    properties:
      pinmux:
        type: array
        required: true
        description: Encoded GRF iomux fields to apply for this group.
```

## dts/bindings/pwm/rockchip,rk3328-pwm.yaml
```yaml
# Copyright The Zephyr Project Contributors
# SPDX-License-Identifier: Apache-2.0

description: |
  Rockchip PWM of the RK3328 generation (also RK3308), one channel per
  node. The PWM clock is set to clock-frequency; period and duty are
  counted in its cycles.

compatible: "rockchip,rk3328-pwm"

include: [pwm-controller.yaml, pinctrl-device.yaml, base.yaml]

properties:
  reg:
    required: true

  clocks:
    required: true

  clock-names:
    required: true
    description: Must be "pwm" (functional clock), "pclk" (APB).

  clock-frequency:
    type: int
    default: 24000000
    description: Rate set on the PWM clock.

  "#pwm-cells":
    const: 3

pwm-cells:
  - channel
  - period
  - flags
```

## dts/bindings/regulator/pwm-regulator.yaml
```yaml
# Copyright The Zephyr Project Contributors
# SPDX-License-Identifier: Apache-2.0

description: |
  Regulator whose output voltage is set by the duty cycle of a PWM, in
  the continuous mode of the Linux pwm-regulator binding: the voltage goes
  linearly from regulator-min-microvolt to regulator-max-microvolt as the
  duty cycle goes from the first to the second value of
  pwm-dutycycle-range. The PWM flags (e.g. PWM_POLARITY_INVERTED) are
  applied as usual: the duty cycle is the active part of the period.

compatible: "pwm-regulator"

include:
  - name: base.yaml
  - name: regulator.yaml
    property-allowlist:
      - regulator-name
      - regulator-init-microvolt
      - regulator-min-microvolt
      - regulator-max-microvolt
      - regulator-always-on
      - regulator-boot-on

properties:
  pwms:
    type: phandle-array
    required: true

  regulator-min-microvolt:
    required: true

  regulator-max-microvolt:
    required: true

  pwm-dutycycle-range:
    type: array
    default: [0, 100]
    description: Duty cycles of the minimum and the maximum voltage.

  pwm-dutycycle-unit:
    type: int
    default: 100
    description: Unit of pwm-dutycycle-range (100 for percent).

  regulator-settling-time-up-us:
    type: int
    default: 0
    description: Wait after a voltage increase.
```

## dts/bindings/regulator/rockchip,rk808-regulator.yaml
```yaml
# Copyright The Zephyr Project Contributors
# SPDX-License-Identifier: Apache-2.0

description: |
  Rockchip RK808 PMIC regulators, a child node of the "rockchip,rk808" PMIC
  node. Regulators are child nodes named as in the Linux binding; DCDC_REG1
  and DCDC_REG2 (712.5-1500 mV in 12.5 mV steps) are supported.

  pmic@1b {
    compatible = "rockchip,rk808";
    reg = <0x1b>;

    regulators {
      compatible = "rockchip,rk808-regulator";

      DCDC_REG2 {
        regulator-always-on;
        regulator-min-microvolt = <750000>;
        regulator-max-microvolt = <1350000>;
      };
    };
  };

compatible: "rockchip,rk808-regulator"

include: base.yaml

child-binding:
  include:
    - name: regulator.yaml
      property-allowlist:
        - regulator-always-on
        - regulator-boot-on
        - regulator-min-microvolt
        - regulator-max-microvolt
        - regulator-init-microvolt
```

## dts/bindings/regulator/silergy,syr827.yaml
```yaml
# Copyright The Zephyr Project Contributors
# SPDX-License-Identifier: Apache-2.0

description: |
  Silergy SYR827 step-down regulator (FAN53555 register layout): 712.5-1500 mV
  in 12.5 mV steps. Two voltage registers, VSEL0 and VSEL1; the VSEL pin
  picks the one in use, the other one usually holds the sleep voltage.

compatible: "silergy,syr827"

include:
  - name: i2c-device.yaml
  - name: regulator.yaml
    property-allowlist:
      - regulator-always-on
      - regulator-boot-on
      - regulator-min-microvolt
      - regulator-max-microvolt
      - regulator-init-microvolt

properties:
  silergy,vsel:
    type: int
    default: 0
    enum: [0, 1]
    description: |
      Voltage register in use while the SoC runs, the one the VSEL pin level
      selects: 0 for VSEL0, 1 for VSEL1.
```

## dts/bindings/spi/allwinner,sun55i-a523-spi.yaml
```yaml
# Copyright The Zephyr Project Contributors
# SPDX-License-Identifier: Apache-2.0

description: |
  Allwinner A523/A527 SPI controller.

  The bus clock, module clock and reset are controlled directly by the
  driver through the SoC CCU using the allwinner,ccu-instance index; the
  controller operates in polling mode and does not use interrupts or DMA.

compatible: "allwinner,sun55i-a523-spi"

include: [spi-controller.yaml]

properties:
  clock-frequency:
    type: int
    required: true
    description: |
      Rate of the SPI module (parent) clock in Hz. The SCLK is derived from
      it with an integer divider in the CCU.

  allwinner,ccu-instance:
    type: int
    required: true
    description: |
      Index of this controller in the SoC CCU (0 = SPI0, 1 = SPI1,
      2 = SPI2), used for the module clock register, bus gate and reset.
```
