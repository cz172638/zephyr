## dts/bindings/spi/rockchip,rk3066-spi.yaml
```yaml
# Copyright (c) 2026 Jiri Kastner
# SPDX-License-Identifier: Apache-2.0

description: Rockchip SPI controller (RK3066 and later)

compatible: "rockchip,rk3066-spi"

include: [spi-controller.yaml, pinctrl-device.yaml]

properties:
  reg:
    required: true

  clocks:
    required: true

  clock-names:
    required: true
    description: Must be "spiclk", "apb_pclk".

  clock-frequency:
    type: int
    description: |
      Rate set on spiclk at init (SCK is at most half of it). Without it
      the boot loader's setting stays.

  rx-sample-delay:
    type: int
    default: 0
    description: RX sample delay in spiclk cycles (CTRLR0.RSD, 0..3).
```

## soc/marvell/Kconfig
```kconfig
# Copyright (c) 2026 Jiri Kastner
# SPDX-License-Identifier: Apache-2.0

if SOC_FAMILY_MARVELL_ARMADA

rsource "*/Kconfig"

endif # SOC_FAMILY_MARVELL_ARMADA
```

## soc/marvell/Kconfig.soc
```kconfig
# Copyright (c) 2026 Jiri Kastner
# SPDX-License-Identifier: Apache-2.0

config SOC_FAMILY_MARVELL_ARMADA
	bool

config SOC_FAMILY
	default "marvell_armada" if SOC_FAMILY_MARVELL_ARMADA

rsource "*/Kconfig.soc"
```

## soc/marvell/armada37xx/Kconfig
```kconfig
# Copyright (c) 2026 Jiri Kastner
# SPDX-License-Identifier: Apache-2.0

config SOC_ARMADA3720
	select ARM64
	select CPU_CORTEX_A53
	select ARM_ARCH_TIMER if SYS_CLOCK_EXISTS

config SOC_ARMADA3720_CM3
	select ARM
	select CPU_CORTEX_M3
	select CPU_CORTEX_M_HAS_SYSTICK
	select CPU_CORTEX_M_HAS_VTOR
	select SOC_EARLY_INIT_HOOK
	help
	  The Cortex-M3 secure processor ("rWTM") of the Armada 3720 in place
	  of the Marvell WTMI firmware. It sees its SRAM at 0x1fff0000, its
	  own registers (mailbox, eFuse) at 0x40000000, the SoC registers at
	  0xc0000000 (0xd0000000 for the A53) and DDR at 0x60000000.

if SOC_ARMADA3720_CM3

config SOC_ARMADA3720_CM3_SYS_INIT
	bool "Clock preset, AVS and DDR tuning (Marvell WTMI sys_init)"
	default y
	help
	  What the Marvell WTMI sys_init does before the A53 may start, run
	  before the kernel: the clock preset, the AVS voltage and the DDR
	  tuning. The BootROM did the static DDR setup from the TIM already.

if SOC_ARMADA3720_CM3_SYS_INIT

config SOC_ARMADA3720_CM3_CLOCK_PRESET
	int "Clock preset"
	default 2
	range 0 3
	help
	  0: CPU 600 / DDR 600, 1: CPU 800 / DDR 800, 2: CPU 1000 / DDR 800,
	  3: CPU 1200 / DDR 750 MHz. Must match the chip marking and the TIM
	  (mkflash.sh CLOCKS).

config SOC_ARMADA3720_CM3_DDR_TYPE
	int "DDR type (0 DDR3, 1 DDR4)"
	default 0

config SOC_ARMADA3720_CM3_DDR_DEV_WIDTH
	int "DDR device bus width"
	default 16

config SOC_ARMADA3720_CM3_DDR_SPEED_BIN
	int "DDR speed bin index"
	default 12

config SOC_ARMADA3720_CM3_DDR_CS_NUM
	int "DDR chip selects"
	default 2

config SOC_ARMADA3720_CM3_DDR_DEV_CAP_MB
	int "DDR device capacity [MiB]"
	default 512
	help
	  Defaults: ESPRESSObin v5, 1 GiB DDR3 on 2 chip selects (A3700-utils
	  DDR_TOPOLOGY_2).

endif # SOC_ARMADA3720_CM3_SYS_INIT

config SOC_ARMADA3720_CM3_START_AP
	bool "Start the A53"
	default y
	help
	  Tell the A53 BootROM through the mailbox to run the OBMI image
	  (TF-A BL1) the BootROM loaded.

config SOC_ARMADA3720_CM3_AP_ENTRY
	hex "A53 entry"
	default 0x04100000
	depends on SOC_ARMADA3720_CM3_START_AP

config SOC_ARMADA3720_CM3_CONSOLE_BRIDGE
	bool "A53 console through the CM3"
	depends on IPC_SERVICE && UART_CONSOLE
	depends on $(dt_nodelabel_enabled,ipc0)
	help
	  UART0 stays with the CM3. The A53 console (zephyr,uart-ipc on the
	  "console" endpoint of ipc0) is written out here and the UART input
	  goes to the A53.

config SOC_ARMADA3720_CM3_CONSOLE_POLL_MS
	int "UART input poll period"
	default 2
	depends on SOC_ARMADA3720_CM3_CONSOLE_BRIDGE

config SOC_ARMADA3720_CM3_FLASH_SERVER
	bool "Serve the SPI NOR to the A53"
	depends on FLASH && MBOX_MVEBU_RWTM
	depends on $(dt_nodelabel_enabled,rflash)
	select CRC
	help
	  The CM3 owns the SPI NOR: the A53 (flash_mvebu_rwtm) reads, writes
	  and erases outside the firmware area through the mailbox, and
	  updates the firmware only as a whole checked image.

config SOC_ARMADA3720_CM3_FLASH_TRACE
	bool "Print every flash request"
	depends on SOC_ARMADA3720_CM3_FLASH_SERVER

config SOC_ARMADA3720_CM3_FLASH_FW_SIZE
	hex "Firmware area"
	default 0x3e0000
	depends on SOC_ARMADA3720_CM3_FLASH_SERVER
	help
	  From offset 0: TIM, WTMI (this image), TF-A and the A53 Zephyr.
	  Plain writes and erases from the A53 below this are refused.

config SOC_ARMADA3720_CM3_REBOOT
	bool "WTMI reboot command"
	default y
	depends on MBOX_MVEBU_RWTM
	help
	  Answers the WTMI reboot command (9, argument 0xdeadbeef) that TF-A
	  sends with CM3_SYSTEM_RESET=1, with the north bridge warm reset.

endif # SOC_ARMADA3720_CM3

config SOC_ARMADA37XX_DAP_SHELL
	bool "CoreSight/DAP shell"
	depends on SOC_ARMADA3720 && SHELL
	default y
	help
	  'dap info': MDRAR_EL1, DBGAUTHSTATUS and a walk of the debug ROM
	  table (DAP-Lite or full CoreSight with funnels/TMC/TPIU);
	  'dap rd': raw reads of the debug APB.

config SOC_ARMADA37XX_REGS_SHELL
	bool "regs shell (abort-safe register range reads)"
	depends on SOC_ARMADA3720 && SHELL && MMU
	default y
	help
	  'regs scan|nz|dump <pa> <len>' and 'regs clk': map an internal
	  register range and read it, an external abort shows as ????????.

config SOC_ARMADA37XX_DAP_ROM_BASE
	hex "CoreSight ROM table (debug APB) for dap info"
	default 0x80000000
	depends on SOC_ARMADA37XX_DAP_SHELL
	help
	  Where "dap info" starts its walk without an address argument.
	  MDRAR_EL1 is deprecated in Armv8 (and 0 on the Armada 3720), so the
	  address comes from the SoC: the debug APB the DAP's APB-AP sees.
	  Secure only on this SoC: reads go through TF-A (A3700_DBG_SIP).

config SOC_ARMADA37XX_CCI_SHELL
	bool "CCI-400 shell"
	depends on SOC_ARMADA3720 && SHELL
	default y
	help
	  'cci dump' and 'cci share': the CCI-400 registers (remapped by
	  TF-A to 0xfe000000), for the I/O coherency bring-up.
```

## soc/marvell/armada37xx/Kconfig.soc
```kconfig
# Copyright (c) 2026 Jiri Kastner
# SPDX-License-Identifier: Apache-2.0

config SOC_SERIES_ARMADA37XX
	bool
	select SOC_FAMILY_MARVELL_ARMADA

config SOC_ARMADA3720
	bool
	select SOC_SERIES_ARMADA37XX
	help
	  Marvell Armada 3720: dual Cortex-A53, GIC-500.

config SOC_ARMADA3720_CM3
	bool
	select SOC_SERIES_ARMADA37XX
	help
	  Marvell Armada 3720 Cortex-M3 secure processor.

config SOC
	default "armada3720" if SOC_ARMADA3720
	default "armada3720_cm3" if SOC_ARMADA3720_CM3

config SOC_SERIES
	default "armada37xx" if SOC_SERIES_ARMADA37XX
```

## soc/rockchip/rk3399/Kconfig
```kconfig
# Copyright 2022 Huawei France Technologies SASU
# Copyright The Zephyr Project Contributors
# SPDX-License-Identifier: Apache-2.0

config SOC_RK3399_A53
	select ARM64
	select CPU_CORTEX_A53
	select ARM_ARCH_TIMER if SYS_CLOCK_EXISTS

config SOC_RK3399_A72
	select ARM64
	select CPU_CORTEX_A72
	select ARM_ARCH_TIMER if SYS_CLOCK_EXISTS

config SOC_RK3399_M0_PMU
	select ARM
	select CPU_CORTEX_M0
	select CPU_CORTEX_M_HAS_SYSTICK

config SOC_RK3399_M0_PERILP
	select ARM
	select CPU_CORTEX_M0
	select CPU_CORTEX_M_HAS_SYSTICK

config SOC_PART_NUMBER
	default "RK3399" if SOC_SERIES_RK3399

if SOC_SERIES_RK3399

config RK3399_A72_SELF_MIGRATE
	bool "Migrate to the big cluster when entered on a Cortex-A53"
	depends on SOC_RK3399_A72
	default y
	help
	  The boot ROM, TF-A and U-Boot always run on CPU0 (Cortex-A53).
	  When an image built for the big cluster is entered on an A53, it
	  asks PSCI to start CPU4 (MPIDR 0x100) at the image entry point and
	  powers the calling A53 off.

config RK3399_REMOTE_CORE_CONTROL
	bool "Remote core control (M0 and big/little cluster start)"
	depends on ARM64
	default y
	select HAS_ARM_SMCCC
	help
	  Helpers to start the PMU M0, the PERILP M0 and cores of the other
	  cluster from an image running on a Cortex-A core.

endif # SOC_SERIES_RK3399
```

## soc/rockchip/rk3399/Kconfig.soc
```kconfig
# Copyright 2022 Huawei France Technologies SASU
# Copyright The Zephyr Project Contributors
# SPDX-License-Identifier: Apache-2.0

config SOC_SERIES_RK3399
	bool
	select SOC_FAMILY_ROCKCHIP

config SOC_RK3399
	bool
	select SOC_SERIES_RK3399

config SOC_RK3399_A53
	bool
	select SOC_RK3399
	help
	  RK3399 little cluster (4x Cortex-A53, MPIDR 0x000-0x003).

config SOC_RK3399_A72
	bool
	select SOC_RK3399
	help
	  RK3399 big cluster (2x Cortex-A72, MPIDR 0x100-0x101).

config SOC_RK3399_M0_PMU
	bool
	select SOC_RK3399
	help
	  RK3399 Cortex-M0 in the PMU power domain (PMU M0).

config SOC_RK3399_M0_PERILP
	bool
	select SOC_RK3399
	help
	  RK3399 Cortex-M0 in the PERILP power domain (PERILP M0).

config SOC_SERIES
	default "rk3399" if SOC_SERIES_RK3399

config SOC
	default "rk3399" if SOC_RK3399
```

## subsys/fwupdate/Kconfig
```kconfig
# Copyright (c) 2026 Jiri Kastner
# SPDX-License-Identifier: Apache-2.0

menuconfig FWUPDATE
	bool "Firmware update into a flash partition"
	depends on (FLASH && FLASH_MAP) || DISK_ACCESS
	imply REBOOT
	help
	  Shell driven update of the boot image in the partition with node
	  label fwupdate_partition (or boot_partition). The image is
	  received into RAM, checked, then erased, written (first erase
	  unit last) and verified.
	  With FWUPDATE_BOOT_DISK the image is the boot area at the start
	  of a disk instead (e.g. eMMC on Rockchip SoCs).

if FWUPDATE

config FWUPDATE_YMODEM
	bool "YMODEM over the shell UART"
	default y
	depends on SHELL
	select CRC
	help
	  "fwupdate ymodem [dry]" receives the image with YMODEM (CRC-16,
	  1 KiB blocks) on the shell's own UART, e.g. with tio (ctrl-t y)
	  or lrzsz sb. "fwupdate xmodem [dry]" does the same with XMODEM or
	  XMODEM-1K (CRC-16, or the 8-bit checksum when the sender answers the
	  NAK that alternates with 'C' after 3 s), e.g. tio, lrzsz sx or a script
	  with an XMODEM library; the image arrives padded to whole blocks.

config FWUPDATE_YMODEM_START_TIMEOUT
	int "Seconds to wait for the sender"
	default 60
	depends on FWUPDATE_YMODEM

config FWUPDATE_YMODEM_RX_BUF_SIZE
	int "Receive buffer between the shell and the YMODEM thread"
	default 4096
	depends on FWUPDATE_YMODEM

config FWUPDATE_TCP
	bool "Raw TCP upload"
	depends on SHELL && NET_SOCKETS && NET_TCP && NET_IPV4
	select CRC
	help
	  "fwupdate tcp [port] [dry]" accepts one TCP connection and takes
	  everything up to EOF as the image, e.g. nc -N <board> 6969 <
	  flash-image.bin. There is no authentication: enable it only on
	  trusted networks; the command has to be started from a shell (UART
	  or SSH) for each update.

config FWUPDATE_TCP_PORT
	int "Default TCP port"
	default 6969
	depends on FWUPDATE_TCP

config FWUPDATE_TCP_ACCEPT_TIMEOUT
	int "Seconds to wait for the connection"
	default 120
	depends on FWUPDATE_TCP

config FWUPDATE_SCP
	bool "scp upload (scp -O image <board>:/fw)"
	default y
	depends on SHELL_SSH_SCP
	select CRC
	help
	  Registers the SSH shell's legacy scp sink: "scp -O image
	  <board>:/fw" writes the image, ":/fw-dry" only receives and checks
	  it. Authenticated by the SSH server (public key or password).

config FWUPDATE_TIM_HEADER
	bool "Require a Marvell TIM header"
	default y if SOC_SERIES_ARMADA37XX
	help
	  Refuse images that do not carry a TIM header ("TIMH" at offset 4),
	  as produced by the Armada 3700 TF-A mrvl_flash target.

config FWUPDATE_DISK
	bool "SATA boot images onto a disk"
	default y if AHCI && FWUPDATE_TIM_HEADER
	depends on DISK_ACCESS
	help
	  An image whose TIM names SATA as the boot device (BOOTDEV=SATA)
	  goes into the GPT partition of the Marvell boot type on the disk
	  FWUPDATE_DISK_NAME (made e.g. by sata-install.sh), header sector
	  invalidated first and written last, then verified. SPI NOR images
	  still go to the flash partition.

config FWUPDATE_DISK_NAME
	string "Disk with the SATA boot partition"
	default "sata0"
	depends on FWUPDATE_DISK

config FWUPDATE_BOOT_DISK
	bool "Boot area at the start of a disk instead of a flash partition"
	depends on DISK_ACCESS
	help
	  With a fwupdate_partition or boot_partition as well, the disk is
	  the target only when that partition's flash device is not ready
	  (a board variant without the SPI NOR); images are told apart by
	  the MBR the disk image starts with.
	  The image is a raw copy of the first FWUPDATE_BOOT_DISK_SIZE bytes
	  of the disk FWUPDATE_BOOT_DISK_NAME (e.g. MBR, Rockchip idbloader
	  at sector 64 and the FIT after it), written from sector 0. The
	  sector the boot ROM checks first (FWUPDATE_BOOT_DISK_HEADER) is
	  zeroed before and written after the rest, then all is verified.

config FWUPDATE_BOOT_DISK_NAME
	string "Disk with the boot area"
	default "EMMC"
	depends on FWUPDATE_BOOT_DISK

config FWUPDATE_BOOT_DISK_SIZE
	hex "Size of the boot area (bytes, also the receive buffer)"
	default 0x1000000
	depends on FWUPDATE_BOOT_DISK

config FWUPDATE_BOOT_DISK_HEADER
	int "Sector with the boot header, written last"
	default 64 if SOC_FAMILY_ROCKCHIP
	default 0
	depends on FWUPDATE_BOOT_DISK

config FWUPDATE_PROGRAM_EXTERNAL
	bool
	select CRC
	help
	  Selected by a platform that programs the image itself
	  (fwupdate_program_external()), e.g. a secure processor owning the
	  flash. The partition still gives the maximum size.

config FWUPDATE_THREAD_STACK_SIZE
	int "Update thread stack size"
	default 2048

config FWUPDATE_THREAD_PRIORITY
	int "Update thread priority"
	default 5

# 1 KiB blocks must not overrun the shell's UART receive ring
configdefault SHELL_BACKEND_SERIAL_RX_RING_BUFFER_SIZE
	default 2048 if FWUPDATE_YMODEM

endif # FWUPDATE
```

## subsys/lab/Kconfig
```kconfig
# Copyright (c) 2026 Jiri Kastner
# SPDX-License-Identifier: Apache-2.0

menuconfig LAB_AGENT
	bool "Lab agent (test automation between boards, debug builds)"
	depends on NETWORKING && NET_SOCKETS && NET_UDP && NET_IPV4
	depends on SHELL && SHELL_BACKEND_DUMMY
	select SETTINGS
	help
	  A UDP service that lets a peer board run shell commands here,
	  measure the clock offset and send files, plus "lab" shell
	  commands to do the same to the peer. Protected only by a shared
	  token and the peer's address: for a lab segment, not for a
	  network anyone else is on.

if LAB_AGENT

config LAB_IMAGE
	int "Image number of this firmware"
	default 0
	help
	  The number of the firmware image (NNN-name-spi.bin). Modules are
	  built with the same number; lab mod load / lab ext refuse a module
	  built for another image unless forced (-f). Bump it with every
	  change outside the debug modules.

config LAB_PORT
	int "UDP port"
	default 7777

config LAB_PRIORITY
	int "Server thread priority"
	default 10

config LAB_STACK_SIZE
	int "Server thread stack size"
	default 8192

config LAB_EXEC_TIMEOUT
	int "lab exec: seconds to wait for the peer command"
	default 30

config LAB_FILES
	int "RAM file slots"
	default 8

config LAB_FILE_POOL_SIZE
	int "RAM file pool, bytes"
	default 1048576

config LAB_EXT
	bool "Run test extensions (LLEXT) received by PUT"
	default y if LLEXT
	depends on LLEXT

config LAB_MODS
	int "Debug modules loaded at once (lab mod load)"
	default 8
	depends on LAB_EXT

module = LAB
module-str = lab
source "subsys/logging/Kconfig.template.log_config"

endif
```

## tests/drivers/ethernet/mv88e6xxx_tcam/testcase.yaml
```yaml
tests:
  drivers.ethernet.mv88e6xxx_tcam:
    platform_allow:
      - native_sim
      - native_sim/native/64
    integration_platforms:
      - native_sim/native/64
    tags:
      - ethernet
```

## tests/drivers/pcie/aer/testcase.yaml
```yaml
tests:
  drivers.pcie.aer:
    tags:
      - pcie
    platform_allow:
      - native_sim/native/64
    integration_platforms:
      - native_sim/native/64
```

## tests/drivers/pcie/endpoint/epc_aardvark/testcase.yaml
```yaml
tests:
  drivers.pcie.endpoint.epc_aardvark:
    tags:
      - pcie
    platform_allow:
      - native_sim/native/64
    integration_platforms:
      - native_sim/native/64
```
