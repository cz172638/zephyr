## tests/drivers/pcie/fabric/core/testcase.yaml
```yaml
tests:
  drivers.pcie.fabric.core:
    tags:
      - pcie
    platform_allow:
      - native_sim
      - native_sim/native/64
    integration_platforms:
      - native_sim/native/64
```

## tests/drivers/ptp_clock/mv88e6xxx_tc/testcase.yaml
```yaml
tests:
  drivers.ptp_clock.mv88e6xxx_tc:
    platform_allow:
      - native_sim
      - native_sim/native/64
    integration_platforms:
      - native_sim
    tags:
      - ptp_clock
```

## tests/net/dsa_tag_mv88e6xxx/testcase.yaml
```yaml
tests:
  net.dsa.tag_mv88e6xxx:
    platform_allow:
      - native_sim
      - native_sim/native/64
    integration_platforms:
      - native_sim
    tags:
      - net
      - dsa
```

## tests/subsys/lab/agent/testcase.yaml
```yaml
common:
  tags:
    - lab
    - net
  platform_allow:
    - native_sim/native/64
  integration_platforms:
    - native_sim/native/64
tests:
  lab.agent.loopback: {}
```

## tests/subsys/lab/ext/testcase.yaml
```yaml
common:
  tags:
    - llext
    - lab
  arch_allow: arm64
  integration_platforms:
    - qemu_cortex_a53
tests:
  lab.ext.loader:
    filter: CONFIG_MMU
```
