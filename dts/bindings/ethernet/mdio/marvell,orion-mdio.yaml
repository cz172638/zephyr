## dts/bindings/pcie/endpoint/zephyr,pcie-epf-nvme.yaml
```yaml
# Copyright (c) 2026 Jiri Kastner
# SPDX-License-Identifier: Apache-2.0

description: |
  NVMe endpoint function: the endpoint as an NVM Express controller (class
  01:08:02 whatever class-code says), one namespace per Zephyr disk. Modelled on the Linux NVMe PCI
  endpoint target (drivers/nvme/target/pci-epf.c); the host's stock nvme
  driver binds to it. BAR0 carries the controller registers, the
  doorbells and the MSI-X table. Child of a PCIe endpoint controller node.

  Example, two SATA disks (port, port multiplier port 1):

    nvme0: function@0 {
            compatible = "zephyr,pcie-epf-nvme";
            reg = <0>;
            vendor-id = <0x11ab>;
            device-id = <0x0100>;
            memory-region = <&pcie_bar_mem>;
            disk-names = "sata0", "sata1";
    };

compatible: "zephyr,pcie-epf-nvme"

include: pcie-epf.yaml

properties:
  memory-region:
    type: phandle
    description: |
      Memory backing BAR0 (registers, doorbells, MSI-X table), reachable by
      the PCIe controller. Without it BAR0 is a static buffer.

  disk-names:
    type: string-array
    required: true
    description: |
      disk_access names; entry n is namespace n + 1. A disk that is not
      there is an inactive namespace and is looked for again on the next
      identify.

  serial-number:
    type: string
    description: |
      Controller serial number (20 characters at most). Default: the
      Device Serial Number of the function in hex.

  model-number:
    type: string
    default: "Zephyr NVMe endpoint"
    description: Model number (40 characters at most).

  io-queues:
    type: int
    default: 4
    description: |
      I/O submission/completion queue pairs offered, at most
      CONFIG_PCIE_EPF_NVME_MAX_IO_QUEUES. Commands run one at a time, more
      queues only save the host its locking.

  max-queue-entries:
    type: int
    default: 256
    description: CAP.MQES + 1, the largest queue the host may create.

  msix-interrupts:
    type: int
    default: 16
    description: MSI-X vectors, table in BAR0 (0 = no MSI-X).

  msi-interrupts:
    type: int
    default: 16
    description: MSI vectors (0 = no MSI).
```

## dts/bindings/pcie/endpoint/zephyr,pcie-epf-test.yaml
```yaml
# Copyright (c) 2026 Jiri Kastner
# SPDX-License-Identifier: Apache-2.0

description: |
  PCIe endpoint test function, register compatible with the Linux
  pci_endpoint_test host driver (drivers/misc/pci_endpoint_test.c) and the
  pcitest / kselftest pci_endpoint tools. Child of a PCIe endpoint
  controller node.

compatible: "zephyr,pcie-epf-test"

include: pcie-epf.yaml

properties:
  memory-region:
    type: phandle
    required: true
    description: |
      Non-cacheable memory backing the BARs. Must be reachable by the PCIe
      controller (DDR carveout), not core-local TCM.

  memory-offset:
    type: int
    default: 0
    description: |
      Start of this function's part of memory-region, so several functions
      (e.g. SR-IOV VFs) can share one carveout.

  memory-size:
    type: int
    description: Size of that part; the rest of the region when absent.

  bar-sizes:
    type: array
    default: [512, 512, 1024, 16384, 131072, 1048576]
    description: Size of BAR0..BAR5 in bytes, 0 disables the BAR.

  test-reg-bar:
    type: int
    default: 0
    description: BAR carrying the test register block.

  msi-interrupts:
    type: int
    default: 16
    description: Number of MSI vectors to advertise.

  msix-interrupts:
    type: int
    default: 0
    description: Number of MSI-X vectors to advertise (0 = MSI-X off).
```

## dts/bindings/pcie/endpoint/zephyr,pcie-epf-vntb.yaml
```yaml
# Copyright (c) 2026 Jiri Kastner
# SPDX-License-Identifier: Apache-2.0

description: |
  vNTB endpoint function: a Non-Transparent Bridge between the PCIe host
  and Zephyr, the counterpart of the Linux pci-epf-vntb function. The host
  runs the ntb_hw_epf driver, which picks the BAR layout by vendor and
  device ID, so the IDs and the BARs here must match one of its entries:

    ID          class   config  doorbell  windows
    1957:0809   0500xx  BAR0    BAR2      BAR4 (BAR5)    (i.MX8)
    1912:0030   0500xx  BAR0    BAR4      BAR2           (R-Car)
    104c:b00d   0500xx  BAR0    BAR2      BAR2..BAR5     (J721E; peer
                                                          scratchpads in BAR1)

  The J721E layout puts the doorbells and the first window into one BAR
  and the scratchpads into another, neither of which this function
  does: use the i.MX8 or R-Car layout. Zephyr sees the bridge through the
  NTB API (zephyr/drivers/ntb.h). Child of a PCIe endpoint controller.

  Example, i.MX8 layout, one 4 MiB window:

    vntb0: function@0 {
            compatible = "zephyr,pcie-epf-vntb";
            reg = <0>;
            vendor-id = <0x1957>;
            device-id = <0x0809>;
            memory-region = <&pcie_bar_mem>;
            ctrl-bar = <0>;
            db-bar = <2>;
            mw-bars = <4>;
            mw-sizes = <0x400000>;
    };

compatible: "zephyr,pcie-epf-vntb"

include: pcie-epf.yaml

properties:
  class-code:
    default: 0x050000
    description: |
      24-bit class code; ntb_hw_epf matches 05:00 (memory controller,
      RAM).

  memory-region:
    type: phandle
    description: |
      Memory backing the BARs, reachable by the PCIe controller. Each BAR
      is placed aligned to its size, largest first. Without it the BARs
      live in a static buffer (CONFIG_PCIE_EPF_VNTB_STATIC_MEM_SIZE).

  ctrl-bar:
    type: int
    default: 0
    description: |
      BAR of the control region, the MSI-X table and the scratchpads of
      both sides.

  db-bar:
    type: int
    default: 2
    description: BAR of the doorbell slots, one 32-bit word each.

  mw-bars:
    type: array
    default: [4]
    description: BARs of the memory windows (1 to 4), local memory the host writes.

  mw-sizes:
    type: array
    default: [0x100000]
    description: |
      Size of each memory window in bytes, one entry per mw-bars entry;
      rounded up to what the controller can do (a power of two).

  spad-count:
    type: int
    default: 64
    description: Scratchpads on each side.

  db-count:
    type: int
    default: 8
    description: |
      Interrupt slots, 3 to 32: the link event, a slot the protocol keeps
      unused, and db-count - 2 doorbells. Also the MSI-X table size.
```

## dts/bindings/pinctrl/marvell,armada3710-nb-pinctrl.yaml
```yaml
# Copyright (c) 2026 Jiri Kastner
# SPDX-License-Identifier: Apache-2.0

description: |
  Marvell Armada 37xx north bridge pin controller. Pin states are nodes
  whose children each select one pin group:

    &pinctrl_sb {
      eth0_default: eth0_default {
        rgmii {
          marvell,bridge = <A37XX_SB>;
          marvell,mask = <A37XX_SB_RGMII>;
          marvell,value = <0>;          /* 0 = function, mask = GPIO */
        };
      };
    };

  The same layout is used under the north bridge node.

compatible: "marvell,armada3710-nb-pinctrl"

include: base.yaml

properties:
  reg:
    required: true

child-binding:
  description: Pin state
  child-binding:
    description: One pin group
    properties:
      marvell,bridge:
        type: int
        required: true
        description: A37XX_NB (0) or A37XX_SB (1)
      marvell,mask:
        type: int
        required: true
      marvell,value:
        type: int
        required: true
```

## dts/bindings/pinctrl/rockchip,rk3399-pinctrl.yaml
```yaml
# Copyright (c) 2026 Jiri Kastner
# SPDX-License-Identifier: Apache-2.0

description: |
  Rockchip RK3399 pin controller (iomux and pull in GRF/PMUGRF).

  Each child node is a pin state referenced from pinctrl-N; its children
  are groups:

    spi1_pins: spi1-pins {
      group {
        pinmux = <RK_PINMUX(1, RK_PA7, 2, RK_PULL_UP)>, ...;
      };
    };

compatible: "rockchip,rk3399-pinctrl"

include: base.yaml

child-binding:
  description: Pin state
  child-binding:
    description: Pin group
    properties:
      pinmux:
        type: array
        required: true
        description: RK_PINMUX(bank, pin, function, pull) cells
```

## dts/bindings/reset/rockchip,rk3399-cru-rst.yaml
```yaml
# Copyright The Zephyr Project Contributors
# SPDX-License-Identifier: Apache-2.0

title: Rockchip RK3399 CRU soft reset controller

description: |
  Soft reset controller of an RK3399 CRU or PMUCRU. Reset specifiers are
  (SOFTRST_CON index * 16) + bit, see
  include/zephyr/dt-bindings/reset/rk3399-cru-reset.h.

compatible: "rockchip,rk3399-cru-rst"

include: [reset-controller.yaml, base.yaml]

properties:
  "#reset-cells":
    const: 1

  rockchip,softrst-offset:
    type: int
    required: true
    description: Offset of SOFTRST_CON0 in the parent block (CRU 0x400, PMUCRU 0x110).

reset-cells:
  - id
```

## dts/bindings/sdhc/marvell,armada-3700-sdhci.yaml
```yaml
# Copyright (c) 2026 Jiri Kastner
# SPDX-License-Identifier: Apache-2.0

description: |
  Marvell Xenon SD host controller of the Armada 3700: SDHCI v3 slot with
  Xenon system registers and eMMC PHY. The second register is the SoC pad
  control of the slot (0: 3.3 V, 1: 1.8 V IO pads).

compatible: "marvell,armada-3700-sdhci"

include: [sdhc.yaml, pinctrl-device.yaml]

properties:
  reg:
    required: true
    description: Controller registers, then the SoC pad control register.

  reg-names:
    required: true
    description: '"base", "pad"'

  interrupts:
    required: true

  clocks:
    required: true

  bus-width:
    type: int
    default: 4
    enum: [1, 4, 8]

  non-removable:
    type: boolean
    description: Soldered device (eMMC), always present.

  cd-gpios:
    type: phandle-array
    description: Card detect GPIO.

  vqmmc-supply:
    type: phandle
    description: |
      Regulator of the IO voltage. Without one the slot signals at 3.3 V
      only (no UHS).

  marvell,pad-type:
    type: string
    default: "sd"
    enum:
      - "sd"
      - "fixed-1-8v"
    description: |
      "sd": pads at 3.3 V, 1.8 V after a voltage switch; "fixed-1-8v":
      eMMC on 1.8 V pads.

  no-1-8-v:
    type: boolean
    description: |
      Do not offer 1.8 V signalling (no UHS voltage switch) even with a
      vqmmc-supply.
```

## dts/bindings/sdhc/rockchip,rk3399-dw-mshc.yaml
```yaml
# Copyright (c) 2026 Jiri Kastner
# SPDX-License-Identifier: Apache-2.0

description: |
  Synopsys DesignWare Mobile Storage Host (dw_mmc) as the RK3399 SDMMC
  slot. The CIU clock is the CRU clock divided by 2 inside the SoC.

compatible: "rockchip,rk3399-dw-mshc"

include: [sdhc.yaml, pinctrl-device.yaml]

properties:
  reg:
    required: true

  clocks:
    required: true

  clock-names:
    required: true
    description: Must be "biu" (AHB), "ciu" (card clock source).

  bus-width:
    type: int
    default: 4
    enum: [1, 4, 8]

  broken-cd:
    type: boolean
    description: No card detect; the card is assumed present.

  rockchip,grf:
    type: phandle
    description: GRF syscon; the driver clears GRF_SOC_CON7.force_jtag.

  rockchip,sd-jtag:
    type: boolean
    description: |
      JTAG through the micro SD slot: GRF_SOC_CON7.force_jtag stays set
      (JTAG on the pins while card detect says no card), and a breakout
      that card detect takes for a card (no command answered after
      power-on) gets the pins muxed to JTAG by hand. Without it,
      force_jtag is cleared. Needs rockchip,grf.
```

## dts/bindings/sdhc/rockchip,rk3399-sdhci-5.1.yaml
```yaml
# Copyright (c) 2026 Jiri Kastner
# SPDX-License-Identifier: Apache-2.0

description: |
  RK3399 eMMC controller: Arasan SDHCI 5.1, the eMMC PHY and the core
  configuration live in the GRF.

compatible: "rockchip,rk3399-sdhci-5.1"

include: sdhc.yaml

properties:
  reg:
    required: true

  clocks:
    required: true

  clock-names:
    required: true
    description: Must be "clk_xin" (base clock), "clk_ahb".

  rockchip,grf:
    type: phandle
    required: true

  max-frequency:
    type: int
    default: 200000000
    description: Base clock asked from the CRU (GPLL / n not above it).

  bus-width:
    type: int
    default: 8
    enum: [1, 4, 8]
```

## dts/bindings/serial/marvell,armada-3700-uart.yaml
```yaml
# Copyright (c) 2026 Jiri Kastner
# SPDX-License-Identifier: Apache-2.0

description: Marvell Armada 3700 standard UART

compatible: "marvell,armada-3700-uart"

include: [uart-controller.yaml, pinctrl-device.yaml]

properties:
  reg:
    required: true

  interrupts:
    description: Needed for the interrupt driven API (not on the CM3).

  interrupt-names:
    description: Must contain "uart-sum".

  clock-frequency:
    type: int
    description: |
      Base clock of the baud generator. When given together with
      current-speed the divider is reprogrammed; otherwise the bootloader
      setting is kept.
```

## dts/bindings/serial/zephyr,uart-ipc.yaml
```yaml
# Copyright (c) 2026 Jiri Kastner
# SPDX-License-Identifier: Apache-2.0

description: |
  UART on an IPC service endpoint: the bytes go to the remote core,
  which puts them on its real UART (and sends its input back). Lets a
  core without a UART of its own have a console and a shell.

compatible: "zephyr,uart-ipc"

include: uart-controller.yaml

properties:
  ipc-instance:
    type: string
    required: true
    description: |
      Name of the IPC service instance node (zephyr,ipc-icmsg, ...). A
      name, not a phandle: the UART is a console from PRE_KERNEL_1, the
      IPC backend only comes up in POST_KERNEL.

  endpoint-name:
    type: string
    default: "console"
    description: Endpoint name, the same on both cores
```

## dts/bindings/spi/marvell,armada-3700-spi.yaml
```yaml
# Copyright (c) 2026 Jiri Kastner
# SPDX-License-Identifier: Apache-2.0

description: Marvell Armada 3700 SPI controller

compatible: "marvell,armada-3700-spi"

include: [spi-controller.yaml, pinctrl-device.yaml]

properties:
  reg:
    required: true

  clocks:
    required: true
```
