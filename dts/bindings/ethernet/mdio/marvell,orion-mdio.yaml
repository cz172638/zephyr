## dts/bindings/ethernet/mdio/marvell,orion-mdio.yaml
```yaml
# Copyright (c) 2026 Jiri Kastner
# SPDX-License-Identifier: Apache-2.0

description: Marvell Orion SMI (clause 22 MDIO) controller

compatible: "marvell,orion-mdio"

include: [mdio-controller.yaml, pinctrl-device.yaml]

properties:
  reg:
    required: true

  clocks:
    description: |
      Optional gate clock of the block containing the SMI register (on
      Armada 3700, the GbE0 core clock).

  pinctrl-0:
    description: Optional MDC/MDIO pin configuration.
```

## dts/bindings/ethernet/phy/marvell,mv88e6085.yaml
```yaml
# Copyright (c) 2026 Jiri Kastner
# SPDX-License-Identifier: Apache-2.0

description: |
  Marvell 88E6xxx (Link Street) Ethernet switch, minimal bring-up.

  The switch is presented to the MAC as its PHY. It is configured so that
  every user port forwards only to the CPU port and the CPU port to all
  user ports (no DSA tagging, one network interface). The reported link is
  up while any user port has link.

  Only multi-chip addressing is supported: reg is the switch SMI address
  (non-zero) on the parent MDIO bus. Internal PHYs are expected at
  0x10 + port number, as on the 88E6341/6390 families.

  Example (ESPRESSObin, 88E6341):

    &mdio {
        switch0: ethernet-switch@1 {
            compatible = "marvell,mv88e6085";
            reg = <1>;
            marvell,cpu-port = <0>;
            marvell,user-ports = [01 02 03];
        };
    };

compatible: "marvell,mv88e6085"

include: phy.yaml

on-bus: mdio

properties:
  reg:
    required: true
    description: Switch SMI address (multi-chip mode).

  marvell,cpu-port:
    type: int
    default: 0
    description: Switch port connected to the MAC.

  marvell,user-ports:
    type: uint8-array
    required: true
    description: Front panel ports with internal PHYs.

  marvell,cpu-port-mac-ctl:
    type: int
    default: 0xe002
    description: |
      Value for the CPU port "Physical Control" register (port register 1).
      The default enables the RGMII RX and TX timing delays in the switch
      and selects 1000 Mb/s, as U-Boot does on the ESPRESSObin.
```

## dts/bindings/flash_controller/marvell,armada-3700-rwtm-flash.yaml
```yaml
# Copyright (c) 2026 Jiri Kastner
# SPDX-License-Identifier: Apache-2.0

description: |
  SPI NOR of the Armada 3700 reached through the Cortex-M3: requests over
  the rWTM mailbox, data in a shared DDR buffer (reg, as each core sees
  it). The A53 side has one soc-nv-flash child (size, erase block,
  partitions); the CM3 side names the flash it serves.

compatible: "marvell,armada-3700-rwtm-flash"

include: flash-controller.yaml

properties:
  reg:
    required: true
    description: Shared buffer

  mboxes:
    required: true
    description: tx and rx channel (the same rWTM channel)

  mbox-names:
    required: true
    description: '"tx", "rx"'

  zephyr,flash-server:
    type: phandle
    description: CM3 side only, the flash it serves
```

## dts/bindings/gpio/marvell,armada-3700-gpio.yaml
```yaml
# Copyright (c) 2026 Jiri Kastner
# SPDX-License-Identifier: Apache-2.0

description: |
  GPIO bank of the Marvell Armada 3700 north or south bridge: output
  enable at reg + 0x00, input values at + 0x10, output values at + 0x18.
  The north bridge has 36 pins, pins 32..35 are a second bank at the
  base + 4. Pin muxing is done by the pin controller.

compatible: "marvell,armada-3700-gpio"

include: [gpio-controller.yaml, base.yaml]

properties:
  reg:
    required: true

  "#gpio-cells":
    const: 2

gpio-cells:
  - pin
  - flags
```

## dts/bindings/mbox/marvell,armada-3700-rwtm-mailbox.yaml
```yaml
# Copyright (c) 2026 Jiri Kastner
# SPDX-License-Identifier: Apache-2.0

description: |
  Marvell Armada 3700 rWTM mailbox, A53 (host) side: commands to the
  Cortex-M3 secure processor, its replies and doorbells raise the host
  interrupt. Channel n is command 0x200 + n; commands below 0x200 are the
  ones of the Marvell/CZ.NIC WTMI firmware (9 reboot, ...).

compatible: "marvell,armada-3700-rwtm-mailbox"

include: [base.yaml, mailbox-controller.yaml]

properties:
  reg:
    required: true

  interrupts:
    required: true

mbox-cells:
  - channel
```

## dts/bindings/mbox/marvell,armada-3700-rwtm-sp.yaml
```yaml
# Copyright (c) 2026 Jiri Kastner
# SPDX-License-Identifier: Apache-2.0

description: |
  Marvell Armada 3700 rWTM mailbox, Cortex-M3 (secure processor) side:
  the A53 commands arrive on NVIC line 2, replies raise the host
  interrupt. Same channel encoding as marvell,armada-3700-rwtm-mailbox.

compatible: "marvell,armada-3700-rwtm-sp"

include: [base.yaml, mailbox-controller.yaml]

properties:
  reg:
    required: true

  interrupts:
    required: true

mbox-cells:
  - channel
```

## dts/bindings/pcie/controller/marvell,armada-3700-pcie.yaml
```yaml
# Copyright (c) 2026 Jiri Kastner
# SPDX-License-Identifier: Apache-2.0

description: |
  Marvell Armada 3700 (Aardvark) PCIe controller as root complex.

  The same controller as marvell,armada-3700-pcie-ep; with both nodes
  enabled the role is picked at boot (CONFIG_PCIE_AARDVARK_MODE).

compatible: "marvell,armada-3700-pcie"

include: [pcie-controller.yaml, pinctrl-device.yaml]

properties:
  reg:
    required: true

  reg-names:
    required: true
    description: |
      "ctrl": controller registers, "comphy": COMPHY lane 1 registers.

  ranges:
    required: true
    description: |
      PCI memory (and I/O) ranges in the AXI window 0xe8000000-0xefffffff,
      mapped by outbound windows in power-of-two pieces (at most 8).

  clocks:
    required: true

  interrupts:
    description: Controller interrupt (not used yet).

  perst-gpios:
    type: phandle-array
    description: PERST# to the slot.

  num-lanes:
    type: int
    default: 1

  max-link-speed:
    type: int
    default: 2

  marvell,comphy-lane:
    type: int
    default: 1

  marvell,comphy-polarity-invert:
    type: int
    default: 0
    enum: [0, 1, 2, 3]
```

## dts/bindings/pcie/controller/rockchip,rk3399-pcie.yaml
```yaml
# Copyright (c) 2026 Jiri Kastner
# SPDX-License-Identifier: Apache-2.0

description: |
  Rockchip RK3399 PCIe controller as root complex (Cadence core behind
  the Rockchip client wrapper, PHY in the GRF).

  The same controller as rockchip,rk3399-pcie-ep; with both nodes
  enabled the role is picked at boot (CONFIG_PCIE_ROLE).

  "apb" (16 MiB): client registers at 0, the Cadence core at 0x800000.
  "cfg" (32 MiB at 0xf8000000): configuration requests through
  outbound region 0, ECAM-like (bus << 20 | dev << 15 | fn << 12), so
  buses 0..31. The 32 MiB above it (0xfa000000) is decoded by outbound
  regions 1..32 of 1 MiB each: "ranges" must lie there.

compatible: "rockchip,rk3399-pcie"

include: [pcie-controller.yaml, reset-device.yaml]

properties:
  reg:
    required: true

  reg-names:
    required: true
    description: Must be "apb", "cfg".

  ranges:
    required: true

  clocks:
    required: true

  clock-names:
    required: true
    description: Must be "aclk", "aclk-perf", "hclk", "pm".

  resets:
    required: true

  reset-names:
    required: true
    description: |
      "core", "mgmt", "mgmt-sticky", "pipe", "pm", "pclk", "aclk", "phy".

  rockchip,grf:
    type: phandle
    required: true

  num-lanes:
    type: int
    default: 4
    enum: [1, 2, 4]

  max-link-speed:
    type: int
    default: 2
    enum: [1, 2]

  perst-gpios:
    type: phandle-array
    description: PERST# to the slot.

  slot-power-gpios:
    type: phandle-array
    description: Switch of the slot's 3.3 V (ROCK Pi 4 vcc3v3_pcie).
```

## dts/bindings/pcie/endpoint/marvell,armada-3700-pcie-ep.yaml
```yaml
# Copyright (c) 2026 Jiri Kastner
# SPDX-License-Identifier: Apache-2.0

description: |
  Marvell Armada 3700 (Aardvark) PCIe controller in endpoint mode.

  The COMPHY lane is powered through the TF-A SiP service
  MV_SIP_COMPHY_POWER_ON; the PHY's 100/125 MHz clock output it enables
  is switched off again, the endpoint runs on its own reference clock.

compatible: "marvell,armada-3700-pcie-ep"

include: [pcie-ep-controller.yaml, pinctrl-device.yaml]

properties:
  reg:
    required: true

  reg-names:
    required: true
    description: |
      "ctrl": controller registers, "mem": the AXI range decoded to PCIe,
      used for outbound windows (power of two sized and aligned),
      "comphy": COMPHY lane 1 registers (PHY clock output).

  clocks:
    required: true

  interrupts:
    description: Controller interrupt (not used yet, the driver polls).

  perst-gpios:
    type: phandle-array
    description: |
      PERST# from the host. The controller's PCIE_RESETn pin is an output,
      so it has to come in through a GPIO. Without it training is enabled
      once and the link state is polled.

  marvell,comphy-lane:
    type: int
    default: 1
    description: COMPHY lane carrying PCIe (lane 1 on the A3720).

  marvell,comphy-polarity-invert:
    type: int
    default: 0
    enum: [0, 1, 2, 3]
    description: COMPHY polarity inversion, bit 0 TX, bit 1 RX.

  marvell,refclk-in:
    type: boolean
    description: |
      Switch the REFCLK pins to input (common clock from the host).
      Default is the setup known to work: REFCLK not connected, the
      PHY's clock output off, each side on its own reference.

  memory-region:
    type: phandle
    description: |
      The DDR range inbound TLPs may reach, normally the functions' BAR
      backing store: the PCIe IO decode window is set to exactly this
      range (base and size in 64 KiB units), the host gets a completer
      abort anywhere else. Without it the window is DDR 0 up to
      CONFIG_PCIE_EPC_AARDVARK_INBOUND_LIMIT.

  marvell,comphy-skip:
    type: boolean
    description: Do not call the COMPHY SiP service (debugging).
```

## dts/bindings/pcie/endpoint/pcie-ep-controller.yaml
```yaml
# Copyright (c) 2026 Jiri Kastner
# SPDX-License-Identifier: Apache-2.0

description: |
  Common properties of PCIe endpoint controllers driven through the
  pcie_epc API. Endpoint functions are child nodes; their unit address
  (reg) is the physical function number.

include: base.yaml

properties:
  max-functions:
    type: int
    default: 1
    description: Number of physical functions the controller exposes.

  max-virtual-functions:
    type: int
    default: 0
    description: |
      SR-IOV virtual functions of physical function 0. EPF child nodes
      address them by routing function number: max-functions ..
      max-functions + max-virtual-functions - 1 (First VF Offset =
      max-functions, stride 1).

  max-link-speed:
    type: int
    description: Highest PCIe generation to train to (1..4).

  num-lanes:
    type: int
    description: Number of lanes to use.

  zephyr,no-autostart:
    type: boolean
    description: |
      Do not start link training automatically after the endpoint
      functions bound; the application calls pcie_epc_start().

  "#address-cells":
    const: 1

  "#size-cells":
    const: 0
```

## dts/bindings/pcie/endpoint/pcie-epf.yaml
```yaml
# Copyright (c) 2026 Jiri Kastner
# SPDX-License-Identifier: Apache-2.0

description: Common properties of PCIe endpoint functions.

include: base.yaml

properties:
  reg:
    required: true
    description: Physical function number.

  vendor-id:
    type: int
    required: true

  device-id:
    type: int
    required: true

  revision-id:
    type: int

  class-code:
    type: int
    description: 24-bit class code (base << 16 | sub << 8 | prog-if).

  subsystem-vendor-id:
    type: int

  subsystem-id:
    type: int

  interrupt-pin:
    type: int
    description: 0 = none, 1 = INTA ... 4 = INTD. Default INTA.
```

## dts/bindings/pcie/endpoint/rockchip,rk3399-pcie-ep.yaml
```yaml
# Copyright The Zephyr Project Contributors
# SPDX-License-Identifier: Apache-2.0

title: Rockchip RK3399 PCIe endpoint controller

description: |
  PCIe Gen2 x4 controller of the RK3399 in endpoint mode. The controller is
  a Cadence PCIe IP (older LGA revision) behind a Rockchip "client" wrapper;
  the integrated PCIe PHY is controlled through the GRF.

  The apb region (16 MiB) holds the client registers at offset 0 and
  the Cadence core at offset 0x800000. The mem region (32 MiB) is the
  AXI outbound window, split into 32 regions of 1 MiB.

compatible: "rockchip,rk3399-pcie-ep"

include: [pcie-ep-controller.yaml, reset-device.yaml]

properties:
  reg:
    required: true

  reg-names:
    required: true
    description: Must be "apb", "mem".

  clocks:
    required: true

  clock-names:
    required: true
    description: Must be "aclk", "aclk-perf", "hclk", "pm".

  resets:
    required: true

  reset-names:
    required: true
    description: |
      Must contain "core", "mgmt", "mgmt-sticky", "pipe", "pm", "pclk",
      "aclk" and "phy".

  rockchip,grf:
    type: phandle
    required: true
    description: GRF syscon holding the PCIe PHY configuration registers.

  num-lanes:
    type: int
    default: 4
    enum: [1, 2, 4]
    description: Number of lanes to train.

  max-link-speed:
    type: int
    default: 1
    enum: [1, 2]
    description: 1 = 2.5 GT/s, 2 = 5 GT/s.

  perst-gpios:
    type: phandle-array
    description: |
      PERST# input from the host. Without it, link training starts as soon
      as pcie_epc_start() is called.

  slot-power-gpios:
    type: phandle-array
    description: |
      Switch of the slot's 3.3 V; driven off in the endpoint role (the
      host powers the link partner, not us).

  vendor-id:
    type: int
    description: Vendor ID of function 0. Hardware reset value when absent.

  device-id:
    type: int
    description: Device ID of function 0. Hardware reset value when absent.

  class-code:
    type: int
    default: 0xff0000
    description: Class code of function 0 (base << 16 | sub << 8 | prog-if).

  subsystem-vendor-id:
    type: int
    default: 0

  subsystem-id:
    type: int
    default: 0

  msi-vectors:
    type: int
    default: 1
    enum: [1, 2, 4, 8, 16, 32]
    description: MSI vectors advertised by function 0.
```

## dts/bindings/pcie/endpoint/zephyr,pcie-epf-fabric.yaml
```yaml
# Copyright (c) 2026 Jiri Kastner
# SPDX-License-Identifier: Apache-2.0

description: |
  PCIe fabric endpoint function: this endpoint is a node of a fabric
  run by the root complex (zephyr/drivers/pcie/fabric.h). BAR0 is the
  node's region: info block, the card the root complex writes (node ID,
  role, peers), credits, receive rings and an RMA window. The other
  nodes write into it directly, peer to peer through the switches; the
  function writes into theirs through the outbound window.

  The root complex finds the node by the PFAB magic at BAR0 + 0, the IDs
  are only for lspci. Child of a PCIe endpoint controller.

    fabric0: fabric@0 {
            compatible = "zephyr,pcie-epf-fabric";
            reg = <0>;
            vendor-id = <0x11ab>;
            device-id = <0xfab1>;
            memory-region = <&pcie_bar_mem>;
            roles = <0x4>;            /* compute */
    };

compatible: "zephyr,pcie-epf-fabric"

include: pcie-epf.yaml

properties:
  class-code:
    default: 0x0b4000
    description: 24-bit class code; default processor, co-processor.

  memory-region:
    type: phandle
    description: |
      Memory backing BAR0, reachable by the PCIe controller, uncached.
      Without it a static buffer (CONFIG_PCIE_EPF_FABRIC_STATIC_MEM).

  region-size:
    type: int
    default: 0x10000
    description: BAR0 size in bytes, a power of two (rings + RMA window).

  roles:
    type: int
    default: 0x4
    description: |
      Roles this node can take, bit n = role n (1 manager, 2 compute,
      3 storage, 4 io, others free). The root complex picks one.
```
