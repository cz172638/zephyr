## drivers/pcie/Kconfig
```kconfig
# PCIe RC/EP drivers configuration options

config PCIE_AARDVARK_MODE
	bool "Armada 3700 PCIe: root complex or endpoint from settings"
	default y
	depends on DT_HAS_MARVELL_ARMADA_3700_PCIE_ENABLED
	depends on DT_HAS_MARVELL_ARMADA_3700_PCIE_EP_ENABLED
	depends on SETTINGS
	help
	  With both the root complex and the endpoint driver built in, the
	  setting "advk/mode" ("rc" or "ep") picks the role at boot;
	  "pcie controller mode rc|ep" in the shell stores it for the next
	  boot. The
	  driver not picked leaves the controller alone.

if PCIE_AARDVARK_MODE

config PCIE_AARDVARK_MODE_DEFAULT_RC
	bool "Root complex when nothing is saved"
	help
	  Without it the controller stays an endpoint, its reset role.

config PCIE_AARDVARK_MODE_INIT_PRIORITY
	int "POST_KERNEL priority of the mode lookup"
	default 81
	help
	  After the settings flash (SPI_NOR_INIT_PRIORITY), before both
	  controller drivers.

# Both controller drivers after the mode lookup
configdefault PCIE_EPC_INIT_PRIORITY
	default 82

configdefault PCIE_EPF_INIT_PRIORITY
	default 83

endif # PCIE_AARDVARK_MODE

config PCIE_ROLE
	bool "Dual-mode PCIe controller: root complex or endpoint at boot"
	default y
	depends on DT_HAS_ROCKCHIP_RK3399_PCIE_ENABLED && DT_HAS_ROCKCHIP_RK3399_PCIE_EP_ENABLED
	help
	  With both the root complex and the endpoint driver of a dual-mode
	  controller built in, pick the role at boot (see
	  zephyr/drivers/pcie/role.h); "pcie controller mode rc|ep" stores
	  it for the next boot.

if PCIE_ROLE

config PCIE_ROLE_DEFAULT_RC
	bool "Root complex when nothing is saved"

config PCIE_ROLE_SETTINGS
	bool "Keep the role in settings"
	depends on SETTINGS

config PCIE_ROLE_RETENTION_REG
	hex "Keep the role in this register (survives warm reset), 0 = nowhere"
	default 0xff320304 if SOC_RK3399
	default 0
	help
	  RK3399: PMUGRF_OS_REG1 (OS_REG0 is the boot mode register, OS_REG2/3
	  hold the DRAM configuration). Written on every save; read when
	  settings have no role or are unavailable.

config PCIE_ROLE_INIT_PRIORITY
	int "POST_KERNEL priority of the role lookup"
	default 81

configdefault PCIE_EPC_INIT_PRIORITY
	default 82

configdefault PCIE_EPF_INIT_PRIORITY
	default 83

# the link autostart walks the registered controllers: after them
configdefault PCIE_EPC_AUTOSTART_PRIORITY
	default 90 if PCIE_EPC_DSN_SETTINGS
	default 85

endif # PCIE_ROLE

config PCIE_RK3399_PORT
	bool
	help
	  RK3399 PCIe bring-up shared by the root complex and the endpoint
	  driver: clocks, resets, client wrapper, PHY.

source "drivers/pcie/host/Kconfig"
source "drivers/pcie/endpoint/Kconfig"
source "drivers/pcie/controller/Kconfig"
source "drivers/pcie/fabric/Kconfig"

config PCIE_AER
	bool "Advanced Error Reporting below a root port"
	depends on PCIE_CONTROLLER
	help
	  Controller neutral helpers: walk the tree under a root port, enable
	  error reporting and forwarding on every function, service the root
	  port's received error messages and count them per source. Used by
	  root complex drivers after the enumeration; "pcie aer" in the
	  shell.

config PCIE_AER_SOURCES
	int "Error sources counted"
	default 16
	depends on PCIE_AER

config PCIE_AER_UR_EP
	bool "Unsupported Request reporting on endpoints"
	default y
	depends on PCIE_AER

config PCIE_AER_UR_BRIDGE
	bool "Unsupported Request reporting on ports and bridges"
	depends on PCIE_AER
	help
	  Off by default: config reads of absent functions below a port end
	  with UR, every rescan would report.

config PCIE_AER_ECRC
	bool "ECRC generation and check where capable"
	depends on PCIE_AER
	help
	  End-to-end CRC (TLP digest). Switches pass it through; both ends
	  have to be capable for a check to mean anything.

config PCIE_AER_LOG_LIMIT
	int "Messages logged per source (then counted only)"
	default 16
	depends on PCIE_AER

config PCIE_CTRL_SHELL
	bool "Controller-neutral pcie shell"
	default y
	depends on SHELL
	depends on PCIE_CONTROLLER || PCIE_EPC
	depends on !PCIE_SHELL
	help
	  "pcie controller | ls | cfg | cap | debug": the same commands for
	  root complex and endpoint controllers of any vendor; the drivers
	  register a backend (pcie_shell_register()). Replaces the generic
	  PCIE_SHELL, which uses the same command name.
```

## drivers/pcie/controller/Kconfig
```kconfig
# PCIe controller configuration options

# Copyright 2024 TSN Lab, Inc.
# SPDX-License-Identifier: Apache-2.0

if PCIE_CONTROLLER

# zephyr-keep-sorted-start
source "drivers/pcie/controller/Kconfig.aardvark"
source "drivers/pcie/controller/Kconfig.brcmstb"
source "drivers/pcie/controller/Kconfig.ecam"
source "drivers/pcie/controller/Kconfig.rk3399"
# zephyr-keep-sorted-stop

endif # PCIE_CONTROLLER
```

## drivers/pcie/controller/Kconfig.aardvark
```kconfig
# Copyright (c) 2026 Jiri Kastner
# SPDX-License-Identifier: Apache-2.0

config PCIE_AARDVARK
	bool "Marvell Armada 3700 (Aardvark) PCIe root complex"
	default y
	depends on DT_HAS_MARVELL_ARMADA_3700_PCIE_ENABLED
	depends on ARM64
	select FLASH_EX_OP_ENABLED if SPI_NOR
	help
	  The Armada 3700 PCIe controller as root complex: configuration
	  requests through the PIO block, a software root port with the
	  hardware's PCIe and extended capabilities (AER, L1SS, LTR) passed
	  through, outbound windows from "ranges", generic enumeration.

if PCIE_AARDVARK

config PCIE_AARDVARK_INIT_PRIORITY
	int "POST_KERNEL init priority"
	default 84
	help
	  After the GPIO, clock and (with PCIE_AARDVARK_MODE) the settings
	  that choose the role.

config PCIE_AARDVARK_CORE_TIMEOUT_MS
	int "Wait for the core registers after the PHY [ms]"
	default 500
	help
	  The core control registers abort for some time after the clock
	  and the COMPHY are switched on.

config PCIE_AARDVARK_PERST_MS
	int "PERST# pulse [ms]"
	default 10

config PCIE_AARDVARK_LINK_TIMEOUT_MS
	int "Wait for the link [ms]"
	default 1000

config PCIE_AARDVARK_CRS_TIMEOUT_MS
	int "Retry a configuration request answered with CRS for, ms"
	default 1000
	help
	  A device still initialising (a switch loading its EEPROM) answers
	  configuration requests with Configuration Request Retry Status.
	  The base specification allows 1 s after a reset; the request is
	  repeated every millisecond for that long, then the function is
	  taken as absent.

config PCIE_AARDVARK_TRACE_INIT
	bool "printk checkpoints in the init"
	help
	  Prints the core control registers after every bring-up step. A
	  step whose registers abort is reported and stops the init
	  in any case.

config PCIE_AARDVARK_AER
	bool "Advanced Error Reporting"
	default y
	depends on PCIE_CONTROLLER
	select PCIE_AER
	help
	  After every enumeration, error reporting on the whole tree (see
	  PCIE_AER); error messages at the root port (ISR0 bits 11-13) are
	  serviced from the system work queue and logged with the source.

config PCIE_AARDVARK_SHELL
	bool "pcie shell backend and debug commands"
	default y
	depends on PCIE_CTRL_SHELL

config PCIE_AARDVARK_EPFTEST_SHELL
	bool "pcie debug epftest: host side of the endpoint test function"
	default y
	depends on PCIE_AARDVARK_SHELL
	select CRC
	help
	  BAR patterns, MSI/MSI-X into the root complex's MSI receiver and
	  read/write/copy into RC memory against a pci-epf-test compatible
	  endpoint (Zephyr pcie_epf_test, Linux pci-epf-test), as pcitest.

config PCIE_AARDVARK_EPFTEST_BUF_KB
	int "Host buffers (two) for epftest, KiB"
	default 1024
	depends on PCIE_AARDVARK_EPFTEST_SHELL

config PCIE_AARDVARK_NVME_SHELL
	bool "pcie debug nvme: polled NVMe identify and read"
	default y
	depends on PCIE_AARDVARK_SHELL
	help
	  Bring-up check of both directions through the controller without
	  interrupts or a disk driver.

endif # PCIE_AARDVARK
```

## drivers/pcie/controller/Kconfig.rk3399
```kconfig
# Copyright (c) 2026 Jiri Kastner
# SPDX-License-Identifier: Apache-2.0

config PCIE_RK3399
	bool "Rockchip RK3399 PCIe root complex"
	default y
	depends on DT_HAS_ROCKCHIP_RK3399_PCIE_ENABLED
	depends on SYSCON && RESET && CLOCK_CONTROL && GPIO
	select PCIE_RK3399_PORT
	help
	  The RK3399 PCIe controller as root complex: hardware root port,
	  configuration requests through outbound region 0, memory and I/O
	  in 1 MiB outbound regions from "ranges", generic enumeration.
	  No interrupts yet (polled devices only).

config PCIE_RK3399_INIT_PRIORITY
	int "POST_KERNEL init priority"
	default 84
	depends on PCIE_RK3399
	help
	  After GPIO, clocks, resets, the GRF and (PCIE_ROLE) the role.
```
