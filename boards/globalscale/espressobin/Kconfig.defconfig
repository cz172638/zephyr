## boards/globalscale/espressobin/Kconfig.espressobin
```kconfig
# Copyright (c) 2026 Jiri Kastner
# SPDX-License-Identifier: Apache-2.0

config BOARD_ESPRESSOBIN
	select SOC_ARMADA3720 if BOARD_ESPRESSOBIN_ARMADA3720 || BOARD_ESPRESSOBIN_ARMADA3720_SMP
	select SOC_ARMADA3720_CM3 if BOARD_ESPRESSOBIN_ARMADA3720_CM3
```

## boards/globalscale/espressobin/board.yml
```yaml
board:
  name: espressobin
  full_name: ESPRESSObin
  vendor: globalscale
  socs:
  - name: armada3720
    variants:
    - name: smp
  - name: armada3720_cm3
```

## boards/globalscale/espressobin/espressobin_armada3720_smp_defconfig
```kconfig
# SPDX-License-Identifier: Apache-2.0

CONFIG_ARM64_VA_BITS_40=y
CONFIG_ARM64_PA_BITS_40=y
CONFIG_CACHE_MANAGEMENT=y
CONFIG_ARMV8_A_NS=y

CONFIG_PINCTRL=y
CONFIG_SERIAL=y
CONFIG_UART_INTERRUPT_DRIVEN=y
CONFIG_CONSOLE=y
CONFIG_UART_CONSOLE=y
CONFIG_SMP=y
CONFIG_MP_MAX_NUM_CPUS=2
CONFIG_PM_CPU_OPS=y
```

## boards/radxa/rock_pi_4/Kconfig.rock_pi_4
```kconfig
# Copyright The Zephyr Project Contributors
# SPDX-License-Identifier: Apache-2.0

config BOARD_ROCK_PI_4
	select SOC_RK3399_A53 if BOARD_ROCK_PI_4_RK3399_A53 || BOARD_ROCK_PI_4_RK3399_A53_SMP
	select SOC_RK3399_A72 if BOARD_ROCK_PI_4_RK3399_A72 || BOARD_ROCK_PI_4_RK3399_A72_SMP
	select SOC_RK3399_M0_PMU if BOARD_ROCK_PI_4_RK3399_M0_PMU
	select SOC_RK3399_M0_PERILP if BOARD_ROCK_PI_4_RK3399_M0_PERILP
```

## boards/radxa/rock_pi_4/board.yml
```yaml
board:
  name: rock_pi_4
  full_name: ROCK Pi 4
  vendor: radxa
  socs:
    - name: rk3399
      variants:
        - name: smp
          cpucluster: a53
        - name: smp
          cpucluster: a72
```

## boards/radxa/rock_pi_4/rock_pi_4_rk3399_a72_defconfig
```kconfig
# Copyright The Zephyr Project Contributors
# SPDX-License-Identifier: Apache-2.0

# Platform Configuration
CONFIG_ARM64_VA_BITS_40=y
CONFIG_ARM64_PA_BITS_40=y
CONFIG_ARMV8_A_NS=y
CONFIG_CACHE_MANAGEMENT=y
CONFIG_TICKLESS_KERNEL=y

# Serial Drivers
CONFIG_SERIAL=y
CONFIG_UART_INTERRUPT_DRIVEN=y

# Enable console
CONFIG_CONSOLE=y
CONFIG_UART_CONSOLE=y
```

## boards/radxa/rock_pi_4/rock_pi_4_rk3399_a72_smp_defconfig
```kconfig
# Copyright The Zephyr Project Contributors
# SPDX-License-Identifier: Apache-2.0

# Platform Configuration
CONFIG_ARM64_VA_BITS_40=y
CONFIG_ARM64_PA_BITS_40=y
CONFIG_ARMV8_A_NS=y
CONFIG_CACHE_MANAGEMENT=y
CONFIG_TICKLESS_KERNEL=y

# Serial Drivers
CONFIG_SERIAL=y
CONFIG_UART_INTERRUPT_DRIVEN=y

# Enable console
CONFIG_CONSOLE=y
CONFIG_UART_CONSOLE=y

# SMP support
CONFIG_SMP=y
CONFIG_MP_MAX_NUM_CPUS=2

# PSCI support
CONFIG_PM_CPU_OPS=y
CONFIG_PM_CPU_OPS_PSCI=y
```

## drivers/clock_control/Kconfig.armada37xx
```kconfig
# Copyright (c) 2026 Jiri Kastner
# SPDX-License-Identifier: Apache-2.0

config CLOCK_CONTROL_ARMADA37XX_PERIPH
	bool "Marvell Armada 37xx TBG and peripheral clocks"
	default y
	depends on DT_HAS_MARVELL_ARMADA_3700_PERIPH_CLOCK_SB_ENABLED || \
		   DT_HAS_MARVELL_ARMADA_3700_PERIPH_CLOCK_NB_ENABLED || \
		   DT_HAS_MARVELL_ARMADA_3700_TBG_CLOCK_ENABLED
	help
	  Gates of the north/south bridge peripheral clocks and read-only
	  rates of the TBG PLLs, muxes and dividers.
```

## drivers/clock_control/Kconfig.rockchip
```kconfig
# SPDX-FileCopyrightText: Copyright (c) 2026 KylinSoft Corporation
# SPDX-License-Identifier: Apache-2.0

config CLOCK_CONTROL_ROCKCHIP_RK3588
	bool "Rockchip RK3588 CRU clock controller"
	default y
	depends on DT_HAS_ROCKCHIP_RK3588_CRU_CLK_ENABLED
	help
	  Enable clock gate control for the Rockchip RK3588 CRU.

config CLOCK_CONTROL_ROCKCHIP_RK3399
	bool "Rockchip RK3399 CRU clock controller"
	default y
	depends on DT_HAS_ROCKCHIP_RK3399_CRU_CLK_ENABLED
	help
	  Enable clock gate control for the Rockchip RK3399 CRU and PMUCRU.
```

## drivers/disk/ahci/Kconfig
```kconfig
# Copyright (c) 2026 Jiri Kastner
# SPDX-License-Identifier: Apache-2.0

menuconfig AHCI
	bool "AHCI SATA disk"
	default y
	depends on DT_HAS_MARVELL_ARMADA_3700_AHCI_ENABLED
	select CACHE_MANAGEMENT if ARCH_HAS_CACHE_MANAGEMENT
	help
	  SATA disk on an AHCI host controller (port 0), registered with
	  the disk access subsystem. Armada 3700 glue: SATA PHY on COMPHY
	  lane 2 through the TF-A SiP service.

if AHCI

config AHCI_INIT_PRIORITY
	int "Controller init priority (POST_KERNEL)"
	default 85

config AHCI_BOUNCE_SECTORS
	int "DMA bounce buffer, 512-byte sectors"
	default 128
	range 8 8192
	help
	  Every transfer goes through one cache line aligned bounce buffer;
	  a larger one means fewer commands per request.

config AHCI_LINK_TIMEOUT_MS
	int "PHY communication timeout after COMRESET (ms)"
	default 1000

config AHCI_READY_TIMEOUT_MS
	int "Device ready timeout (ms), covers a rotating disk spinning up"
	default 30000

config AHCI_CMD_TIMEOUT_MS
	int "Command timeout (ms)"
	default 10000

config AHCI_BOOT_PROBE
	bool "Bring the link up and identify the disk at boot (background thread)"
	default y

config AHCI_SHELL
	bool "ata shell"
	default y
	depends on SHELL

module = AHCI
module-str = ahci
source "subsys/logging/Kconfig.template.log_config"

endif # AHCI
```

## drivers/ethernet/Kconfig.mvneta
```kconfig
# Copyright (c) 2026 Jiri Kastner
# SPDX-License-Identifier: Apache-2.0

config ETH_MVNETA
	bool "Marvell NETA (Armada 3700) Ethernet driver"
	default y
	depends on DT_HAS_MARVELL_ARMADA_3700_NETA_ENABLED
	select PINCTRL
	select CLOCK_CONTROL
	select NOCACHE_MEMORY if ARCH_HAS_NOCACHE_MEMORY_SUPPORT
	help
	  Enable the NETA gigabit Ethernet controller of the Marvell
	  Armada 3700 SoC.

if ETH_MVNETA

config ETH_MVNETA_RX_QUEUES
	int "Number of RX queues"
	default NET_TC_RX_COUNT if NET_TC_RX_COUNT > 0
	default 1
	range 1 8
	help
	  VLAN tagged frames are sorted into the queues by their PCP, untagged
	  frames go to queue 0. Higher queues are processed first. With as
	  many queues as RX traffic classes, the stack's priority to traffic
	  class mapping is used.

config ETH_MVNETA_TX_QUEUES
	int "Number of TX queues"
	default NET_TC_TX_COUNT if NET_TC_TX_COUNT > 0
	default 1
	range 1 8
	help
	  Packets are put into the queues by net_pkt priority and sent in
	  strict priority order. With as many queues as TX traffic classes,
	  queue N carries traffic class N (needed for Qav traffic class
	  queries).

config ETH_MVNETA_TXQ0_HIGHEST
	bool "Hardware TX queue 0 has the highest priority"
	help
	  Select which end of the hardware TX queues the strict priority
	  arbiter serves first. The default assumes queue 7 is served first;
	  flip this if measurements show the opposite.

config ETH_MVNETA_RX_DESCS
	int "Number of RX descriptors per queue"
	default 64 if ETH_MVNETA_RX_QUEUES = 1
	default 32
	range 8 1024

config ETH_MVNETA_TX_DESCS
	int "Number of TX descriptors per queue"
	default 32 if ETH_MVNETA_TX_QUEUES = 1
	default 16
	range 4 1024

config ETH_MVNETA_RX_BUDGET
	int "Frames taken from one RX queue before rechecking higher ones"
	default 16
	range 1 1024

config ETH_MVNETA_DMA_COHERENT
	bool "DMA is cache coherent (descriptors and buffers in cached memory)"
	default y
	help
	  Put the rings and buffers in normal cached memory without any
	  cache maintenance. Correct because the NETA DMA snoops the CPU
	  caches through the CCI-400 on the Armada 3720 (verified on the
	  ESPRESSObin: ping and apt dist-upgrade through the router with
	  cached rings). Say n for uncached rings (__nocache).

config ETH_MVNETA_TX_TIMEOUT_MS
	int "Time to wait for a free TX descriptor [ms]"
	default 100
	help
	  A rate limited queue can stay full for a while; send() sleeps in
	  20 us steps up to this time before dropping the packet.

config ETH_MVNETA_RX_COAL_CYCLES
	int "RX time coalescing, in core clock cycles"
	default 0
	help
	  Value of the RX queue time coalescing register. The packet
	  threshold is one frame, so this only matters if the threshold is
	  raised.

config ETH_MVNETA_RX_POLL_MS
	int "RX poll interval without interrupts [ms]"
	default 100
	help
	  The RX thread also polls the ring at this interval, as a safety net
	  against a lost or misrouted interrupt.

config ETH_MVNETA_RX_THREAD_STACK_SIZE
	int "RX thread stack size"
	default 2048

config ETH_MVNETA_RX_THREAD_PRIORITY
	int "RX thread cooperative priority"
	default 2

config ETH_MVNETA_SHELL
	bool "mvneta shell commands"
	depends on SHELL && NET_L2_ETHERNET_MGMT
	help
	  "mvneta queues" and "mvneta qav" to look at the TX queues and set
	  their rate limit through the Ethernet management API, "mvneta regs"
	  and "mvneta sw" to dump MAC and switch state for debugging.

endif # ETH_MVNETA
```

## drivers/ethernet/dsa/Kconfig
```kconfig
# Distributed Switch Architecture [DSA] device configuration options

# Copyright (c) 2020 DENX Software Engineering GmbH
#               Lukasz Majewski <lukma@denx.de>
# Copyright 2025 NXP
# SPDX-License-Identifier: Apache-2.0

menuconfig DSA_DRIVERS
	bool "Distributed Switch Architecture device drivers"
	default y if NET_DSA
	help
	  Enable Distributed Switch Architecture support.

if DSA_DRIVERS

config DSA_NXP_IMX_NETC
	bool "Support for NXP i.MX NETC"
	default y
	depends on DT_HAS_NXP_NETC_SWITCH_ENABLED
	select NET_PKT_CONTROL_BLOCK if PTP_CLOCK_NXP_NETC
	help
	  Add support for NXP i.MX NETC DSA device driver.

config DSA_NXP_IMX_NETC_GCL_LEN
	int "Gate control list length for i.MX NETC switch"
	default 64
	range 1 256
	depends on DSA_NXP_IMX_NETC && NET_QBV
	help
	  Amount of Gate control list to use. Small value saves RAM.
	  The Max of the value can be 64, 128, or 256.

config DSA_MARVELL_MV88E6XXX
	bool "Support for Marvell 88E6xxx (Link Street) switches"
	default y
	depends on DT_HAS_MARVELL_MV88E6XXX_DSA_ENABLED
	depends on PHY_MARVELL_MV88E6XXX
	help
	  DSA driver for Marvell 88E6xxx switches managed by the
	  marvell,mv88e6085 driver, with one interface per user port.
	  Set DSA_TAG_SIZE to 4 for the DSA tag or 8 for EDSA.

# DSA tag protocol drivers
#   Tag protocol ID found in <zephyr/dt-bindings/ethernet/dsa_tag_proto.h>

config DSA_TAG_PROTOCOL_NETC
	bool "Tag protocol - NETC"
	default y
	select NET_PKT_CONTROL_BLOCK
	depends on $(dt_compat_any_has_prop,$(DT_COMPAT_ZEPHYR_DSA_PORT),dsa-tag-protocol,1)
	help
	  NXP NETC tag protocol.

config DSA_TAG_PROTOCOL_MV88E6XXX
	bool "Tag protocol - Marvell DSA and EDSA"
	default y
	depends on DSA_MARVELL_MV88E6XXX
	help
	  Marvell DSA (4 byte) and Ethertype DSA (8 byte) tag protocols.

endif # DSA_DRIVERS
```

## drivers/ethernet/mdio/Kconfig.mv88e6xxx
```kconfig
# Copyright (c) 2026 Jiri Kastner
# SPDX-License-Identifier: Apache-2.0

config MDIO_MV88E6XXX
	bool "Marvell 88E6xxx switch internal MDIO bus"
	default y
	depends on DT_HAS_MARVELL_MV88E6XXX_MDIO_ENABLED
	depends on PHY_MARVELL_MV88E6XXX
	help
	  MDIO bus of the internal PHYs of a Marvell 88E6xxx switch, reached
	  through the switch's Global 2 SMI PHY registers. Lets generic PHY
	  drivers handle the switch user ports.
```

## drivers/ethernet/mdio/Kconfig.orion
```kconfig
# Copyright (c) 2026 Jiri Kastner
# SPDX-License-Identifier: Apache-2.0

config MDIO_ORION
	bool "Marvell Orion SMI (MDIO) driver"
	default y
	depends on DT_HAS_MARVELL_ORION_MDIO_ENABLED
	help
	  Enable the clause 22 SMI controller of Marvell Kirkwood/Armada
	  SoCs (compatible "marvell,orion-mdio").
```

## drivers/ethernet/phy/Kconfig.mv88e6xxx
```kconfig
# Copyright (c) 2026 Jiri Kastner
# SPDX-License-Identifier: Apache-2.0

config PHY_MARVELL_MV88E6XXX
	bool "Marvell 88E6xxx switch as a PHY (minimal bring-up)"
	default y
	depends on DT_HAS_MARVELL_MV88E6085_ENABLED
	select MDIO
	help
	  Configure a Marvell Link Street switch, attached in multi-chip SMI
	  mode, as a port expander for one MAC and report the aggregated
	  link state of its user ports through the Ethernet PHY API.

config PHY_MARVELL_MV88E6XXX_SHELL
	bool "Shell commands for the 88E6xxx AVB/Qav registers"
	depends on PHY_MARVELL_MV88E6XXX && SHELL
	help
	  "mv88e6xxx" shell command: raw read/write of the PTP, AVB, Qav
	  and Qvb register blocks behind the Global 2 AVB command and a
	  summary of the egress shapers.

config PHY_MARVELL_MV88E6XXX_TCAM
	bool "TCAM (ingress ACL) of the 88E6341/88E6390"
	depends on PHY_MARVELL_MV88E6XXX
	help
	  Rules matching the first 48 bytes of ingress frames on given
	  ports, with drop, trap to the CPU, redirect or mirror actions,
	  using the TCAM register layout of Linux for the 88E6390. With the
	  shell: "mv88e6xxx tcam add/del/list/flush".

config PHY_MARVELL_MV88E6XXX_TCAM_RULES
	int "Number of TCAM rules"
	default 32
	range 1 256
	depends on PHY_MARVELL_MV88E6XXX_TCAM
```

## drivers/flash/Kconfig.mvebu_rwtm
```kconfig
# Copyright (c) 2026 Jiri Kastner
# SPDX-License-Identifier: Apache-2.0

config FLASH_MVEBU_RWTM
	bool "Armada 3700 SPI NOR through the Cortex-M3"
	default y
	depends on DT_HAS_MARVELL_ARMADA_3700_RWTM_FLASH_ENABLED
	depends on !SOC_ARMADA3720_CM3
	depends on MBOX
	select FLASH_HAS_DRIVER_ENABLED
	select FLASH_HAS_PAGE_LAYOUT
	select FLASH_HAS_EXPLICIT_ERASE
	help
	  The A53 side: flash API calls become requests to the CM3, which
	  owns the SPI controller (soc option
	  SOC_ARMADA3720_CM3_FLASH_SERVER).

config FLASH_MVEBU_RWTM_TIMEOUT_MS
	int "Request timeout"
	default 5000
	depends on FLASH_MVEBU_RWTM

config FLASH_MVEBU_RWTM_FWUPDATE
	bool "fwupdate through the CM3"
	default y
	depends on FLASH_MVEBU_RWTM && FWUPDATE
	select FWUPDATE_PROGRAM_EXTERNAL
	help
	  fwupdate hands the received image to the CM3, which checks and
	  programs it; the A53 itself cannot write the firmware area.

config FLASH_MVEBU_RWTM_FWUPDATE_TIMEOUT
	int "Seconds for a whole update"
	default 180
	depends on FLASH_MVEBU_RWTM_FWUPDATE
```

## drivers/gpio/Kconfig.mvebu_a3700
```kconfig
# Copyright (c) 2026 Jiri Kastner
# SPDX-License-Identifier: Apache-2.0

config GPIO_MVEBU_A3700
	bool "Marvell Armada 3700 GPIO"
	default y
	depends on DT_HAS_MARVELL_ARMADA_3700_GPIO_ENABLED
	help
	  GPIO of the Armada 3700 north and south bridges, without interrupts.

config GPIO_MVEBU_A3700_TRACE
	bool "printk in the init"
	depends on GPIO_MVEBU_A3700
	help
	  Bring-up: needs GPIO_INIT_PRIORITY above CONSOLE_INIT_PRIORITY to
	  be visible.
```

## drivers/mbox/Kconfig.mvebu_rwtm
```kconfig
# Copyright (c) 2026 Jiri Kastner
# SPDX-License-Identifier: Apache-2.0

config MBOX_MVEBU_RWTM
	bool "Marvell Armada 3700 rWTM mailbox"
	default y
	depends on DT_HAS_MARVELL_ARMADA_3700_RWTM_MAILBOX_ENABLED || \
		   DT_HAS_MARVELL_ARMADA_3700_RWTM_SP_ENABLED
	help
	  Mailbox between the A53 cores and the Cortex-M3 secure processor
	  of the Armada 3700, both ends. Used as the doorbell of the icmsg
	  IPC backend; the WTMI firmware commands (below 0x200) stay
	  compatible.
```

## drivers/ntb/Kconfig
```kconfig
# Copyright (c) 2026 Jiri Kastner
# SPDX-License-Identifier: Apache-2.0

menuconfig NTB
	bool "Non-Transparent Bridge (NTB) drivers"
	help
	  Devices bridging two memory domains with scratchpads, doorbells
	  and memory windows (include/zephyr/drivers/ntb.h), such as the
	  vNTB PCIe endpoint function.

if NTB

config NTB_SHELL
	bool "ntb shell command"
	default y
	depends on SHELL
	select CRC
	help
	  Link, scratchpads, doorbells and memory windows of any NTB device
	  from the shell, the counterpart of the Linux ntb_tool. Includes
	  an echo responder for doorbell round trips.

endif # NTB
```
