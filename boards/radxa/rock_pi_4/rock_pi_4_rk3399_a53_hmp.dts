/*
 * Copyright The Zephyr Project Contributors
 * SPDX-License-Identifier: Apache-2.0
 */

/dts-v1/;

/* boots on CPU0 (A53) and runs all six cores, the A72s included, as one SMP image */
#include <rockchip/rk3399.dtsi>
#include "rock_pi_4_a.dtsi"

/ {
	sram0: memory@200000 {
		reg = <ROCK_PI_4_A53_BASE ROCK_PI_4_A53_SIZE>;
	};
};
