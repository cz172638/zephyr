/*
 * Copyright The Zephyr Project Contributors
 * SPDX-License-Identifier: Apache-2.0
 */

/dts-v1/;

#include <rockchip/rk3399_a72.dtsi>
#include "rock_pi_4_a.dtsi"

/ {
	sram0: memory@4000000 {
		reg = <ROCK_PI_4_A72_BASE ROCK_PI_4_A72_SIZE>;
	};
};
