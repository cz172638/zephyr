/*
 * Copyright (c) 2026 Jiri Kastner <cz172638@gmail.com>
 *
 * SPDX-License-Identifier: Apache-2.0
 */

/dts-v1/;

#include "rock_pi_s.dtsi"

/ {
	model = "Radxa ROCK Pi S";

	cpus {
		/delete-node/ cpu@1;
		/delete-node/ cpu@2;
		/delete-node/ cpu@3;
	};
};
