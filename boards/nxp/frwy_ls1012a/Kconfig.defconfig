## boards/nxp/frwy_ls1012a/Kconfig.frwy_ls1012a
```kconfig
# Copyright The Zephyr Project Contributors
# SPDX-License-Identifier: Apache-2.0

config BOARD_FRWY_LS1012A
	select SOC_LS1012A
```

## boards/nxp/frwy_ls1012a/board.yml
```yaml
board:
  name: frwy_ls1012a
  full_name: FRWY-LS1012A
  vendor: nxp
  socs:
  - name: ls1012a
```

## boards/nxp/frwy_ls1012a/frwy_ls1012a_defconfig
```kconfig
# Copyright The Zephyr Project Contributors
# SPDX-License-Identifier: Apache-2.0

CONFIG_ARM64_VA_BITS_40=y
CONFIG_ARM64_PA_BITS_40=y
# generic timer, 25 MHz
CONFIG_SYS_CLOCK_HW_CYCLES_PER_SEC=25000000

CONFIG_XIP=n
CONFIG_AARCH64_IMAGE_HEADER=y

CONFIG_SERIAL=y
CONFIG_UART_INTERRUPT_DRIVEN=y
CONFIG_CONSOLE=y
CONFIG_UART_CONSOLE=y
```

## boards/radxa/cubie_a5e/Kconfig.cubie_a5e
```kconfig
# Copyright The Zephyr Project Contributors
# SPDX-License-Identifier: Apache-2.0

config BOARD_CUBIE_A5E
	select SOC_SUN55I_A523
```

## boards/radxa/cubie_a5e/board.yml
```yaml
# Copyright The Zephyr Project Contributors
# SPDX-License-Identifier: Apache-2.0

board:
  name: cubie_a5e
  full_name: Cubie A5E
  vendor: radxa
  socs:
    - name: sun55i_a523
      variants:
        - name: smp
```

## boards/radxa/rock_pi_s/Kconfig.rock_pi_s
```kconfig
# Copyright (c) 2026 Jiri Kastner <cz172638@gmail.com>
# SPDX-License-Identifier: Apache-2.0

config BOARD_ROCK_PI_S
	select SOC_RK3308
```

## boards/radxa/rock_pi_s/board.yml
```yaml
board:
  name: rock_pi_s
  full_name: Radxa ROCK Pi S
  vendor: radxa
  socs:
  - name: rk3308
    variants:
    - name: smp
```

## drivers/flash/Kconfig.fsl_qspi
```kconfig
# Copyright The Zephyr Project Contributors
# SPDX-License-Identifier: Apache-2.0

config FLASH_FSL_QSPI
	bool "Freescale QuadSPI SPI NOR flash driver (Layerscape)"
	default y
	depends on DT_HAS_FSL_LS1021A_QSPI_ENABLED
	select FLASH_HAS_DRIVER_ENABLED
	select FLASH_HAS_PAGE_LAYOUT
	select FLASH_HAS_EXPLICIT_ERASE
	help
	  SPI NOR flash on the QuadSPI controller of the NXP Layerscape
	  LS1021A and LS1012A, single wire, through IP commands and the AHB
	  read buffer.
```

## drivers/hwinfo/Kconfig.rockchip
```kconfig
# Copyright The Zephyr Project Contributors
# SPDX-License-Identifier: Apache-2.0

config HWINFO_RK3308
	bool "RK3308 OTP CPU ID"
	default y
	depends on DT_HAS_ROCKCHIP_RK3308_OTP_ENABLED
	select HWINFO_HAS_DRIVER
	help
	  Device ID from the 16-byte CPU ID in the RK3308 OTP.
```

## drivers/i2c/Kconfig.rockchip
```kconfig
# SPDX-FileCopyrightText: Copyright The Zephyr Project Contributors
# SPDX-License-Identifier: Apache-2.0

config I2C_ROCKCHIP
	bool "Rockchip I2C controller"
	default y
	depends on DT_HAS_ROCKCHIP_RK3399_I2C_ENABLED
	select PINCTRL if $(dt_compat_any_has_prop,$(DT_COMPAT_ROCKCHIP_RK3399_I2C),pinctrl-0)
	help
	  Polled driver for the Rockchip I2C controller of the RK3399
	  ("rk3x", v1 timing): standard and fast mode, 7-bit addresses,
	  chunks of up to 32 bytes, register reads of up to three address
	  bytes as one transaction.
```

## drivers/pcie/controller/Kconfig.sun55i
```kconfig
# Copyright The Zephyr Project Contributors
# SPDX-License-Identifier: Apache-2.0

config PCIE_SUN55I
	bool "Allwinner A523 PCIe root complex"
	default y
	depends on DT_HAS_ALLWINNER_SUN55I_A523_PCIE_ENABLED
	depends on GPIO
	help
	  The A523/A527/T527 PCIe controller (DesignWare, root complex only):
	  power domain, clocks and combo PHY bring-up, configuration requests
	  through outbound iATU region 0, memory and I/O windows from "ranges",
	  generic enumeration. No interrupts yet (polled devices only).

config PCIE_SUN55I_INIT_PRIORITY
	int "POST_KERNEL init priority"
	default 84
	depends on PCIE_SUN55I
	help
	  After GPIO and the GPIO hogs (the lane switch on the Cubie A5E).

config PCIE_SUN55I_POLL_MS
	int "Link monitor period [ms]"
	default 100
	depends on PCIE_SUN55I
	help
	  The core resets the root port registers and the iATU when the link
	  goes down. The monitor puts them back and enumerates again when the
	  link is in L0. 0 disables it.
```

## drivers/pcie/endpoint/Kconfig.dwc
```kconfig
# Copyright The Zephyr Project Contributors
# SPDX-License-Identifier: Apache-2.0

config PCIE_EPC_DWC
	bool
	select PCIE_EPC
	help
	  Register level support for the Synopsys DesignWare PCIe controller
	  in endpoint mode, used by SoC specific glue drivers.

config PCIE_EPC_LAYERSCAPE
	bool "NXP Layerscape PCIe endpoint controller"
	default y
	depends on DT_HAS_FSL_LS_PCIE_EP_ENABLED
	select PCIE_EPC_DWC
	help
	  The DesignWare based PCIe controller of the Layerscape SoCs in
	  endpoint mode (RCW agent mode): header, BARs, outbound windows,
	  MSI and link events.

if PCIE_EPC_DWC

config PCIE_EPC_DWC_POLL_MS
	int "Link poll period [ms]"
	default 20
	help
	  Link state, bus master enable and the glue's link events are
	  polled.

config PCIE_EPC_DWC_OB_SIZE
	hex "Outbound window mapped from the controller address space"
	default 0x1000000
	help
	  Part of the controller's address space mapped for outbound
	  windows (MSI, host memory access).

endif # PCIE_EPC_DWC
```

## drivers/pinctrl/Kconfig.rockchip
```kconfig
# Copyright (c) 2026 Jiri Kastner <cz172638@gmail.com>
# SPDX-License-Identifier: Apache-2.0

config PINCTRL_RK3308
	bool "Rockchip RK3308 pin controller"
	default y
	depends on DT_HAS_ROCKCHIP_RK3308_PINCTRL_ENABLED
	help
	  Enable the GRF iomux pin controller driver for Rockchip RK3308.
```

## drivers/pwm/Kconfig.rockchip
```kconfig
# Copyright The Zephyr Project Contributors
# SPDX-License-Identifier: Apache-2.0

config PWM_ROCKCHIP
	bool "Rockchip PWM (RK3328 generation)"
	default y
	depends on DT_HAS_ROCKCHIP_RK3328_PWM_ENABLED
	depends on CLOCK_CONTROL
	select PINCTRL
	help
	  Rockchip PWM as in RK3328 and RK3308: one channel per instance,
	  continuous output.
```

## drivers/regulator/Kconfig.pwm
```kconfig
# Copyright The Zephyr Project Contributors
# SPDX-License-Identifier: Apache-2.0

config REGULATOR_PWM
	bool "PWM-controlled regulators"
	default y
	depends on DT_HAS_PWM_REGULATOR_ENABLED
	select PWM
	help
	  Regulators whose output voltage follows the duty cycle of a PWM
	  (continuous mode of the pwm-regulator binding).

if REGULATOR_PWM

config REGULATOR_PWM_INIT_PRIORITY
	int "Init priority"
	default 76
	help
	  Device driver initialization priority, after the PWM controller.

endif # REGULATOR_PWM
```

## drivers/regulator/Kconfig.rk808
```kconfig
# Copyright The Zephyr Project Contributors
# SPDX-License-Identifier: Apache-2.0

config REGULATOR_RK808
	bool "Rockchip RK808 PMIC regulator driver"
	default y
	depends on DT_HAS_ROCKCHIP_RK808_REGULATOR_ENABLED
	select I2C
	help
	  Driver for the DCDC_REG1 and DCDC_REG2 buck converters of the
	  Rockchip RK808 PMIC.

config REGULATOR_RK808_INIT_PRIORITY
	int "Rockchip RK808 regulator driver init priority"
	default 75
	depends on REGULATOR_RK808
	help
	  Init priority of the RK808 regulators; above the I2C bus driver.
```

## drivers/regulator/Kconfig.syr827
```kconfig
# Copyright The Zephyr Project Contributors
# SPDX-License-Identifier: Apache-2.0

config REGULATOR_SYR827
	bool "Silergy SYR827 regulator driver"
	default y
	depends on DT_HAS_SILERGY_SYR827_ENABLED
	select I2C
	help
	  Driver for the Silergy SYR827 step-down regulator.

config REGULATOR_SYR827_INIT_PRIORITY
	int "Silergy SYR827 regulator driver init priority"
	default 75
	depends on REGULATOR_SYR827
	help
	  Init priority of the SYR827 regulator; above the I2C bus driver.
```

## drivers/spi/Kconfig.allwinner
```kconfig
# Copyright The Zephyr Project Contributors
# SPDX-License-Identifier: Apache-2.0

config SPI_ALLWINNER
	bool "Allwinner SPI controller driver"
	default y
	depends on DT_HAS_ALLWINNER_SUN55I_A523_SPI_ENABLED
	help
	  Enable the SPI controllers found on the Allwinner A523/A527/T527
	  SoCs. Transfers are polled, the controller clock is derived from
	  the always-on 24 MHz oscillator.

if SPI_ALLWINNER

config SPI_ALLWINNER_A523_SPI0_PC_PINMUX
	bool "Configure SPI0 pins on port C"
	default y
	help
	  Mux PC2, PC3 (CS0), PC4 and PC12 to the "spi0" function. Disable
	  this option if the SPI0 pins are muxed by earlier firmware boot
	  stages, e.g. U-Boot, or are used differently.

endif # SPI_ALLWINNER
```

## dts/bindings/clock/rockchip,rk3308-cru-clk.yaml
```yaml
# Copyright (c) 2026 Jiri Kastner <cz172638@gmail.com>
# SPDX-License-Identifier: Apache-2.0

title: Rockchip RK3308 CRU Clock Controller

description: |
  Clock gate controller for the Rockchip RK3308 CRU. Clock IDs are defined in
  include/zephyr/dt-bindings/clock/rk3308-cru.h and encode the CRU_CLKGATE_CON
  index and bit directly.

compatible: "rockchip,rk3308-cru-clk"

include: [clock-controller.yaml, base.yaml]

properties:
  "#clock-cells":
    const: 1

clock-cells:
  - clkid
```

## dts/bindings/clock/rockchip,rk3308-cru.yaml
```yaml
# Copyright (c) 2026 Jiri Kastner <cz172638@gmail.com>
# SPDX-License-Identifier: Apache-2.0

title: Rockchip RK3308 CRU

description: |
  Rockchip RK3308 Clock and Reset Unit (CRU) register block. A child node
  provides the clock gate controller interface.

compatible: "rockchip,rk3308-cru"

include: base.yaml

properties:
  reg:
    required: true

child-binding:
  description: Clock controller sharing the CRU register block.
```
