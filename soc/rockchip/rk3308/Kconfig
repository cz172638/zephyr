## soc/rockchip/rk3308/Kconfig
```kconfig
# Copyright (c) 2026 Jiri Kastner <cz172638@gmail.com>
# SPDX-License-Identifier: Apache-2.0

config SOC_RK3308
	select ARM64
	select CPU_CORTEX_A35
	select ARM_ARCH_TIMER if SYS_CLOCK_EXISTS
	select PINCTRL
	select CLOCK_CONTROL

config SOC_PART_NUMBER
	default "RK3308" if SOC_RK3308
```

## soc/rockchip/rk3308/Kconfig.soc
```kconfig
# Copyright (c) 2026 Jiri Kastner <cz172638@gmail.com>
# SPDX-License-Identifier: Apache-2.0

config SOC_SERIES_RK3308
	bool
	select SOC_FAMILY_ROCKCHIP

config SOC_RK3308
	bool
	select SOC_SERIES_RK3308

config SOC_SERIES
	default "rk3308" if SOC_SERIES_RK3308

config SOC
	default "rk3308" if SOC_RK3308
```

## subsys/dap/Kconfig
```kconfig
# Copyright (c) 2018-2019 PHYTEC Messtechnik GmbH
# SPDX-License-Identifier: Apache-2.0

menuconfig DAP
	bool "Debug Access Port support [EXPERIMENTAL]"
	select EXPERIMENTAL
	select DP_DRIVER
	help
	  Debug Access Port support (currently CMSIS DAP only)

if DAP

config CMSIS_DAP_PACKET_COUNT
	int "Maximum packet buffers for request and response data."
	default 4
	range 1 $(UINT8_MAX)
	help
	  Maximum packet buffers for request and response data.

config CMSIS_DAP_PROBE_VENDOR
	string "Probe vendor"
	default "Zephyr"

config CMSIS_DAP_PROBE_NAME
	string "Probe name"
	default "CMSIS-DAP"

config CMSIS_DAP_BOARD_VENDOR
	string "Target board vendor"
	default ""

config CMSIS_DAP_BOARD_NAME
	string "Target board name"
	default ""

config CMSIS_DAP_DEVICE_VENDOR
	string "Target device vendor"
	default ""

config CMSIS_DAP_DEVICE_NAME
	string "Target device name"
	default ""

config DAP_BACKEND_USB
	bool "USB backend"
	depends on USB_DEVICE_STACK_NEXT
	help
	  DAP USB backend using bulk endpoints.

config DAP_BACKEND_TCP
	bool "TCP backend"
	depends on NET_SOCKETS && NET_TCP && NET_IPV4
	help
	  DAP over TCP, framed as OpenOCD's "cmsis-dap backend tcp" expects:
	    adapter driver cmsis-dap
	    cmsis-dap backend tcp
	    cmsis-dap tcp host <address>

if DAP_BACKEND_TCP

config DAP_BACKEND_TCP_PORT
	int "TCP port"
	default 4441

config DAP_BACKEND_TCP_PACKET_SIZE
	int "Packet size"
	default 1024
	range 64 1024
	help
	  Largest request and response payload; OpenOCD's TCP backend takes
	  up to 1024 bytes.

config DAP_BACKEND_TCP_STACK_SIZE
	int "Server thread stack size"
	default 2048

config DAP_BACKEND_TCP_PRIORITY
	int "Server thread priority"
	default 7

endif # DAP_BACKEND_TCP

module = DAP
module-str = dap
source "subsys/logging/Kconfig.template.log_config"

endif # DAP
```
