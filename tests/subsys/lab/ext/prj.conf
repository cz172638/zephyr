## CMakeLists.txt
```
# Copyright (c) 2026 Jiri Kastner
# SPDX-License-Identifier: Apache-2.0

cmake_minimum_required(VERSION 3.20.0)
find_package(Zephyr REQUIRED HINTS $ENV{ZEPHYR_BASE})
project(lab_ext)

# the loader glue of the lab agent, without the network parts
target_sources(app PRIVATE src/main.c ${ZEPHYR_BASE}/subsys/lab/lab_llext.c
  ${ZEPHYR_BASE}/subsys/lab/lab_mod.c ${ZEPHYR_BASE}/subsys/lab/lab_exports.c)
target_include_directories(app PRIVATE ${ZEPHYR_BASE}/subsys/lab)

set(gen ${ZEPHYR_BINARY_DIR}/include/generated)
add_llext_target(lab_hello_ext OUTPUT ${PROJECT_BINARY_DIR}/llext/lab_hello.llext
  SOURCES ${ZEPHYR_BASE}/subsys/lab/ext/lab_hello.c)
generate_inc_file_for_target(app ${PROJECT_BINARY_DIR}/llext/lab_hello.llext ${gen}/lab_hello.inc)

add_llext_target(mod_ext OUTPUT ${PROJECT_BINARY_DIR}/llext/mod.llext SOURCES src/mod_ext.c)
generate_inc_file_for_target(app ${PROJECT_BINARY_DIR}/llext/mod.llext ${gen}/mod.inc)

add_llext_target(mod99_ext OUTPUT ${PROJECT_BINARY_DIR}/llext/mod99.llext SOURCES src/mod_ext.c)
get_target_property(lib99 mod99_ext lib_target)
target_compile_definitions(${lib99} PRIVATE LAB_TEST_OTHER_IMAGE)
generate_inc_file_for_target(app ${PROJECT_BINARY_DIR}/llext/mod99.llext ${gen}/mod99.inc)
```

## Kconfig
```
# Copyright (c) 2026 Jiri Kastner
# SPDX-License-Identifier: Apache-2.0

# the loader parts of subsys/lab without CONFIG_LAB_AGENT (networking)
config LAB_LOG_LEVEL
	int
	default 3

config LAB_IMAGE
	int
	default 7

config LAB_MODS
	int
	default 4

source "Kconfig.zephyr"
```

## prj.conf
```kconfig
CONFIG_ZTEST=y
CONFIG_LOG=y
CONFIG_LLEXT=y
CONFIG_LLEXT_HEAP_SIZE=512
CONFIG_HEAP_MEM_POOL_SIZE=32768
CONFIG_SHELL=y
CONFIG_SHELL_BACKEND_SERIAL=n
CONFIG_SHELL_BACKEND_DUMMY=y
CONFIG_DYNAMIC_INTERRUPTS=y
```

## src/main.c
```c
/*
 * Copyright (c) 2026 Jiri Kastner
 * SPDX-License-Identifier: Apache-2.0
 *
 * The lab test extension through the lab loader (lab_ext_run), with
 * the network side stubbed: relocations, data/bss reset between loads,
 * the api table, and errors for a bad image or a missing entry point.
 */

#include <errno.h>
#include <string.h>

#include <zephyr/kernel.h>
#include <zephyr/lab/lab.h>
#include <zephyr/logging/log.h>
#include <zephyr/ztest.h>

#include "lab_internal.h"

LOG_MODULE_REGISTER(lab, CONFIG_LAB_LOG_LEVEL);

static const uint8_t ext[] __aligned(8) = {
#include "lab_hello.inc"
};

uint64_t lab_now_ns(void)
{
	return k_cyc_to_ns_floor64(k_cycle_get_64());
}

int lab_local_exec(const char *cmd, char *out, size_t len)
{
	ARG_UNUSED(cmd);
	if (len > 0) {
		out[0] = '\0';
	}
	return 0;
}

int lab_peer_exec(const char *cmd, char *out, size_t len, k_timeout_t timeout)
{
	ARG_UNUSED(cmd);
	ARG_UNUSED(out);
	ARG_UNUSED(len);
	ARG_UNUSED(timeout);
	return -ENOTCONN;
}

int64_t lab_peer_offset_ns(void)
{
	return 1234;
}

const char *lab_role(void)
{
	return "test";
}

ZTEST(lab_ext, test_run)
{
	char *argv[] = {"lab_hello", "x"};

	zassert_equal(lab_ext_run(NULL, "lab_hello", ext, sizeof(ext), NULL, 2, argv, false), 0);
}

ZTEST(lab_ext, test_reload)
{
	char *argv[] = {"lab_hello"};

	/* data and bss come back fresh on every load (counter == 7 check) */
	for (int i = 0; i < 5; i++) {
		zassert_equal(lab_ext_run(NULL, "lab_hello", ext, sizeof(ext), NULL, 1, argv, false), 0,
			      "run %d", i);
	}
}

ZTEST(lab_ext, test_missing_fn)
{
	zassert_equal(lab_ext_run(NULL, "lab_hello", ext, sizeof(ext), "nope", 0, NULL, false), -ENOENT);
}

ZTEST(lab_ext, test_bad_image)
{
	static uint8_t bad[256];

	memcpy(bad, ext, sizeof(bad));
	bad[1] = 'X'; /* ELF magic */
	zassert_true(lab_ext_run(NULL, "bad", bad, sizeof(bad), NULL, 0, NULL, false) < 0);
}



/* ---- debug modules (lab mod) ---- */

#include <zephyr/lab/mod.h>
#include <zephyr/llext/symbol.h>
#include <zephyr/shell/shell_dummy.h>

int lab_test_inits, lab_test_finis, lab_test_calls;
EXPORT_SYMBOL(lab_test_calls);
EXPORT_SYMBOL(lab_test_inits);
EXPORT_SYMBOL(lab_test_finis);

static const uint8_t mod[] __aligned(8) = {
#include "mod.inc"
};

static const uint8_t mod99[] __aligned(8) = {
#include "mod99.inc"
};

static const char *run(const char *cmd, int *ret)
{
	const struct shell *sh = shell_backend_dummy_get_ptr();
	size_t n;

	shell_backend_dummy_clear_output(sh);
	*ret = shell_execute_cmd(sh, cmd);
	return shell_backend_dummy_get_output(sh, &n);
}

ZTEST(lab_ext, test_mod)
{
	const struct shell *sh = shell_backend_dummy_get_ptr();
	struct shell_static_entry e;
	const char *out;
	int ret;

	lab_test_inits = lab_test_finis = 0;
	zassert_ok(lab_mod_load(sh, mod, sizeof(mod), "7-labt.llext", false));
	zassert_equal(lab_test_inits, 1);
	zassert_true(lab_mod_get("dbg", 0, &e));
	zassert_str_equal(e.syntax, "labt");
	zassert_false(lab_mod_get("pcie", 0, &e));

	out = run("dbg labt hello", &ret);
	zassert_ok(ret);
	zassert_not_null(strstr(out, "labt hello calls 1"), "ret %d out [%s]", ret, out);
	out = run("dbg labt sub", &ret);
	zassert_ok(ret);
	zassert_not_null(strstr(out, "labt sub ok"), "%s", out);

	/* reload by name: fini of the old, init of the new, fresh data */
	zassert_ok(lab_mod_load(sh, mod, sizeof(mod), "7-labt.llext", false));
	zassert_equal(lab_test_finis, 1);
	zassert_equal(lab_test_inits, 2);
	out = run("dbg labt again", &ret);
	zassert_not_null(strstr(out, "calls 1"), "%s", out);

	zassert_ok(lab_mod_unload(sh, "labt"));
	zassert_equal(lab_test_finis, 2);
	out = run("dbg labt", &ret);
	zassert_true(ret != 0);
	zassert_equal(lab_mod_unload(sh, "labt"), -ENOENT);
}

ZTEST(lab_ext, test_mod_image)
{
	const struct shell *sh = shell_backend_dummy_get_ptr();
	int ret;

	/* built for image 99, this is 7 */
	zassert_equal(lab_mod_load(sh, mod99, sizeof(mod99), "99-labt.llext", false), -ENOEXEC);
	zassert_ok(lab_mod_load(sh, mod99, sizeof(mod99), "99-labt.llext", true));
	(void)run("dbg labt", &ret);
	zassert_ok(ret);
	zassert_ok(lab_mod_unload(sh, "all"));
}

ZTEST(lab_ext, test_mod_slots)
{
	const struct shell *sh = shell_backend_dummy_get_ptr();

	/* the same command again replaces, so slots never run out */
	for (int i = 0; i < 2 * CONFIG_LAB_MODS; i++) {
		zassert_ok(lab_mod_load(sh, mod, sizeof(mod), "7-labt.llext", false), "%d", i);
	}
	zassert_ok(lab_mod_unload(sh, "all"));
}


static void *suite_setup(void)
{
	/* the dummy shell takes output only once its thread made it active */
	k_sleep(K_MSEC(200));
	return NULL;
}

ZTEST_SUITE(lab_ext, NULL, suite_setup, NULL, NULL, NULL);
```

## src/mod_ext.c
```c
/*
 * Copyright (c) 2026 Jiri Kastner
 * SPDX-License-Identifier: Apache-2.0
 *
 * A lab debug module: "dbg labt [arg]" with a subcommand, init and fini
 * reported to the firmware through exported counters.
 */

#ifdef LAB_TEST_OTHER_IMAGE
#undef CONFIG_LAB_IMAGE
#define CONFIG_LAB_IMAGE 99
#endif

#include <zephyr/lab/mod.h>
#include <zephyr/shell/shell.h>

extern int lab_test_inits, lab_test_finis, lab_test_calls;

static int calls;

static int cmd_labt(const struct shell *sh, size_t argc, char **argv)
{
	calls++;
	lab_test_calls++;
	shell_print(sh, "labt %s calls %d", argc > 1 ? argv[1] : "-", calls);
	return 0;
}

static int cmd_sub(const struct shell *sh, size_t argc, char **argv)
{
	shell_print(sh, "labt sub ok");
	return 0;
}

SHELL_STATIC_SUBCMD_SET_CREATE(labt_cmds,
	SHELL_CMD_ARG(sub, NULL, "a subcommand", cmd_sub, 1, 0),
	SHELL_SUBCMD_SET_END);

static int labt_init(void)
{
	lab_test_inits++;
	return 0;
}

static void labt_fini(void)
{
	lab_test_finis++;
}

LAB_DBG_CMD((dbg), "dbg", labt, &labt_cmds, "lab module test", cmd_labt, 1, 1, labt_init,
	    labt_fini);
```
